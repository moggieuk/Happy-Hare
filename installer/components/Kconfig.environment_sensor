## installer/components/Kconfig.environment_sensor
```kconfig
# Environment sensor - type, i2c bus and address of one [temperature_sensor].
#
# Sourced once for the shared sensor and once per gate (Kconfig.environment_sensor),
# inside the caller's feature `if`. The caller sets:
#
#   env_sensor_suffix  appended to every symbol name: empty for the shared
#                      sensor, _<gate> for a per-gate one
#
# and must re-assign it on the line before each source: preprocessor variables
# are global for the whole parse, and @repeat substitutes its variable only in
# its own body, never in a sourced file.
#
# The i2c bus comes from components/Kconfig.i2c_bus, shared with the NFC reader.
#
# Defines, for each $(env_sensor_suffix):
#   CHOICE_ENVIRONMENT_SENSOR_TYPE* PARAM_ENVIRONMENT_SENSOR_TYPE*
#   PARAM_SENSOR_REPORT_TIME_PARAM* PARAM_ENVIRONMENT_SENSOR_REPORT_TIME*
#   CHOICE_ENVIRONMENT_SENSOR_HTU21D_RESOLUTION*
#   PARAM_ENVIRONMENT_SENSOR_HTU21D_RESOLUTION*
#   PARAM_ENVIRONMENT_SENSOR_HTU21D_HOLD_MASTER*
#   PARAM_ENVIRONMENT_SENSOR_I2C_ADDRESS*
#   and the i2c bus symbols (components/Kconfig.i2c_bus)

choice CHOICE_ENVIRONMENT_SENSOR_TYPE$(env_sensor_suffix)
  prompt "Sensor type       "
  default CHOICE_ENVIRONMENT_SENSOR_TYPE_AHT2X$(env_sensor_suffix)
  help
    Select the type of environment sensor
    AHT1X/AHT2X/AHT3X need Klipper newer than v0.13.0 or Kalico v2026.06+
    Use AHT10 on older firmware
    The HTU21D family needs MCU i2c support for zero-length writes

  config CHOICE_ENVIRONMENT_SENSOR_TYPE_AHT10$(env_sensor_suffix)
    bool "AHT10 [[DIM]]/ older Klipper[[/DIM]]"
    help
      AHT10/AHT20/AHT21 on Klipper v0.13.0 or older or Kalico before v2026.06.
      Newer firmware treats AHT10 as AHT1X, so choose AHT2X/AHT3X there.

  config CHOICE_ENVIRONMENT_SENSOR_TYPE_AHT1X$(env_sensor_suffix)
    bool "AHT1X"
    help
      AHT1X humidity/temperature sensor

  config CHOICE_ENVIRONMENT_SENSOR_TYPE_AHT2X$(env_sensor_suffix)
    bool "AHT2X"
    help
      AHT2X humidity/temperature sensor

  config CHOICE_ENVIRONMENT_SENSOR_TYPE_AHT3X$(env_sensor_suffix)
    bool "AHT3X"
    help
      AHT3X humidity/temperature sensor

  config CHOICE_ENVIRONMENT_SENSOR_TYPE_BME280$(env_sensor_suffix)
    bool "BME280 [[DIM]]/ BMP180 / BMP280 / BMP388 / BME680[[/DIM]]"
    help
      BME280 humidity/temperature/pressure sensor. Klipper detects the
      chip, so this also covers BMP180, BMP280, BMP388 and BME680.
      Only BME280 and BME680 report humidity; with a BMP chip, drying
      runs for its full time and any humidity goal is ignored.

  config CHOICE_ENVIRONMENT_SENSOR_TYPE_HTU21D$(env_sensor_suffix)
    bool "HTU21D"
    help
      HTU21D humidity/temperature sensor

  config CHOICE_ENVIRONMENT_SENSOR_TYPE_SI7013$(env_sensor_suffix)
    bool "SI7013 [[DIM]]/ HTU21D family[[/DIM]]"
    help
      SI7013 humidity/temperature sensor (Klipper's HTU21D driver)

  config CHOICE_ENVIRONMENT_SENSOR_TYPE_SI7020$(env_sensor_suffix)
    bool "SI7020 [[DIM]]/ HTU21D family[[/DIM]]"
    help
      SI7020 humidity/temperature sensor (Klipper's HTU21D driver)

  config CHOICE_ENVIRONMENT_SENSOR_TYPE_SI7021$(env_sensor_suffix)
    bool "SI7021 [[DIM]]/ HTU21D family[[/DIM]]"
    help
      SI7021 humidity/temperature sensor (Klipper's HTU21D driver)

  config CHOICE_ENVIRONMENT_SENSOR_TYPE_SHT21$(env_sensor_suffix)
    bool "SHT21 [[DIM]]/ HTU21D family[[/DIM]]"
    help
      SHT21 humidity/temperature sensor (Klipper's HTU21D driver)

  config CHOICE_ENVIRONMENT_SENSOR_TYPE_SHT3X$(env_sensor_suffix)
    bool "SHT3X"
    help
      SHT3X (SHT30/SHT31/SHT35) humidity/temperature sensor

  config CHOICE_ENVIRONMENT_SENSOR_TYPE_LM75$(env_sensor_suffix)
    bool "LM75 [[DIM]]/ temperature only[[/DIM]]"
    help
      LM75 temperature sensor. It has no humidity reading, so drying
      runs for its full time and any humidity goal is ignored.
endchoice

config PARAM_ENVIRONMENT_SENSOR_TYPE$(env_sensor_suffix)
  string
  default "AHT10"  if CHOICE_ENVIRONMENT_SENSOR_TYPE_AHT10$(env_sensor_suffix)
  default "AHT1X"  if CHOICE_ENVIRONMENT_SENSOR_TYPE_AHT1X$(env_sensor_suffix)
  default "AHT2X"  if CHOICE_ENVIRONMENT_SENSOR_TYPE_AHT2X$(env_sensor_suffix)
  default "AHT3X"  if CHOICE_ENVIRONMENT_SENSOR_TYPE_AHT3X$(env_sensor_suffix)
  default "BME280" if CHOICE_ENVIRONMENT_SENSOR_TYPE_BME280$(env_sensor_suffix)
  default "HTU21D" if CHOICE_ENVIRONMENT_SENSOR_TYPE_HTU21D$(env_sensor_suffix)
  default "SI7013" if CHOICE_ENVIRONMENT_SENSOR_TYPE_SI7013$(env_sensor_suffix)
  default "SI7020" if CHOICE_ENVIRONMENT_SENSOR_TYPE_SI7020$(env_sensor_suffix)
  default "SI7021" if CHOICE_ENVIRONMENT_SENSOR_TYPE_SI7021$(env_sensor_suffix)
  default "SHT21"  if CHOICE_ENVIRONMENT_SENSOR_TYPE_SHT21$(env_sensor_suffix)
  default "SHT3X"  if CHOICE_ENVIRONMENT_SENSOR_TYPE_SHT3X$(env_sensor_suffix)
  default "LM75"   if CHOICE_ENVIRONMENT_SENSOR_TYPE_LM75$(env_sensor_suffix)

config PARAM_SENSOR_REPORT_TIME_PARAM$(env_sensor_suffix)
  string
  default "aht10_report_time"  if CHOICE_ENVIRONMENT_SENSOR_TYPE_AHT10$(env_sensor_suffix) || CHOICE_ENVIRONMENT_SENSOR_TYPE_AHT1X$(env_sensor_suffix) || CHOICE_ENVIRONMENT_SENSOR_TYPE_AHT2X$(env_sensor_suffix) || CHOICE_ENVIRONMENT_SENSOR_TYPE_AHT3X$(env_sensor_suffix)
  default "htu21d_report_time" if CHOICE_ENVIRONMENT_SENSOR_TYPE_HTU21D$(env_sensor_suffix) || CHOICE_ENVIRONMENT_SENSOR_TYPE_SI7013$(env_sensor_suffix) || CHOICE_ENVIRONMENT_SENSOR_TYPE_SI7020$(env_sensor_suffix) || CHOICE_ENVIRONMENT_SENSOR_TYPE_SI7021$(env_sensor_suffix) || CHOICE_ENVIRONMENT_SENSOR_TYPE_SHT21$(env_sensor_suffix)
  default "sht3x_report_time"  if CHOICE_ENVIRONMENT_SENSOR_TYPE_SHT3X$(env_sensor_suffix)
  default "lm75_report_time"   if CHOICE_ENVIRONMENT_SENSOR_TYPE_LM75$(env_sensor_suffix)
  default ""

config PARAM_ENVIRONMENT_SENSOR_REPORT_TIME$(env_sensor_suffix)
  int "Report time (secs)" if PARAM_SENSOR_REPORT_TIME_PARAM$(env_sensor_suffix) != ""
  default 0  if CHOICE_ENVIRONMENT_SENSOR_TYPE_BME280$(env_sensor_suffix)
  default 60
  range 0 300     if CHOICE_ENVIRONMENT_SENSOR_TYPE_SHT3X$(env_sensor_suffix) || CHOICE_ENVIRONMENT_SENSOR_TYPE_LM75$(env_sensor_suffix)
  range 0 0 5 300
  help
    Seconds between sensor readings (default 60 seconds)

    0 leaves the option out so Klipper uses its own default
    (30 secs; 1 sec for SHT3X, 0.8 secs for LM75).
    Otherwise at least 5 secs (1 sec for SHT3X and LM75).

if PARAM_SENSOR_REPORT_TIME_PARAM$(env_sensor_suffix) = "htu21d_report_time"
  choice CHOICE_ENVIRONMENT_SENSOR_HTU21D_RESOLUTION$(env_sensor_suffix)
    prompt "Resolution        "
    default CHOICE_ENVIRONMENT_SENSOR_HTU21D_RESOLUTION_DEFAULT$(env_sensor_suffix)
    help
      Measurement resolution (htu21d_resolution). "Klipper default"
      leaves the option out, so Klipper uses TEMP12_HUM08.

    config CHOICE_ENVIRONMENT_SENSOR_HTU21D_RESOLUTION_DEFAULT$(env_sensor_suffix)
      bool "Klipper default"

    config CHOICE_ENVIRONMENT_SENSOR_HTU21D_RESOLUTION_TEMP14_HUM12$(env_sensor_suffix)
      bool "TEMP14_HUM12"

    config CHOICE_ENVIRONMENT_SENSOR_HTU21D_RESOLUTION_TEMP13_HUM10$(env_sensor_suffix)
      bool "TEMP13_HUM10"

    config CHOICE_ENVIRONMENT_SENSOR_HTU21D_RESOLUTION_TEMP12_HUM08$(env_sensor_suffix)
      bool "TEMP12_HUM08"

    config CHOICE_ENVIRONMENT_SENSOR_HTU21D_RESOLUTION_TEMP11_HUM11$(env_sensor_suffix)
      bool "TEMP11_HUM11"
  endchoice

  config PARAM_ENVIRONMENT_SENSOR_HTU21D_RESOLUTION$(env_sensor_suffix)
    string
    default "TEMP14_HUM12" if CHOICE_ENVIRONMENT_SENSOR_HTU21D_RESOLUTION_TEMP14_HUM12$(env_sensor_suffix)
    default "TEMP13_HUM10" if CHOICE_ENVIRONMENT_SENSOR_HTU21D_RESOLUTION_TEMP13_HUM10$(env_sensor_suffix)
    default "TEMP12_HUM08" if CHOICE_ENVIRONMENT_SENSOR_HTU21D_RESOLUTION_TEMP12_HUM08$(env_sensor_suffix)
    default "TEMP11_HUM11" if CHOICE_ENVIRONMENT_SENSOR_HTU21D_RESOLUTION_TEMP11_HUM11$(env_sensor_suffix)
    default ""

  config PARAM_ENVIRONMENT_SENSOR_HTU21D_HOLD_MASTER$(env_sensor_suffix)
    boolint "Hold master mode  "
    default 0
    help
      Read with hold master mode commands (htu21d_hold_master).
      Leave off unless your sensor needs it.
endif

i2c_prefix    := ENVIRONMENT_SENSOR
i2c_suffix    := $(env_sensor_suffix)
i2c_stem      := i2c
i2c_pad       := 18
i2c_type_hint :=
source "components/Kconfig.i2c_bus"

config PARAM_ENVIRONMENT_SENSOR_I2C_ADDRESS$(env_sensor_suffix)
  int "i2c address       "
  default 118 if CHOICE_ENVIRONMENT_SENSOR_TYPE_BME280$(env_sensor_suffix)
  default 64  if CHOICE_ENVIRONMENT_SENSOR_TYPE_HTU21D$(env_sensor_suffix) || CHOICE_ENVIRONMENT_SENSOR_TYPE_SI7013$(env_sensor_suffix) || CHOICE_ENVIRONMENT_SENSOR_TYPE_SI7020$(env_sensor_suffix) || CHOICE_ENVIRONMENT_SENSOR_TYPE_SI7021$(env_sensor_suffix) || CHOICE_ENVIRONMENT_SENSOR_TYPE_SHT21$(env_sensor_suffix)
  default 68  if CHOICE_ENVIRONMENT_SENSOR_TYPE_SHT3X$(env_sensor_suffix)
  default 72  if CHOICE_ENVIRONMENT_SENSOR_TYPE_LM75$(env_sensor_suffix)
  default 56
  help
    i2c address of the environment sensor (default 56 [0x38] for AHT sensors, 118 [0x76] for BME280, 64 [0x40] for HTU21D family, 68 [0x44] for SHT3X, 72 [0x48] for LM75)
    BMP180, BMP388 and some BME280 sensors use 119 [0x77] instead of 118.
```

## installer/connection/Kconfig.buffer_mcu
```kconfig
# Module sets the serial connection tokens
# Make the first 10 available serial tty devices selectable, it's unlikely people have more.
#
# Responsible for setting:
#   CHOICE_BUFFER_CONNECTION_TYPE_SERIAL
#   CHOICE_BUFFER_CONNECTION_TYPE_CANBUS
#   PARAM_BUFFER_SERIAL_DEVICE
#   PARAM_BUFFER_CANBUS_UUID
#   PARAM_BUFFER_CANBUS_INTERFACE

choice CHOICE_BUFFER_CONNECTION_TYPE
  prompt "MCU connection for sync-feedback buffer"
  default CHOICE_BUFFER_CONNECTION_TYPE_SERIAL
  help 
    Choose the type of mcu connection for sync-feedback buffer
    Serial or CANbus

  config CHOICE_BUFFER_CONNECTION_TYPE_SERIAL
    bool "Serial"
    help
      Select if your sync-feedback buffer connects via a serial connection to mcu board

  config CHOICE_BUFFER_CONNECTION_TYPE_CANBUS
    bool "CANbus"
    help
      Select if your sync-feedback buffer  connects with a CANbus connection to mcu board
endchoice

# PAUL TODO add chip as filter for serial devices

# -------------------------------------
# Serial
# -------------------------------------

if CHOICE_BUFFER_CONNECTION_TYPE_SERIAL

  choice CHOICE_BUFFER_SERIAL_CONNECTION
    prompt "Select serial device for sync-feedback buffer"
    default CHOICE_BUFFER_SERIAL_DEVICE_PREVIOUS if "$(saved-config-value,PARAM_BUFFER_SERIAL_DEVICE)" != ""
    help
      MCU connection for sync-feedback buffer
      Select the serial device connected to the sync-feedback buffer  mcu
      or select "Other" and enter it manually.

    config CHOICE_BUFFER_SERIAL_DEVICE_PREVIOUS
      bool "Previous selection: $(saved-config-value,PARAM_BUFFER_SERIAL_DEVICE)"
      depends on "$(saved-config-value,PARAM_BUFFER_SERIAL_DEVICE)" != ""

    @repeat var=i min=1 max=10@
    config $(buffer_serial_config,$(i))
      bool "$(serial_device,$(i))"
      depends on $(serial_exists,$(i))
    @endrepeat@

    config CHOICE_BUFFER_SERIAL_DEVICE_OTHER
      bool "Other / manually entered"
    if CHOICE_BUFFER_SERIAL_DEVICE_OTHER
      config BUFFER_SERIAL_DEVICE_OTHER
        string "Enter serial device path"
        default "-enter-device-path-"
        help
          MCU connection for sync-feedback buffer
          Specify the path of the serial device connected to the BUFFER's mcu.
          It's best to use the /dev/serial/by-id/ path, as it's unique and
          doesn't change when you plug in multiple serial devices.
          Example: /dev/serial/by-id/usb-Klipper_MCU_12345678-if00
    endif
  endchoice

  config PARAM_BUFFER_SERIAL_DEVICE
    string
    default "$(saved-config-value,PARAM_BUFFER_SERIAL_DEVICE)" if CHOICE_BUFFER_SERIAL_DEVICE_PREVIOUS
    @repeat var=i min=1 max=10@
    default "$(serial_device,$(i))" if $(buffer_serial_config,$(i))
    @endrepeat@
    default BUFFER_SERIAL_DEVICE_OTHER if CHOICE_BUFFER_SERIAL_DEVICE_OTHER

endif

# -------------------------------------
# CanBus
# -------------------------------------

if CHOICE_BUFFER_CONNECTION_TYPE_CANBUS

  choice CHOICE_BUFFER_CANBUS_CONNECTION
    prompt "Select canbus UUID for BUFFER"
    default CHOICE_BUFFER_CANBUS_UUID_PREVIOUS if "$(saved-config-value,PARAM_BUFFER_CANBUS_UUID)" != ""
    help
      MCU connection for BUFFER
      Select the CANbus uuid belonging to the BUFFER's mcu or select
      "Other" and enter it manually.

    config CHOICE_BUFFER_CANBUS_UUID_PREVIOUS
      bool "Previous selection: $(saved_canbus_connection,PARAM_BUFFER_CANBUS_INTERFACE,PARAM_BUFFER_CANBUS_UUID)"
      depends on "$(saved-config-value,PARAM_BUFFER_CANBUS_UUID)" != ""

    @repeat var=i min=1 max=10@
    config $(buffer_canbus_config,$(i))
      bool "$(canbus_connection,$(i))"
      depends on $(canbus_uuid_count) >= $(i)
    @endrepeat@

    config CHOICE_BUFFER_CANBUS_UUID_OTHER
      bool "Other / manually entered"
    if CHOICE_BUFFER_CANBUS_UUID_OTHER
      config BUFFER_CANBUS_UUID_OTHER
        string "Enter CANbus UUID"
        default "-enter-canbus-id-"
        help
          Specify the CANbus UUID that is used for connection to the sync-feedback buffer
          It is a 6 byte ID represented in hex.
          This can be found with:
            ~/klipper/klippy-env/bin/python ~/klipper/klipper/scripts/canbus_query.py <interface>
          Enter only the uuid portion (12 hex digits)
            E.g. 127081e7e3c6
      config BUFFER_CANBUS_INTERFACE_OTHER
        string "Enter CANbus interface"
        default "can0"
    endif
  endchoice

  config PARAM_BUFFER_CANBUS_UUID
    string
    default "$(saved-config-value,PARAM_BUFFER_CANBUS_UUID)" if CHOICE_BUFFER_CANBUS_UUID_PREVIOUS
    @repeat var=i min=1 max=10@
    default "$(canbus_uuid,$(i))" if $(buffer_canbus_config,$(i))
    @endrepeat@
    default BUFFER_CANBUS_UUID_OTHER if CHOICE_BUFFER_CANBUS_UUID_OTHER

  config PARAM_BUFFER_CANBUS_INTERFACE
    string
    default "$(saved_canbus_interface,PARAM_BUFFER_CANBUS_INTERFACE)" if CHOICE_BUFFER_CANBUS_UUID_PREVIOUS
    @repeat var=i min=1 max=10@
    default "$(canbus_interface,$(i))" if $(buffer_canbus_config,$(i))
    @endrepeat@
    default BUFFER_CANBUS_INTERFACE_OTHER if CHOICE_BUFFER_CANBUS_UUID_OTHER

endif
```
