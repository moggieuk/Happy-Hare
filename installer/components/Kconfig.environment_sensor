## installer/mmu_types/Kconfig.emu
```kconfig
config MMU_TYPE_EMU_1_0
  bool "EMU  - Expandable Multi-material Unit"
  help
    EMU is a modular type-B MMU with each spool being contained in it's own
    (optionally heater) enclosure. It had many features and is an incredible
    choice for new builds. Highly recommended to use with an analog proportional
    sync-feedback buffer like PSF.
  select VIRTUAL_SELECTOR
  select UNSELECT_MMU_HAS_FILAMENT_BUFFER # Disable
  imply  MMU_HAS_PER_GATE_MCU # Install must also be run with "-e" for PER_GATE_MCU support
  select MMU_HAS_PER_GATE_CONFIG
  imply  MMU_HAS_ENVIRONMENT_SENSOR
  select MMU_HAS_LEDS
  imply  MMU_HAS_EJECT_BUTTONS
  select MMU_HAS_SENSOR_ENTRY
  select MMU_HAS_SENSOR_EXIT
  select PARAM_VARIABLE_ROTATION_DISTANCES
  select PARAM_VARIABLE_BOWDEN_LENGTHS
  select PARAM_FILAMENT_ALWAYS_GRIPPED
  select PARAM_SYNC_TO_EXTRUDER
  select PARAM_SYNC_FORM_TIP
  select PARAM_SYNC_PURGE
  imply  MMU_HAS_SYNC_FEEDBACK_BUFFER
  imply  MMU_HAS_FANS
  imply  OPTION_PSF_BUFFER


# -------------------------------------
# Buffer option
# -------------------------------------

if MMU_TYPE_EMU_1_0
  config OPTION_PSF_BUFFER
    bool "PSF buffer"
    help
      Select if using the recommended PSF brand buffer connected to the bowden tube.
      Don't select if using a different sync-feedback buffer system (instead add
      under MMU additions)
    select MMU_HAS_SYNC_FEEDBACK_BUFFER
    select MMU_HAS_SENSOR_BUFFER_PROPORTIONAL
    select UNSELECT_MMU_HAS_SENSOR_BUFFER_COMPRESSION
    select UNSELECT_MMU_HAS_SENSOR_BUFFER_TENSION

  if OPTION_PSF_BUFFER
    choice CHOICE_BUFFER_SPRING_STATE
      default CHOICE_BUFFER_SPRING_STATE_TENSION
    endchoice

    config PARAM_BUFFER_RANGE
      default 16
    config PARAM_BUFFER_MAXRANGE
      default 16
  endif

  if !OPTION_PSF_BUFFER
    config MMU_HAS_SENSOR_BUFFER_COMPRESSION
      default y
    config MMU_HAS_SENSOR_BUFFER_TENSION
      default y
  endif
endif


# -------------------------------------
# Defaults
# -------------------------------------

if MMU_TYPE_EMU_1_0

  source "Kconfig.num_gates"

  choice CHOICE_DEFAULT_FAN_TEMPERATURE_SOURCE
    default CHOICE_DEFAULT_FAN_TEMPERATURE_SOURCE_MCU if FAN_HAS_MCU_TEMPERATURE
  endchoice


  source "Kconfig.capabilities"

  config PARAM_VENDOR
    default "EMU"
  config PARAM_VERSION
    default "1.0"  
  config PARAM_NUM_GATES
    default 5
  choice BOARD_TYPE
    default BOARD_TYPE_SLB_1_0
  endchoice

  # Gear stepper ---------------------------
  config PARAM_GEAR_GEAR_RATIO
    default "1:1"
  config PARAM_GEAR_RUN_CURRENT
    default 0.9
  config PARAM_GEAR_HOLD_CURRENT
    default 0.1
  config PARAM_GEAR_MICROSTEPS
    default 4

  config PARAM_SYNC_GEAR_CURRENT
    default 52

  # Speeds  --------------------------------
  config PARAM_GEAR_LOAD_SPEED
    default 250
  config PARAM_GEAR_LOAD_ACCEL
    default 120
  config PARAM_GEAR_FROM_FILAMENT_BUFFER_SPEED
    default 250
  config PARAM_GEAR_FROM_FILAMENT_BUFFER_ACCEL
    default 120
  config PARAM_GEAR_UNLOAD_SPEED
    default 250
  config PARAM_GEAR_UNLOAD_ACCEL
    default 120
  config PARAM_GEAR_SHORT_MOVE_SPEED
    default 80
  config PARAM_GEAR_SHORT_MOVE_ACCEL
    default 80
  config PARAM_GEAR_SHORT_MOVE_THRESHOLD
    default 100
  config PARAM_GEAR_HOMING_SPEED
    default 80

  # Gate endstops and homing ---------------
  config PARAM_GATE_HOMING_MAX
    default 600
  config PARAM_GATE_PARKING_DISTANCE
    default -1

  config PARAM_GATE_PRELOAD_HOMING_MAX
    default 600
  config PARAM_GATE_PRELOAD_PARKING_DISTANCE
    default -1

  config PARAM_GATE_FINAL_EJECT_DISTANCE
    default 100

  config PARAM_BOWDEN_UNLOAD_HOMING_BUFFER
    default 80
  config PARAM_EXTRUDER_HOMING_MAX
    default 300
  config PARAM_GATE_PRELOAD_ATTEMPTS
    default 5

  # NFC reader setup (if fitted) -----------
  config PARAM_NFC_GATE_JOG_SCAN_WINDOW
    default "0, 480"
  config PARAM_NFC_PRELOAD_JOG_SCAN_WINDOW
    default "0, 480"
  config PARAM_NFC_GATE_CLEAR_DISTANCE
    default 70
  config PARAM_NFC_PRELOAD_CLEAR_DISTANCE
    default 70
  config PARAM_NFC_NEIGHBOR_CHECK
    default y

  # Other ----------------------------------
  config PARAM_COLOR_ORDER
    default "GRBW"
  config PARAM_RETRY_TOOL_CHANGE_ON_ERROR
    default 1
  config PARAM_TOOLHEAD_UNLOAD_SAFETY_MARGIN
    default 40
  config VAR_SEQUENCE_MIN_TOOLCHANGE_Z
    default 30.0
  
  # LED effects override -------------------
  config PARAM_EFFECT_LOADING
    default "mmu_blue_clockwise_fast,   (0, 0, 0.4)"
  config PARAM_EFFECT_LOADING_EXTRUDER
    default "mmu_blue_clockwise_slow,   (0, 0, 1)"
  config PARAM_EFFECT_UNLOADING
    default "mmu_blue_anticlock_fast,   (0, 0, 0.4)"
  config PARAM_EFFECT_UNLOADING_EXTRUDER
    default "mmu_blue_anticlock_slow,   (0, 0, 1)"
  config PARAM_EFFECT_CHECKING
    default "mmu_breathing_white_fast,  (0.8, 0.8, 0.8)"
  config PARAM_EFFECT_GATE_AVAILABLE
    default "mmu_static_white_dim_$(UNIT_NAME), (0.1, 0.1, 0.1)"
  config PARAM_EFFECT_GATE_AVAILABLE_SEL
    default "mmu_static_white_$(UNIT_NAME),    (0.75, 0.75, 0.75)"
  config PARAM_EFFECT_GATE_EMPTY_SEL
    default "mmu_static_red_$(UNIT_NAME),      (0.2, 0, 0)"

  config PARAM_MISC_LED_EFFECTS
    default "$(ml,\
[mmu_led_effect mmu_static_white_$(UNIT_NAME)]\n\
unit      : $(UNIT_NAME)\n\
define_on : gates$(comma) exit\n\
layers    : static 0 0 top (1.0$(comma)1.0$(comma)1.0$(comma) 1.0)\n\
\n\
[mmu_led_effect mmu_static_white_dim_$(UNIT_NAME)]\n\
unit      : $(UNIT_NAME)\n\
define_on : gates$(comma) exit\n\
layers    : static 0 0 top (0.1$(comma)0.1$(comma)0.1$(comma) 0.1)\n\
\n\
[mmu_led_effect mmu_static_red_$(UNIT_NAME)]\n\
unit      : $(UNIT_NAME)\n\
define_on : gates$(comma) exit\n\
layers    : static 0 0 top (0.5$(comma)0.0$(comma)0.0)\n\
)"

  if BOARD_TYPE_SLB_1_0
    config PARAM_ENTRY_LEDS
      generated_default "neopixel:_$(UNIT_NAME)_gate%i_box (1)" "" "; " PARAM_NUM_GATES

    config PARAM_EXIT_LEDS
      generated_default "neopixel:_$(UNIT_NAME)_gate%i_leds (1,2,3,4)" "" "; " PARAM_NUM_GATES

  endif

  if BOARD_TYPE_EBB_GEN1
    config PARAM_CHAIN_COUNT
      default 5

    config PARAM_ENTRY_LEDS
      generated_default "neopixel:_$(UNIT_NAME)_gate%i_leds (5)" "" "; " PARAM_NUM_GATES

    config PARAM_EXIT_LEDS
      generated_default "neopixel:_$(UNIT_NAME)_gate%i_leds (1,2,3,4)" "" "; " PARAM_NUM_GATES
    
  endif

  comment "_"

endif 
```

## installer/mmu_types/Kconfig.htlf
```kconfig
config MMU_TYPE_HTLF_1_0
  bool "HTLF"
  help
    HappyTurtleLettuceFeeder (HTLF) is a 4 gate type-A MMU with
    rotary cam based selection mechanism controlled by stepper
  select ROTARY_SELECTOR
  select MMU_HAS_LEDS
  select PARAM_FILAMENT_ALWAYS_GRIPPED
  select PARAM_VARIABLE_ROTATION_DISTANCES


if MMU_TYPE_HTLF_1_0

  choice CHOICE_HTLF_CAM_ANGLE
    prompt "Cam lobe angle"
    default CHOICE_HTLF_CAM_ANGLE_60
    help
      The lobe angle of the printed cam. It sets the selector
      position of each gate (60 is the recommended print)

    config CHOICE_HTLF_CAM_ANGLE_30
      bool "30 degrees"
    config CHOICE_HTLF_CAM_ANGLE_45
      bool "45 degrees"
    config CHOICE_HTLF_CAM_ANGLE_60
      bool "60 degrees"

  endchoice

  # Selector rotation_distance is 360 so selector "mm" are cam degrees. Gate 0's lobe
  # engages 215 degrees from home and each later gate one cam angle closer
  config PARAM_CAD_GATE0_POS
    default "215"
  config PARAM_CAD_GATE_WIDTH
    default "-30" if CHOICE_HTLF_CAM_ANGLE_30
    default "-45" if CHOICE_HTLF_CAM_ANGLE_45
    default "-60"
  config PARAM_CAD_SELECTOR_TOLERANCE
    default "30" if CHOICE_HTLF_CAM_ANGLE_30
    default "45" if CHOICE_HTLF_CAM_ANGLE_45
    default "60"


  source "Kconfig.capabilities"

  config PARAM_VENDOR
    default "HTLF"
  config PARAM_VERSION
    default "1.0"

  config PARAM_NUM_GATES
    default 4
  config PARAM_DESIGN_NUM_GATES
    default 4

  # ----------------------------------------
  # Defaults
  # ----------------------------------------

  # Gear stepper ---------------------------
  config PARAM_GEAR_GEAR_RATIO
    default "1:1"
  config PARAM_GEAR_ROTATION_DISTANCE
    default 4.65
  config PARAM_GEAR_RUN_CURRENT
    default 0.8
  config PARAM_GEAR_HOLD_CURRENT
    default 0.1
  config PARAM_GEAR_MICROSTEPS
    default 16

  # Selector stepper -----------------------
  config PARAM_SELECTOR_GEAR_RATIO
    default "1:1"
  config PARAM_SELECTOR_ROTATION_DISTANCE
    default 360
  config PARAM_SELECTOR_RUN_CURRENT
    default 0.6
  config PARAM_SELECTOR_HOLD_CURRENT
    default 0.3

  config PARAM_SELECTOR_RELEASE_GATES
    default "1, 2, 3, 0"

  # Speeds ---------------------------------
  config PARAM_GEAR_LOAD_SPEED
    default 135
  config PARAM_GEAR_SHORT_MOVE_SPEED
    default 80
  config PARAM_SELECTOR_MOVE_SPEED
    default 562.5
  config PARAM_SELECTOR_HOMING_SPEED
    default 675
  config PARAM_SELECTOR_ACCEL
    default 562.5
  config PARAM_EXTRUDER_LOAD_SPEED
    default 16

  # Gate endstops and homing ---------------
  config PARAM_GATE_PARKING_DISTANCE
    default -25
  config PARAM_GATE_HOMING_MAX
    default 1000

  comment "_"

endif 
```

## installer/mmu_types/Kconfig.low_rider
```kconfig
config MMU_TYPE_LOW_RIDER_1_0
  bool "Low Rider"
  help
    This is a fork/variation of the great MMX design and uses 2-6 cams
    to select gates/lanes with a servo motor.
  select SERVO_SELECTOR
  imply  MMU_HAS_SENSOR_EXTRUDER
  select MMU_HAS_LEDS
  imply  PARAM_FILAMENT_ALWAYS_GRIPPED
  imply  PARAM_VARIABLE_ROTATION_DISTANCES

if MMU_TYPE_LOW_RIDER_1_0

  source "Kconfig.num_gates"
  source "servos/Kconfig"

  if SHOW_MMU_ADDITIONS_WITH_TYPE
    source "Kconfig.mmu_additions"
  endif

  source "Kconfig.capabilities"


  # -------------------------------------
  # Defaults
  # -------------------------------------

  # Identity -------------------------------
  config PARAM_VENDOR
    default "LowRider"
  config PARAM_VERSION
    default "1.0"
  config PARAM_NUM_GATES
    default 6

  # Gear stepper ---------------------------
  config PARAM_GEAR_ROTATION_DISTANCE
    default 23
  config PARAM_GEAR_GEAR_RATIO
    default "80:20"
  config PARAM_GEAR_FULL_STEPS_PER_ROTATION
    default 200
  config PARAM_GEAR_RUN_CURRENT
    default 0.7
  config PARAM_GEAR_HOLD_CURRENT
    default 0.1

  # Selector servo control -----------------
  choice CHOICE_SERVO_TYPE
    default SERVO_TYPE_DM996
  endchoice

  config PARAM_SERVO_DURATION
    default 0.6
  config PARAM_SERVO_DWELL
    default 1.0
  config PARAM_SERVO_ALWAYS_ACTIVE
    default 0
  config PARAM_SERVO_BYPASS_ANGLE
    default -1
  config PARAM_SERVO_RELEASE_ANGLE
    default 0
  config PARAM_SERVO_MAX_ANGLE
    default 180
  # Reserve 0 degrees for the release position, then distribute gates evenly
  # over the remaining selector travel up to 180 degrees.
  config PARAM_SERVO_GATE_ANGLES
    default "90, 180"                       if PARAM_NUM_GATES = 2
    default "60, 120, 180"                  if PARAM_NUM_GATES = 3
    default "45, 90, 135, 180"              if PARAM_NUM_GATES = 4
    default "36, 72, 108, 144, 180"         if PARAM_NUM_GATES = 5
    default "30, 60, 90, 120, 150, 180"     if PARAM_NUM_GATES = 6

  # Gate endstops and homing ---------------
  config PARAM_GATE_PARKING_DISTANCE
    default -25
  config PARAM_GATE_HOMING_MAX
    default 1000

  comment "_"

endif
```

## installer/mmu_types/Kconfig.night_owl
```kconfig
config MMU_TYPE_NIGHT_OWL_1_0
  bool "Night Owl"
  help
    Night Owl is type-B MMU similar to Box Turtle but without the
    active dc-motor respooler and often with just 2 gates. Instead
    of active respooler it uses a Filamentalist based design leveraging
    gear steppers for motion.
  select VIRTUAL_SELECTOR
  select MMU_HAS_LEDS
  imply  MMU_HAS_SENSOR_ENTRY
  imply  MMU_HAS_SENSOR_EXIT
  select PARAM_VARIABLE_ROTATION_DISTANCES
  select PARAM_FILAMENT_ALWAYS_GRIPPED
  select PARAM_SYNC_TO_EXTRUDER
  select PARAM_SYNC_FORM_TIP
  select PARAM_SYNC_PURGE

if MMU_TYPE_NIGHT_OWL_1_0

  choice CHOICE_TURTLE_NECK
    prompt "Turtle Neck"
    default CHOICE_TURTLE_NECK_V2

    config CHOICE_TURTLE_NECK_V1
      bool "Turtle Neck v1"
      help
        The v1 version is unsprung
      select MMU_HAS_SYNC_FEEDBACK_BUFFER
      select MMU_HAS_SENSOR_BUFFER_COMPRESSION
      select MMU_HAS_SENSOR_BUFFER_TENSION
      select UNSELECT_MMU_HAS_SENSOR_BUFFER_PROPORTIONAL

    config CHOICE_TURTLE_NECK_V2
      bool "Turtle Neck v2"
      help
        The v2 version has both filament tension and compression switches.
      select MMU_HAS_SYNC_FEEDBACK_BUFFER
      select MMU_HAS_SENSOR_BUFFER_COMPRESSION
      select MMU_HAS_SENSOR_BUFFER_TENSION
      select UNSELECT_MMU_HAS_SENSOR_BUFFER_PROPORTIONAL

    config CHOICE_TURTLE_NECK_OTHER
      bool "Other"
      help
        Select if you use another type of sync-feedback buffer
        including the new proportional types
      select MMU_HAS_SYNC_FEEDBACK_BUFFER

  endchoice

  if CHOICE_TURTLE_NECK_V1 || CHOICE_TURTLE_NECK_V2
    choice CHOICE_BUFFER_SPRING_STATE
      default CHOICE_BUFFER_SPRING_STATE_TENSION if CHOICE_TURTLE_NECK_V2
      default CHOICE_BUFFER_SPRING_STATE_NONE    if CHOICE_TURTLE_NECK_V1
    endchoice

    config PARAM_BUFFER_RANGE
      default 8
    config PARAM_BUFFER_MAXRANGE
      default 12
  endif

  if SHOW_MMU_ADDITIONS_WITH_TYPE
    source "Kconfig.mmu_additions"
  endif

  source "Kconfig.capabilities"


  # -------------------------------------
  # Defaults
  # -------------------------------------

  config PARAM_VENDOR
    default "NightOwl"
  config PARAM_VERSION
    default "1.0"
  config PARAM_NUM_GATES
    default 2
  choice BOARD_TYPE
    default BOARD_TYPE_OWLFC_MINI_1_0
  endchoice

  # Gear stepper ---------------------------
  config PARAM_GEAR_GEAR_RATIO
    default "50:10"
  config PARAM_GEAR_RUN_CURRENT
    default 0.7
  config PARAM_GEAR_HOLD_CURRENT
    default 0.1

  config PARAM_SYNC_GEAR_CURRENT
    default 70

  # Gate endstops and homing ---------------
  config PARAM_GATE_HOMING_MAX
    default 300
  config PARAM_GATE_PARKING_DISTANCE
    default -100

  config PARAM_GATE_PRELOAD_HOMING_MAX
    default 200
  config PARAM_GATE_PRELOAD_PARKING_DISTANCE
    default 10

  config PARAM_GATE_FINAL_EJECT_DISTANCE
    default 300

  # NFC reader setup (if fitted) -----------
  config PARAM_NFC_GATE_JOG_SCAN_WINDOW
    default "0, 480"
  config PARAM_NFC_PRELOAD_JOG_SCAN_WINDOW
    default "0, 480"
  config PARAM_NFC_GATE_CLEAR_DISTANCE
    default -70
  config PARAM_NFC_PRELOAD_CLEAR_DISTANCE
    default 70
  config PARAM_NFC_NEIGHBOR_CHECK
    default y

  comment "_"

endif 
```
