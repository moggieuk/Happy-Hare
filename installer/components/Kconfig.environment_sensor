## installer/connection/Kconfig.mmu_mcu
```kconfig
# Module sets the serial connection tokens
# Make the first 10 available serial tty devices selectable, it's unlikely people have more.
#
# Responsible for setting:
#   CHOICE_MMU_CONNECTION_TYPE_SERIAL
#   CHOICE_MMU_CONNECTION_TYPE_CANBUS
#   PARAM_MMU_SERIAL_DEVICE
#   PARAM_MMU_CANBUS_UUID
#
# If F_PER_GATE_MCU (EMU design) the special inclusion macro
# will include the extra Kconfig logic. This is relatively expensive
# so it is not normally included. Additional params will be set:
#   PARAM_MMU_SERIAL_DEVICE_<gate>
#   PARAM_MMU_CANBUS_UUID_<gate>


choice CHOICE_MMU_CONNECTION_TYPE
  prompt "MCU connection"
  default CHOICE_MMU_CONNECTION_TYPE_SERIAL
  help 
    Choose the type of mcu connection for the MMU
    Serial or CANbus

  config CHOICE_MMU_CONNECTION_TYPE_SERIAL
    bool "Serial"
    help
      Select if your MMU connects via a serial connection to mcu board

  config CHOICE_MMU_CONNECTION_TYPE_CANBUS
    bool "CANbus"
    help
      Select if your MMU connects with a CANbus connection to mcu board

endchoice

# PAUL TODO add chip as filter for serial devices

# -------------------------------------
# Single MCU
# -------------------------------------

if !MMU_HAS_PER_GATE_MCU

  if CHOICE_MMU_CONNECTION_TYPE_SERIAL

    choice CHOICE_MMU_SERIAL_CONNECTION
      prompt "Select serial device for MMU"
      default CHOICE_MMU_SERIAL_DEVICE_PREVIOUS if "$(saved-config-value,PARAM_MMU_SERIAL_DEVICE)" != ""
      default CHOICE_MMU_SERIAL_DEVICE_OTHER if !$(serial_exists,1)

      config CHOICE_MMU_SERIAL_DEVICE_PREVIOUS
        bool "Previous selection: $(saved-config-value,PARAM_MMU_SERIAL_DEVICE)"
        depends on "$(saved-config-value,PARAM_MMU_SERIAL_DEVICE)" != ""

      @repeat var=i min=1 max=10@
      config $(mmu_serial_config,$(i))
        bool "$(serial_device,$(i))"
        depends on $(serial_exists,$(i))
      @endrepeat@

      config CHOICE_MMU_SERIAL_DEVICE_OTHER
        bool "Other / manually entered"

      if CHOICE_MMU_SERIAL_DEVICE_OTHER
        config MMU_SERIAL_DEVICE_OTHER
          string "Enter serial device path"
          default "-enter-device-path-"
      endif
    endchoice

    config PARAM_MMU_SERIAL_DEVICE
      string
      default "$(saved-config-value,PARAM_MMU_SERIAL_DEVICE)" if CHOICE_MMU_SERIAL_DEVICE_PREVIOUS
      @repeat var=i min=1 max=10@
      default "$(serial_device,$(i))" if $(mmu_serial_config,$(i))
      @endrepeat@
      default MMU_SERIAL_DEVICE_OTHER if CHOICE_MMU_SERIAL_DEVICE_OTHER

  endif

  if CHOICE_MMU_CONNECTION_TYPE_CANBUS

    choice CHOICE_MMU_CANBUS_CONNECTION
      prompt "Select canbus UUID for MMU"
      default CHOICE_MMU_CANBUS_UUID_PREVIOUS if "$(saved-config-value,PARAM_MMU_CANBUS_UUID)" != ""
      default CHOICE_MMU_CANBUS_UUID_OTHER if $(canbus_uuid_count) = 0

      config CHOICE_MMU_CANBUS_UUID_PREVIOUS
        bool "Previous selection: $(saved-config-value,PARAM_MMU_CANBUS_UUID)"
        depends on "$(saved-config-value,PARAM_MMU_CANBUS_UUID)" != ""

      @repeat var=i min=1 max=10@
      config $(mmu_canbus_config,$(i))
        bool "$(canbus_uuid,$(i))"
        depends on $(canbus_uuid_count) >= $(i)
      @endrepeat@

      config CHOICE_MMU_CANBUS_UUID_OTHER
        bool "Other / manually entered"

      if CHOICE_MMU_CANBUS_UUID_OTHER
        config MMU_CANBUS_UUID_OTHER
          string "Enter CANbus uuid"
          default "-enter-canbus-id-"
      endif
    endchoice

    config PARAM_MMU_CANBUS_UUID
      string
      default "$(saved-config-value,PARAM_MMU_CANBUS_UUID)" if CHOICE_MMU_CANBUS_UUID_PREVIOUS
      @repeat var=i min=1 max=10@
      default "$(canbus_uuid,$(i))" if $(mmu_canbus_config,$(i))
      @endrepeat@
      default MMU_CANBUS_UUID_OTHER if CHOICE_MMU_CANBUS_UUID_OTHER

  endif

endif

# -------------------------------------
# Pre-Gate MCU's
# This section is ONLY pre-processed if
# PER_GATE_MCU environment varible is
# y/yes/1/true becuase it is expensive!
# -------------------------------------

@if F_PER_GATE_MCU@
if MMU_HAS_PER_GATE_MCU

  @repeat var=gate min=0 max=9@
  if PARAM_NUM_GATES > $(gate)

    if CHOICE_MMU_CONNECTION_TYPE_SERIAL

      choice CHOICE_MMU_SERIAL_CONNECTION_$(gate)
        prompt "Select serial device for MMU gate $(gate)"
        default CHOICE_MMU_SERIAL_DEVICE_PREVIOUS_$(gate) if "$(saved-config-value,PARAM_MMU_SERIAL_DEVICE_$(gate))" != ""
        default CHOICE_MMU_SERIAL_DEVICE_OTHER_$(gate) if !$(serial_exists,1)

        config CHOICE_MMU_SERIAL_DEVICE_PREVIOUS_$(gate)
          bool "Previous selection: $(saved-config-value,PARAM_MMU_SERIAL_DEVICE_$(gate))"
          depends on "$(saved-config-value,PARAM_MMU_SERIAL_DEVICE_$(gate))" != ""

        @repeat var=i min=1 max=10@
        config CHOICE_MMU_SERIAL_DEVICE_$(gate)_$(i)
          bool "$(serial_device,$(i))"
          depends on $(serial_exists,$(i))
        @endrepeat@

        config CHOICE_MMU_SERIAL_DEVICE_OTHER_$(gate)
          bool "Other / manually entered"

        if CHOICE_MMU_SERIAL_DEVICE_OTHER_$(gate)
          config MMU_SERIAL_DEVICE_OTHER_$(gate)
            string "Enter serial device path"
            default "-enter-device-path-"
        endif
      endchoice

      config PARAM_MMU_SERIAL_DEVICE_$(gate)
        string
        default "$(saved-config-value,PARAM_MMU_SERIAL_DEVICE_$(gate))" if CHOICE_MMU_SERIAL_DEVICE_PREVIOUS_$(gate)
        @repeat var=i min=1 max=10@
        default "$(serial_device,$(i))" if CHOICE_MMU_SERIAL_DEVICE_$(gate)_$(i)
        @endrepeat@
        default MMU_SERIAL_DEVICE_OTHER_$(gate) if CHOICE_MMU_SERIAL_DEVICE_OTHER_$(gate)

    endif

    if CHOICE_MMU_CONNECTION_TYPE_CANBUS

      choice CHOICE_MMU_CANBUS_CONNECTION_$(gate)
        prompt "Select canbus UUID for MMU gate $(gate)"
        default CHOICE_MMU_CANBUS_UUID_PREVIOUS_$(gate) if "$(saved-config-value,PARAM_MMU_CANBUS_UUID_$(gate))" != ""
        default CHOICE_MMU_CANBUS_UUID_OTHER_$(gate) if $(canbus_uuid_count) = 0

        config CHOICE_MMU_CANBUS_UUID_PREVIOUS_$(gate)
          bool "Previous selection: $(saved-config-value,PARAM_MMU_CANBUS_UUID_$(gate))"
          depends on "$(saved-config-value,PARAM_MMU_CANBUS_UUID_$(gate))" != ""

        @repeat var=i min=1 max=10@
        config CHOICE_MMU_CANBUS_UUID_$(gate)_$(i)
          bool "$(canbus_uuid,$(i))"
          depends on $(canbus_uuid_count) >= $(i)
        @endrepeat@

        config CHOICE_MMU_CANBUS_UUID_OTHER_$(gate)
          bool "Other / manually entered"

        if CHOICE_MMU_CANBUS_UUID_OTHER_$(gate)
          config MMU_CANBUS_UUID_OTHER_$(gate)
            string "Enter CANbus uuid"
            default "-enter-canbus-id-"
        endif
      endchoice

      config PARAM_MMU_CANBUS_UUID_$(gate)
        string
        default "$(saved-config-value,PARAM_MMU_CANBUS_UUID_$(gate))" if CHOICE_MMU_CANBUS_UUID_PREVIOUS_$(gate)
        @repeat var=i min=1 max=10@
        default "$(canbus_uuid,$(i))" if CHOICE_MMU_CANBUS_UUID_$(gate)_$(i)
        @endrepeat@
        default MMU_CANBUS_UUID_OTHER_$(gate) if CHOICE_MMU_CANBUS_UUID_OTHER_$(gate)

    endif

  endif
  @endrepeat@

endif
@endif@
```

## installer/macro_vars/Kconfig
```kconfig
# Assemble all marco configuration
#
# Also responsible for setting:
#   PARAM_MACRO_TOOLHEAD_MAX_ACCEL
#   PARAM_MACRO_TOOLHEAD_MIN_CRUISE_RATIO

menu "Macro Variables"
  help
    Configure settings for Happy Hare klipper macros.

  rsource "Kconfig.software"
  rsource "Kconfig.state"
  rsource "Kconfig.sequence"
  rsource "Kconfig.client"

  comment "_"
  comment "_Tip Forming/Cutting"
  rsource "Kconfig.form_tip"
  rsource "Kconfig.cut_tip"
  rsource "Kconfig.servo_cutter"

  comment "_"
  comment "_Purging"
  rsource "Kconfig.blobifier"
  rsource "Kconfig.purge"


# -------------------------------------
# Toolhead Control
# -------------------------------------

  comment "_"
  comment "_Toolhead Control"

  config PARAM_MACRO_TOOLHEAD_MAX_ACCEL
    float "Macro toolhead max acceleration"
    default 0
    help
      Default printer toolhead acceleration applied when macros are run for user customization and
      parking moves (the previous value is automatically restored afterwards). 0 = use printer max

  config PARAM_MACRO_TOOLHEAD_MIN_CRUISE_RATIO
    float "Macro toolhead min cruise ratio"
    default 0.5
    help
      Default printer cruise ratio applied when macros are run

endmenu
```

## installer/macro_vars/Kconfig.client
```kconfig
menu "Client macros        (_MMU_CLIENT)"
  depends on INSTALL_CLIENT_MACROS
  forceshow
  help
    Happy Hare client macro configuration variables.

    Supplemental customization and extension points for the recommended
    PAUSE, RESUME, and CANCEL_PRINT macros.

    (if disabled but desired, select "install default client macros" option
     under "Software Options --->" menu)

  config BOOL_CLIENT_RESET_TTG_ON_CANCEL
    bool "Reset TTG map on cancel"
    default n
    help
      Whether to reset TTG map if print is canceled.

  config VAR_CLIENT_RESET_TTG_ON_CANCEL
    string
    default "True" if BOOL_CLIENT_RESET_TTG_ON_CANCEL
    default "False"

  config BOOL_CLIENT_UNLOAD_TOOL_ON_CANCEL
    bool "Unload tool on cancel"
    default n
    help
      Whether to unload the tool on cancel.

  config VAR_CLIENT_UNLOAD_TOOL_ON_CANCEL
    string
    default "True" if BOOL_CLIENT_UNLOAD_TOOL_ON_CANCEL
    default "False"

  config VAR_CLIENT_USER_PAUSE_EXTENSION
    string "Pause extension macro "
    default ""
    help
      Executed after the Klipper base pause.
      Enter G-code without surrounding quotes.

  config VAR_CLIENT_USER_RESUME_EXTENSION
    string "Resume extension macro"
    default ""
    help
      Executed before the Klipper base resume.
      Enter G-code without surrounding quotes.

  config VAR_CLIENT_USER_CANCEL_EXTENSION
    string "Cancel extension macro"
    default ""
    help
      Executed before the Klipper base cancel_print.
      Enter G-code without surrounding quotes.

endmenu
```

## installer/macro_vars/Kconfig.vent
```kconfig
menu "Enclosure venting  (_MMU_VENT)"
  help
    Happy Hare enclosure venting macro configuration variables.

    The drying cycle calls heater_vent_macro (_MMU_VENT by default) every
    heater_vent_interval minutes. If the unit has a vent servo (MMU
    Features / Additions) the macro opens it, optionally runs the unit's
    managed fan, and closes the vent again after the vent time. Without a
    vent servo the macro only logs.

  comment "_"
  comment "_Vent servo"

  config VAR_VENT_SERVO_OPEN_ANGLE
    float "Servo open angle          "
    default 90
    help
      Vent servo angle with the vent open.

  config VAR_VENT_SERVO_CLOSED_ANGLE
    float "Servo closed angle        "
    default 0
    help
      Vent servo angle with the vent closed.

  config VAR_VENT_SERVO_DURATION
    float "Servo pulse duration (s)  "
    default 1.0
    help
      Duration in seconds of the PWM pulse train used to move the servo.
      The signal then stops so the servo doesn't jitter while held.

  comment "_"
  comment "_Venting"

  config VAR_VENT_DURATION
    float "Vent open time (s)        "
    default 10
    help
      How long the vent stays open each time it is opened.

  config VAR_VENT_RUN_FAN
    boolint "Run managed fan while open"
    default 1
    help
      Force the unit's managed fan on while the vent is open, then restore
      the mode it was in. Has no effect without a managed fan.

endmenu
```

## installer/mmu_types/Kconfig.box_turtle
```kconfig
config MMU_TYPE_BOX_TURTLE_1_0
  bool "Box Turtle"
  help
    Box Turtle is typically a 4 gate type-B MMU/AFC with separate
    gear steppers for each gate and utilizes a DC motor for respooling
    and optionally assisting spool movement. Build options include TurtleNeck
    "buffer" which provides feedback of filament compression/tension.
  select VIRTUAL_SELECTOR
  select MMU_HAS_ESPOOLER
  select MMU_HAS_LEDS
  imply  MMU_HAS_SENSOR_ENTRY
  imply  MMU_HAS_SENSOR_EXIT
  imply  MMU_HAS_SENSOR_SHARED_EXIT
  select PARAM_VARIABLE_ROTATION_DISTANCES
  select PARAM_VARIABLE_BOWDEN_LENGTHS
  select PARAM_REQUIRE_BOWDEN_MOVE
  select PARAM_FILAMENT_ALWAYS_GRIPPED
  select PARAM_SYNC_TO_EXTRUDER
  select PARAM_SYNC_FORM_TIP
  select PARAM_SYNC_PURGE
  select DISABLE_NUM_GATES_OPTION
  select UNSELECT_MMU_HAS_FILAMENT_BUFFER # Disable


if MMU_TYPE_BOX_TURTLE_1_0

  choice CHOICE_TURTLE_NECK
    prompt "Turtle Neck"
    default CHOICE_TURTLE_NECK_V2

    config CHOICE_TURTLE_NECK_V1
      bool "Turtle Neck v1"
      help
        The v1 version is unsprung
      select MMU_HAS_SYNC_FEEDBACK_BUFFER
      select MMU_HAS_SENSOR_BUFFER_COMPRESSION
      select MMU_HAS_SENSOR_BUFFER_TENSION
      select UNSELECT_MMU_HAS_SENSOR_BUFFER_PROPORTIONAL

    config CHOICE_TURTLE_NECK_V2
      bool "Turtle Neck v2"
      help
        The v2 version has both filament tension and compression switches.
      select MMU_HAS_SYNC_FEEDBACK_BUFFER
      select MMU_HAS_SENSOR_BUFFER_COMPRESSION
      select MMU_HAS_SENSOR_BUFFER_TENSION
      select UNSELECT_MMU_HAS_SENSOR_BUFFER_PROPORTIONAL

    config CHOICE_TURTLE_NECK_OTHER
      bool "Other"
      help
        Select if you use another type of sync-feedback buffer
        including the new proportional types
      select MMU_HAS_SYNC_FEEDBACK_BUFFER

  endchoice

  if CHOICE_TURTLE_NECK_V1 || CHOICE_TURTLE_NECK_V2
    choice CHOICE_BUFFER_SPRING_STATE
      default CHOICE_BUFFER_SPRING_STATE_TENSION if CHOICE_TURTLE_NECK_V2
      default CHOICE_BUFFER_SPRING_STATE_NONE    if CHOICE_TURTLE_NECK_V1
    endchoice

    config PARAM_BUFFER_RANGE
      default 8
    config PARAM_BUFFER_MAXRANGE
      default 12
  endif

  if SHOW_MMU_ADDITIONS_WITH_TYPE
    source "Kconfig.mmu_additions"
  endif

  source "Kconfig.capabilities"


  ####################
  ##### Defaults #####
  ####################

  config PARAM_VENDOR
    default "BoxTurtle"
  config PARAM_VERSION
    default "1.0"  
  config PARAM_NUM_GATES
    default 4
  choice BOARD_TYPE
    default BOARD_TYPE_AFC_LITE_1_0
  endchoice

  config PARAM_GEAR_GEAR_RATIO
    default "50:10"
  config PARAM_GEAR_RUN_CURRENT
    default 0.7
  config PARAM_GEAR_HOLD_CURRENT
    default 0.1

  config PARAM_GATE_HOMING_MAX
    default 300
  config PARAM_GATE_PRELOAD_HOMING_MAX
    default 200
  config PARAM_GATE_PARKING_DISTANCE
    default -100
  config PARAM_GATE_FINAL_EJECT_DISTANCE
    default 100

  comment "_"

endif 
```
