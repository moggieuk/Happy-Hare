## installer/Kconfig.td1
```kconfig
# TD-1 filament measurement (transmission distance + measured color)
#
# Unlike NFC readers, TD-1 scanners are USB devices owned by Moonraker's [td1] component,
# not Klipper MCU peripherals - no pins, no bus settings, no klipper section to create.
# All that is collected here is the USB serial number.
#
# Responsible for setting:
#
# MMU_HAS_TD1
# MMU_HAS_PER_GATE_TD1
# MMU_HAS_OFFPATH_TD1
#
# In-path, one scanner in the shared bowden (rendered as one entry per gate):
#   PARAM_TD1_BOWDEN_DEVICE
#
# In-path, per-gate:
#   PARAM_TD1_DEVICE_$(i)       (one USB serial per gate, blank for none)
#   PARAM_TD1_DEVICE_GATE_$(i)  (presentation only: collapses a gate's serial prompt)
#
# Off-path (presented to by hand; readings are staged as pending):
#   PARAM_TD1_DEVICE
#
# Capture policy (rendered into [mmu_unit_parameters] in mmu_parameters.cfg):
#   PARAM_TD1_AUTO_UPDATE
#   PARAM_TD1_CAPTURE_ON_LOAD
#   PARAM_TD1_CAPTURE_TIMEOUT
#   PARAM_TD1_LED_SEGMENT       (from CHOICE_TD1_LED_SEGMENT)
#
# Can be disabled and forced off with:
#   select UNSELECT_MMU_HAS_TD1
#


comment "_"
comment "_TD-1 [[B]](BETA)[[/B]]"

config UNSELECT_MMU_HAS_TD1
  def_bool n

if !UNSELECT_MMU_HAS_TD1
  config MMU_HAS_TD1
    bool "Has TD-1 scanner(s)?"
    forceshow
    default n
    help
      Capture filament transmission distance (TD) and measured RGB color using
      Moonraker's [td1] component. The scanner plugs into a host USB port - no MCU
      pins are needed.

      Add [td1] to moonraker.conf and restart Moonraker, then read the serials from
      the /machine/td1/data endpoint. Hardware need not be connected to configure
      this. Gates are measured on demand with MMU_CHECK_GATE TD1=1.
endif


# ------------------------------------
# TD-1 scanner config
# ------------------------------------

if MMU_HAS_TD1

  menu "TD-1 scanner config"

    # ------------------------------------------
    # Off-path: filament is presented by hand
    # ------------------------------------------

    config MMU_HAS_OFFPATH_TD1
      bool "Separate scanner to present filament to?"
      default n
      help
        A scanner sitting off the filament path - on the bench, or beside the spools.
        You present filament to it by hand and the reading is held for the next gate
        you preload, exactly like presenting a tag to a shared NFC reader.

        Independent of the in-path scanners below; a machine may have both.

    if MMU_HAS_OFFPATH_TD1
      config PARAM_TD1_DEVICE
        string "Off-path TD-1 USB serial       "
        default ""
        help
          USB serial number of the scanner you present filament to, exactly as
          Moonraker reports it. E.g. "TD1-0099".
    endif

    # ------------------------------------------
    # In-path: filament crosses the scanner
    # ------------------------------------------

    config MMU_HAS_PER_GATE_TD1
      bool "Per-gate TD-1 scanners?"
      default n
      help
        Most designs have a single scanner in a shared part of the bowden, serving
        every gate. Select this only if each gate has its own separate scanner.

    if !MMU_HAS_PER_GATE_TD1
      config PARAM_TD1_BOWDEN_DEVICE
        string "Shared bowden TD-1 USB serial  "
        default ""
        help
          USB serial number of the scanner in the shared bowden path, exactly as
          Moonraker reports it. E.g. "TD1-0042". Leave blank if there is none.

          Rendered as one entry per gate, since that is what it is: every gate's
          filament crosses it.
    endif

    if MMU_HAS_PER_GATE_TD1
      @repeat var=i min=0 max=11@
        if PARAM_NUM_GATES > $(i)

          config PARAM_TD1_DEVICE_$(i)
            string

          menuconfig PARAM_TD1_DEVICE_GATE_$(i)
            bool "Gate $(i) TD-1 scanner"
            default y
            help
              Deselect for a gate that has no scanner of its own.

          if PARAM_TD1_DEVICE_GATE_$(i)
            config PARAM_TD1_DEVICE_$(i)
              string "Gate $(i) USB serial       "
              default ""
              help
                USB serial number of this gate's scanner, exactly as Moonraker reports
                it. Repeat a serial to share one physical scanner between gates.
          endif

        endif
      @endrepeat@
    endif # per gate

  endmenu


  # -------------------------------------
  # TD-1 related params
  # -------------------------------------

  menu "TD-1 params"

    config PARAM_TD1_AUTO_UPDATE
      boolint "Apply new readings automatically?"
      default n
      help
        Update measured TD and color whenever a new reading arrives and Happy Hare knows
        which filament owns the path. This never moves filament.

        Set per unit, so units sharing one scanner need not agree.

    config PARAM_TD1_CAPTURE_ON_LOAD
      boolint "Wait for a reading when loading?"
      default n
      help
        Wait briefly for a fresh reading after a normal load completes, rather than
        relying on it arriving by itself. Skipped while printing, so tool changes are
        never delayed.

        Needs an in-path scanner. Filament crosses one during any normal load, so this
        costs no extra movement - only the wait.

    config PARAM_TD1_CAPTURE_TIMEOUT
      string "Measurement wait (secs)  "
      default "5"
      help
        How long to wait for a fresh reading once filament has passed the scanner. The
        device takes a moment to report, so a second or two is normal.

        Only applies where Happy Hare actually waits: MMU_CHECK_GATE TD1=1 and the
        capture-on-load option above. Automatic updates never wait.

    choice CHOICE_TD1_LED_SEGMENT
      prompt "TD-1 led feedback segment"
      help
        TD-1 transient LED feedback: which segment the measured/failed effects render on.
        auto = 'status' for an off-path scanner, 'exit' for a per-gate one.
      default CHOICE_TD1_LED_SEGMENT_AUTO

      config CHOICE_TD1_LED_SEGMENT_AUTO
        bool "Auto"
        help
          Auto: 'status' for an off-path scanner, 'exit' for a per-gate one

      config CHOICE_TD1_LED_SEGMENT_STATUS
        bool "Status"

      config CHOICE_TD1_LED_SEGMENT_EXIT
        bool "Exit"

      config CHOICE_TD1_LED_SEGMENT_ENTRY
        bool "Entry"

    endchoice

    # Create no-prompt param from choice
    config PARAM_TD1_LED_SEGMENT
      string
      default "auto"   if CHOICE_TD1_LED_SEGMENT_AUTO
      default "status" if CHOICE_TD1_LED_SEGMENT_STATUS
      default "exit"   if CHOICE_TD1_LED_SEGMENT_EXIT
      default "entry"  if CHOICE_TD1_LED_SEGMENT_ENTRY

  endmenu
endif
```

## installer/Kconfig.tip_shaping
```kconfig
# Defines parameter token types and defaults for tip forming/cutting
#
# Responsible for defining/setting:
#   MMU_HAS_GANTRY_BUMPER_SERVO (and PIN_GANTRY_BUMPER_SERVO)
#   MMU_HAS_SERVO_CUTTER        (and PIN_SERVO_CUTTER_SERVO)
#   PARAM_GANTRY_SERVO_MAXIMUM_ANGLE
#   PARAM_GANTRY_SERVO_MIN_PULSE_WIDTH
#   PARAM_GANTRY_SERVO_MAX_PULSE_WIDTH
#   PARAM_GANTRY_SERVO_INITIAL_ANGLE
#   PARAM_SERVO_CUTTER_MAXIMUM_ANGLE
#   PARAM_SERVO_CUTTER_MIN_PULSE_WIDTH
#   PARAM_SERVO_CUTTER_MAX_PULSE_WIDTH
#
# Responsible for setting:
#   PARAM_FORCE_FORM_TIP_STANDALONE
#   PARAM_SLICER_TIP_PARK_POS
#   PARAM_FORCE_PURGE_STANDALONE
#   PARAM_FORM_TIP_MACRO

config MMU_HAS_GANTRY_BUMPER_SERVO
  def_bool n

config PIN_GANTRY_BUMPER_SERVO
  string
  default ""

# Defaults here, outside any if, so they hold while the prompts are hidden
config PARAM_GANTRY_SERVO_MAXIMUM_ANGLE
  int
  range 1 360
  default 180

config PARAM_GANTRY_SERVO_MIN_PULSE_WIDTH
  float
  default 0.00075

config PARAM_GANTRY_SERVO_MAX_PULSE_WIDTH
  float
  default 0.00225

config PARAM_GANTRY_SERVO_INITIAL_ANGLE
  int
  range 0 360
  default 180

config MMU_HAS_SERVO_CUTTER
  def_bool n

config PIN_SERVO_CUTTER_SERVO
  string
  default ""

config PARAM_SERVO_CUTTER_MAXIMUM_ANGLE
  int
  range 1 360
  default 180

config PARAM_SERVO_CUTTER_MIN_PULSE_WIDTH
  float
  default 0.0005

config PARAM_SERVO_CUTTER_MAX_PULSE_WIDTH
  float
  default 0.0025


menu "Tip Forming / Cutting"
  help
    Tip Shaping

# -------------------------------------
# Servo cutter configuration
# -------------------------------------

  config MMU_HAS_SERVO_CUTTER
    prompt "Have servo cutter at MMU?"
    help
      Enable this if you have a servo based cutter at your MMU

      NOTE: After enabling this be sure to edit Macro variables

  if MMU_HAS_SERVO_CUTTER

    config PIN_SERVO_CUTTER_SERVO
      prompt "Cutting servo pin                  "
      validator "$(pin_validator)"
      help
        $(pin_help)

    config PARAM_SERVO_CUTTER_MAXIMUM_ANGLE
      prompt "Cutting servo h/w max angle        "
      help
        Klipper scales the PWM pulse width to never exceed this angle.
        Set this to 60 for a 60 degree servo

    config PARAM_SERVO_CUTTER_MIN_PULSE_WIDTH
      prompt "Cutting servo min pulse width      "
      help
        Adapt for your servo

    config PARAM_SERVO_CUTTER_MAX_PULSE_WIDTH
      prompt "Cutting servo max pulse width      "
      help
        Adapt for your servo

  endif


# -------------------------------------
# Standalone tip forming choice
# -------------------------------------

  comment "_"
  comment "_Essential tip forming configuration"

  choice CHOICE_FORM_TIP_MACRO
    bool "Select standalone tip shaping option"
    default CHOICE_FORM_TIP_MACRO_CUT_TIP if MMU_HAS_TOOLHEAD_CUTTER
    default CHOICE_FORM_TIP_MACRO_FORM_TIP
    help
      How to perform standalone tip shaping (forming or cutting)

    config CHOICE_FORM_TIP_MACRO_FORM_TIP
      bool "Tip shaping using filament movement"
      help
        Uses repeated retract/extrude operations to shape filament
        tip into a torpedo shape without strings.
        Needs careful tuning.

    config CHOICE_FORM_TIP_MACRO_CUT_TIP
      bool "Tip cutting using toolhead cutter"
      depends on MMU_HAS_TOOLHEAD_CUTTER
      help
        If toolhead contains a filament cutter with activation
        via toolhead movement.

    config CHOICE_FORM_TIP_MACRO_SLICER
      bool "Slicer controlled tip forming"
      help
        Tip forming is controlled and managed by the slicer rather than Happy Hare.

    config CHOICE_FORM_TIP_MACRO_OTHER
      bool "Other / manually entered macro"
      help
        Specify a custom macro to call to perform tip forming / cutting

    config FORM_TIP_MACRO_OTHER
      string "Tip forming/cutting  macro" if CHOICE_FORM_TIP_MACRO_OTHER
      default "-enter-your-macro-"
      help
        Name of macro to call to perform the tip forming or cutting operation.
  endchoice

  config PARAM_FORM_TIP_MACRO
    string
    default "_MMU_FORM_TIP" if CHOICE_FORM_TIP_MACRO_FORM_TIP
    default "_MMU_CUT_TIP" if CHOICE_FORM_TIP_MACRO_CUT_TIP
    default ""                if CHOICE_FORM_TIP_MACRO_SLICER
    default FORM_TIP_MACRO_OTHER if CHOICE_FORM_TIP_MACRO_OTHER
    default ""


# -------------------------------------
# Toolhead cutter configuration
# -------------------------------------

  if CHOICE_FORM_TIP_MACRO_CUT_TIP

    config MMU_HAS_GANTRY_BUMPER_SERVO
      prompt "Have servo operated gantry bumper?"
      default n

    config PIN_GANTRY_BUMPER_SERVO
      prompt "Gantry servo pin" if MMU_HAS_GANTRY_BUMPER_SERVO
      validator "$(pin_validator)"
      help
        Optional. Used to deploy fold-down "bumper" for tip cutting
        when using a toolhead mounted filament cutting blade

    if MMU_HAS_GANTRY_BUMPER_SERVO
      config PARAM_GANTRY_SERVO_MAXIMUM_ANGLE
        prompt "Gantry servo h/w max angle         "
        help
          Klipper scales the PWM pulse width to never exceed this angle

      config PARAM_GANTRY_SERVO_MIN_PULSE_WIDTH
        prompt "Gantry servo min pulse width       "

      config PARAM_GANTRY_SERVO_MAX_PULSE_WIDTH
        prompt "Gantry servo max pulse width       "

      config PARAM_GANTRY_SERVO_INITIAL_ANGLE
        prompt "Gantry servo initial angle         "
        help
          Angle set at Klipper startup. Normally the retracted position:
          match "Gantry servo up angle" under
          Macro Variables -> Toolhead tip cutting
    endif
  endif


# -------------------------------------
# Other tip shaping options
# -------------------------------------

  config PARAM_FORCE_FORM_TIP_STANDALONE
    boolint "Happy Hare controlled in-print tip forming/cutting"
    default 0 if CHOICE_FORM_TIP_MACRO_SLICER
    default 1
    help
      You can choose whether you want the slicer or Happy Hare (recommended) to control tip forming.
      To use tip cutting ensure this selection is checked and be sure to turn off in your slicer
  config PARAM_SLICER_TIP_PARK_POS
    string
    default "0"
  config PARAM_SLICER_TIP_PARK_POS
    prompt "Slicer tip park pos"
    depends on !PARAM_FORCE_FORM_TIP_STANDALONE
    help
      This specifies the position of filament in extruder after slicer completes tip forming
      and is usually a setting in the slicer config.
      (It is necessary to help Happy Hare complete the extruder unloading process)

  config PARAM_EXTRUDER_FORM_TIP_CURRENT
    int "Extruder tip forming current"
    default 100
    help
      % of extruder current (100%-150%) to use when forming tip (100 to disable feature)

endmenu
```
