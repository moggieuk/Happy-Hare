## installer/boards/per_gate/Kconfig.slb
```kconfig
config BOARD_TYPE_SLB_1_0
  bool "SLB MCU"

if BOARD_TYPE_SLB_1_0
  config PARAM_BOARD_TYPE
    default "SLB v1"

  choice CHOICE_MMU_CONNECTION_TYPE
    default CHOICE_MMU_CONNECTION_TYPE_CANBUS
  endchoice
  choice CHOICE_MMU_SERIAL_CONNECTION
    default $(mmu_serial_config,1,stm32)
  endchoice


# -------------------------------------
# Regular use
# -------------------------------------

  if !MMU_HAS_PER_GATE_MCU

    config PIN_GEAR_UART
      default "$(MCU_NAME):PB6"
    config PIN_GEAR_STEP
      default "$(MCU_NAME):PB5"
    config PIN_GEAR_DIR
      default "$(MCU_NAME):PB4"
    config PIN_GEAR_ENABLE
      default "!$(MCU_NAME):PB7"
    config PIN_GEAR_DIAG
      default ""

    config PIN_ENTRY_SENSOR_0
      default "^(MCU_NAME):PA1"

    config PIN_EXIT_SENSOR_0
      default "^(MCU_NAME):PA0"

    config PIN_EJECT_BUTTON_0
      default "^!$(MCU_NAME):PB2"

    config PIN_NEOPIXEL
      default "$(MCU_NAME):PA4"

    config PIN_NEOPIXEL_BOX
      string
      default "$(MCU_NAME):PA2"

    config PIN_FAN
      default "$(MCU_NAME):PA15"

    config PIN_BUFFER_TENSION
      default "^$(MCU_NAME):PB1"
    config PIN_BUFFER_COMPRESSION
      default "^$(MCU_NAME):PB0"

    if OPTION_PSF_BUFFER
      config PIN_BUFFER_ANALOG
        default "$(MCU_NAME):PA3"
    endif

  endif

# -------------------------------------
# Per gate
# -------------------------------------

  if MMU_HAS_PER_GATE_MCU

    config PIN_GEAR_UART
      default "$(MCU_NAME)_gate0:PB6"
    config PIN_GEAR_STEP
      default "$(MCU_NAME)_gate0:PB5"
    config PIN_GEAR_DIR
      default "$(MCU_NAME)_gate0:PB4"
    config PIN_GEAR_ENABLE
      default "!$(MCU_NAME)_gate0:PB7"
    config PIN_GEAR_DIAG
      default ""

    @repeat var=gate min=1 max=11@
    if PARAM_NUM_GATES > $(gate)

      config PIN_GEAR_UART_$(gate)
        default "$(MCU_NAME)_gate$(gate):PB6"
      config PIN_GEAR_STEP_$(gate)
        default "$(MCU_NAME)_gate$(gate):PB5"
      config PIN_GEAR_DIR_$(gate)
        default "$(MCU_NAME)_gate$(gate):PB4"
      config PIN_GEAR_ENABLE_$(gate)
        default "!$(MCU_NAME)_gate$(gate):PB7"
      config PIN_GEAR_DIAG_$(gate)
        default ""

    endif
    @endrepeat@

    @repeat var=gate min=0 max=11@
    if PARAM_NUM_GATES > $(gate)

      config PIN_ENTRY_SENSOR_$(gate)
        default "^$(MCU_NAME)_gate$(gate):PA1"

      config PIN_EXIT_SENSOR_$(gate)
        default "^$(MCU_NAME)_gate$(gate):PA0"

      config PIN_EJECT_BUTTON_$(gate)
        default "^!$(MCU_NAME)_gate$(gate):PB2"

      config PIN_NEOPIXEL_$(gate)
        default "$(MCU_NAME)_gate$(gate):PA4"

      config PIN_NEOPIXEL_BOX_$(gate)
        string
        default "$(MCU_NAME)_gate$(gate):PA2"

      config PIN_FAN_$(gate)
        string
        default "$(MCU_NAME)_gate$(gate):PA15"

    endif
    @endrepeat@

    # Buffer. Assumed on gate 0 MCU ---
    config PIN_BUFFER_TENSION
      default "^$(MCU_NAME)_gate0:PB1"
    config PIN_BUFFER_COMPRESSION
      default "^$(MCU_NAME)_gate0:PB0"

    if OPTION_PSF_BUFFER
      config PIN_BUFFER_ANALOG
        default "$(MCU_NAME)_gate0:PA3"
    endif

    # i2c2 (PB10/PB11) is the only hardware i2c bus routed on the SLB; it
    # carries both the per-gate environment sensors and the per-gate NFC
    # readers. Offer it to both by chipdef name - the feature files carry
    # no chipdef knowledge of their own.
    @repeat var=gate min=0 max=11@
    if PARAM_NUM_GATES > $(gate)

      choice CHOICE_ENVIRONMENT_SENSOR_I2C_BUS_$(gate)
        default CHOICE_ENVIRONMENT_SENSOR_I2C_BUS_SLB_I2C2_PB10_PB11_$(gate) if BOARD_TYPE_SLB_1_0

        config CHOICE_ENVIRONMENT_SENSOR_I2C_BUS_SLB_I2C2_PB10_PB11_$(gate)
          bool "i2c2_PB10_PB11"
          depends on BOARD_TYPE_SLB_1_0
      endchoice
      config PARAM_ENVIRONMENT_SENSOR_I2C_BUS_$(gate)
        default "i2c2_PB10_PB11" if CHOICE_ENVIRONMENT_SENSOR_I2C_BUS_SLB_I2C2_PB10_PB11_$(gate)

      choice CHOICE_NFC_READER_I2C_BUS_$(gate)
        default CHOICE_NFC_READER_I2C_BUS_SLB_I2C2_PB10_PB11_$(gate) if BOARD_TYPE_SLB_1_0

        config CHOICE_NFC_READER_I2C_BUS_SLB_I2C2_PB10_PB11_$(gate)
          bool "i2c2_PB10_PB11"
          depends on BOARD_TYPE_SLB_1_0
      endchoice
      config PARAM_NFC_READER_I2C_BUS_$(gate)
        default "i2c2_PB10_PB11" if CHOICE_NFC_READER_I2C_BUS_SLB_I2C2_PB10_PB11_$(gate)

    endif
    @endrepeat@

  endif

endif
```
