## installer/Kconfig.speeds
```kconfig
# Per-unit speed settings for gear stepper and selector stepper movement
#
# Responsible for setting:
#   PARAM_GEAR_LOAD_SPEED
#   PARAM_GEAR_LOAD_ACCEL
#   PARAM_GEAR_FROM_FILAMENT_BUFFER_SPEED
#   PARAM_GEAR_FROM_FILAMENT_BUFFER_ACCEL
#   PARAM_GEAR_UNLOAD_SPEED
#   PARAM_GEAR_UNLOAD_ACCEL
#   PARAM_GEAR_HOMING_SPEED
#   PARAM_GEAR_SHORT_MOVE_SPEED
#   PARAM_GEAR_SHORT_MOVE_ACCEL
#   PARAM_GEAR_SHORT_MOVE_THRESHOLD
#
# These must be in a "if MMU_HAS_SELECTOR_STEPPER" clause in cfg templates
#   PARAM_SELECTOR_MOVE_SPEED
#   PARAM_SELECTOR_HOMING_SPEED
#   PARAM_SELECTOR_TOUCH_SPEED
#   PARAM_SELECTOR_ACCEL
#
# A single unit also gets the extruder speeds (Kconfig.extruder_speeds)

menu "Speeds"

# -------------------------------------
# Gear
# -------------------------------------

  comment "_Bowden movement speeds (mm/s)"

  config PARAM_GEAR_LOAD_SPEED
    float "Normal bowden load speed        "
    default 100
    help
      This is the default bowden load speed for long movements.
      On systems with a "filament buffer" that catches loose filament this will set
      a lower speed (for first time load) to overcome friction without the stepper
      loosing steps. and the "from buffer" speed can be set higher.

  config PARAM_GEAR_LOAD_ACCEL
    float "Normal load acceleration        "
    default 100
    help
      Default bowden load acceleration for long movements.

  if MMU_HAS_FILAMENT_BUFFER
    config PARAM_GEAR_FROM_FILAMENT_BUFFER_SPEED
      float "From filament buffer load speed "
      default 150
      help
        High speed for normal filament loading from filament buffer. It is
        employed after the initial load/unload when Happy Hare knows the filament
        won't tug on the spool.
        Generally this can be 50% higher than the normal load speed and
        allows for optimization of filament swap times.

    config PARAM_GEAR_FROM_FILAMENT_BUFFER_ACCEL
      float "From buffer load acceleration   "
      default 400
      help
        Bowden load acceleration for long movements when loading from filament buffer.
        It is employed after the initial load/unload when Happy Hare knows the filament
        won't tug on the spool.
        Generally this can be at least 100% higher than the normal load acceleration and
        allows for optimization of filament swap times.
  endif

  config PARAM_GEAR_UNLOAD_SPEED
    float "Normal bowden unload speed      "
    default 80
    help
      You can use a lower speed when unloading filament. This is useful if you have an eSpool
      rewinder system that limits speed

  config PARAM_GEAR_UNLOAD_ACCEL
    float "Normal unload acceleration      "
    default 100
    help
      Acceleration in mm/s^2 for long bowden unload moves driven by the MMU
      gear stepper. Lower values bring the filament up to speed more gently,
      which can help an eSpooler keep up with the returning filament.

  config PARAM_GEAR_HOMING_SPEED
    float "Gear homing speed               "
    default 50
    help
      Speed of gear stepper only homing moves (e.g. homing to gate or extruder)

  config PARAM_GEAR_SHORT_MOVE_SPEED
    float "Short movement speed            "
    default 80
    help
      Speed when making short moves (e.g. incremental retracts with encoder)

  config PARAM_GEAR_SHORT_MOVE_ACCEL
    float "Short movement acceleration     "
    default 400
    help
      Acceleration in mm/s^2 for gear stepper moves at or below the short
      move threshold, including incremental retracts with an encoder.
      Applies to both loading and unloading moves that are not homing moves.

  config PARAM_GEAR_SHORT_MOVE_THRESHOLD
    float "Short move threshold            "
    default 70
    help
      Individual move distance below which is considered a short move

  config PARAM_VIRTUAL_SENSOR_HOMING_SPEED
    float "Virtual sensor homing speed     "
    default 15
    help
      Special slow speed used for homing to virtual endstops (like
      filament_compression and filament_tension with a proportional
      sync-feedback buffer, or using Qidi filament width sensor
      as a substitute for extruder or toolhead sensor.
      This applies to all steppers using virtual endstops.



# -------------------------------------
# Extruder (printer-level: a multi-unit entry point has its own menu)
# -------------------------------------

  if !MULTI_UNIT
    comment "_"
    source "Kconfig.extruder_speeds"
  endif


# -------------------------------------
# Selector
# -------------------------------------

  if MMU_HAS_SELECTOR_STEPPER

    comment "_"
    comment "_Selector movement speeds (mm/s)"

    config PARAM_SELECTOR_MOVE_SPEED
      float "Speed of selector movement      "
      default 200
      help
        Speed in mm/s for normal selector positioning between gates.
        Select a speed the selector can reliably reach without losing steps.
        Homing and touch moves use their separate speed settings.

    config PARAM_SELECTOR_HOMING_SPEED
      float "Speed of selector homing moves  "
      depends on LINEAR_SELECTOR || LINEAR_SERVO_SELECTOR || LINEAR_MULTI_GEAR_SELECTOR || ROTARY_SELECTOR || TESTING_SELECTOR
      default 60
      help
        Speed in mm/s for the initial selector homing move to its endstop.
        A slower speed can improve reliable detection of the home position.
        Moves using the selector touch endstop use the touch speed instead.

    config PARAM_SELECTOR_TOUCH_SPEED
      float "Speed of touch selector movement"
      depends on LINEAR_SELECTOR || LINEAR_SERVO_SELECTOR || LINEAR_MULTI_GEAR_SELECTOR || TESTING_SELECTOR
      default 80
      help
        Speed in mm/s for selector moves using TMC StallGuard to detect a
        stall or obstruction. Used for touch positioning and end-of-travel
        detection when selector touch is configured and enabled.
        Tune together with the driver's StallGuard sensitivity for reliable
        detection without false triggers.

    config PARAM_SELECTOR_ACCEL
      float "Selector stepper acceleration   "
      default 1200
      help
        Acceleration in mm/s^2 for selector movement, including homing and
        touch moves. Lower values give gentler starts and stops; higher
        values reach the selected speed sooner but can cause lost steps
        if the selector cannot keep up.

  endif 

endmenu
```
