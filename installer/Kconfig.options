## installer/boards/Kconfig.tzb_1_0
```kconfig
config BOARD_TYPE_TZB_1_0
  bool "TZB v1.0 [[DIM]]/ designed for ERCF[[/DIM]]"
  help
    Custom designed originally for the ERCF

if BOARD_TYPE_TZB_1_0
  config PARAM_BOARD_TYPE
    default "TZB v1"

  choice CHOICE_MMU_CONNECTION_TYPE
    default CHOICE_MMU_CONNECTION_TYPE_SERIAL
  endchoice
  choice CHOICE_MMU_SERIAL_CONNECTION
    default $(mmu_serial_config,1,stm32)
  endchoice

  config PIN_GEAR_UART 
    default "$(MCU_NAME):PD1"
  config PIN_GEAR_STEP
    default "$(MCU_NAME):PD0" 
  config PIN_GEAR_DIR
    default "$(MCU_NAME):PA15" 
  config PIN_GEAR_ENABLE
    default "!$(MCU_NAME):PD3" 
  config PIN_GEAR_DIAG
    default "$(MCU_NAME):PD2" 

  config PIN_SELECTOR_UART
    default "$(MCU_NAME):PB5" 
  config PIN_SELECTOR_STEP
    default "$(MCU_NAME):PB4" 
  config PIN_SELECTOR_DIR
    default "$(MCU_NAME):PB3" 
  config PIN_SELECTOR_ENABLE
    default "!$(MCU_NAME):PB7" 
  config PIN_SELECTOR_DIAG
    default "$(MCU_NAME):PB6"

  config PIN_SELECTOR_ENDSTOP
    default "^$(MCU_NAME):PA4"
  config PIN_SELECTOR_SERVO
    default "$(MCU_NAME):PA0" 

  config PIN_ENCODER
    default "^$(MCU_NAME):PA2"
  config PIN_SHARED_EXIT_SENSOR
    default ""
  config PIN_NEOPIXEL
    default "$(MCU_NAME):PA5"

  config PIN_ENTRY_SENSOR_0
    default "^$(MCU_NAME):PB14"
  config PIN_ENTRY_SENSOR_1
    default "^$(MCU_NAME):PB13"
  config PIN_ENTRY_SENSOR_2
    default "^$(MCU_NAME):PB12"
  config PIN_ENTRY_SENSOR_3
    default "^$(MCU_NAME):PA7"
  config PIN_ENTRY_SENSOR_4
    default "^$(MCU_NAME):PA6"
  config PIN_ENTRY_SENSOR_5
    default "^$(MCU_NAME):PB2"
  config PIN_ENTRY_SENSOR_6
    default "^$(MCU_NAME):PA13"
  config PIN_ENTRY_SENSOR_7
    default "^$(MCU_NAME):PA10"
  config PIN_ENTRY_SENSOR_8
    default "^$(MCU_NAME):PC7"
  config PIN_ENTRY_SENSOR_9
    default "^$(MCU_NAME):PC6"
  config PIN_ENTRY_SENSOR_10
    default "^$(MCU_NAME):PA9"
  config PIN_ENTRY_SENSOR_11
    default "^$(MCU_NAME):PA8"

  config PIN_BUFFER_TENSION
    default "^$(MCU_NAME):PB1"
  config PIN_BUFFER_COMPRESSION
    default "^$(MCU_NAME):PB0"
  config PIN_BUFFER_ANALOG
    default "$(MCU_NAME):PA3"

  # PA3 is also the analog buffer input (ADC), which keeps it
  config PIN_SERVO_CUTTER_SERVO
    default "$(MCU_NAME):PA3" if !(MMU_HAS_SENSOR_BUFFER_PROPORTIONAL && PIN_BUFFER_ANALOG = "$(MCU_NAME):PA3")

  config PARAM_MISC_HARDWARE
    default "$(ml,\
[temperature_sensor $(UNIT_NAME)_enclosure]\n\
sensor_type: BME280\n\
i2c_mcu: $(MCU_NAME)\n\
i2c_bus: i2c2_PB10_PB11\n\
i2c_address: 118\n\
)" if MMU_HAS_ENVIRONMENT_SENSOR

# No fan headers (MOTO1/MOTO2 are 5V servo outputs; "24V GND" is unswitched power)

  # I2C headers (two, one bus): hardware i2c2, SCL PB10 / SDA PB11
  i2c_board       := BOARD_TYPE_TZB_1_0
  i2c_tag         := TZB_I2C2
  i2c_bus         := i2c2_PB10_PB11
  i2c_label       := i2c2_PB10_PB11 [[DIM]]/ I2C header[[/DIM]]
  i2c_env         := y
  i2c_env_default := y
  i2c_nfc         := y
  i2c_nfc_default := n
  source "components/Kconfig.i2c_board_bus"
endif
```

## installer/boards/custom/Kconfig.vvd
```kconfig
config BOARD_TYPE_VVD_1_0
  bool "BTT ViViD MCU"

if BOARD_TYPE_VVD_1_0
  config PARAM_BOARD_TYPE
    default "BTT ViViD v1"

  choice CHOICE_MMU_CONNECTION_TYPE
    default CHOICE_MMU_CONNECTION_TYPE_SERIAL
  endchoice
  choice CHOICE_MMU_SERIAL_CONNECTION
    default $(mmu_serial_config,1,stm32)
  endchoice
  choice CHOICE_BUFFER_CONNECTION_TYPE
    default CHOICE_BUFFER_CONNECTION_TYPE_SERIAL
  endchoice
  choice CHOICE_BUFFER_SERIAL_CONNECTION
    default $(buffer_serial_config,1,stm32)
  endchoice

  config PIN_SELECTOR_UART
    default "$(MCU_NAME):PB3"
  config PIN_SELECTOR_STEP
    default "$(MCU_NAME):PD3"
  config PIN_SELECTOR_DIR
    default "$(MCU_NAME):PD2"
  config PIN_SELECTOR_ENABLE
    default "!$(MCU_NAME):PB4"

  config PIN_GATE_ENDSTOP_0
    default "!$(MCU_NAME):PD0"
  config PIN_GATE_ENDSTOP_1
    default "!$(MCU_NAME):PA15"
  config PIN_GATE_ENDSTOP_2
    default "!$(MCU_NAME):PD1"
  config PIN_GATE_ENDSTOP_3
    default "!$(MCU_NAME):PC13"

  config PIN_GEAR_UART
    default "$(MCU_NAME):PB7"
  config PIN_GEAR_STEP
    default "$(MCU_NAME):PB6"
  config PIN_GEAR_DIR
    default "$(MCU_NAME):PB5"
  config PIN_GEAR_ENABLE
    default "!$(MCU_NAME):PB8"

  config PIN_ENTRY_SENSOR_0
    default "$(MCU_NAME):PA0"
  config PIN_ENTRY_SENSOR_1
    default "$(MCU_NAME):PA1"
  config PIN_ENTRY_SENSOR_2
    default "$(MCU_NAME):PA2"
  config PIN_ENTRY_SENSOR_3
    default "$(MCU_NAME):PA3"


  # -------------------------------------
  # Custom LED setup
  # -------------------------------------

  config CUSTOM_LED_SETUP
    def_bool y
misc_hardware_led := \
[neopixel $(UNIT_NAME)_leds_1]\n\
pin: $(MCU_NAME):PC6\n\
chain_count: 14\n\
color_order: GRB\n\
\n\
[neopixel $(UNIT_NAME)_leds_2]\n\
pin: $(MCU_NAME):PC7\n\
chain_count: 14\n\
color_order: GRB\n\
\n\


  # -------------------------------------
  # Custom Environment sensor setup
  # -------------------------------------

  config CUSTOM_ENVIRONMENT_SENSOR_SETUP
    def_bool y
misc_hardware_environment_sensor := \
[temperature_sensor $(UNIT_NAME)_env_left]\n\
sensor_type: AHT3X # Use an AHT10 and set klipper option 'update_aht10_commands: 1' if the AHT3X sensor_type isn't supported (older Klipper versions)\n\
i2c_mcu: $(MCU_NAME)\n\
i2c_software_scl_pin: $(MCU_NAME):PA9\n\
i2c_software_sda_pin: $(MCU_NAME):PA10\n\
aht10_report_time: 10\n\
\n\
[temperature_sensor $(UNIT_NAME)_env_right]\n\
sensor_type: AHT3X # Use an AHT10 and set klipper option 'update_aht10_commands: 1' if the AHT3X sensor_type isn't supported (older Klipper versions)\n\
i2c_mcu: $(MCU_NAME)\n\
i2c_software_scl_pin: $(MCU_NAME):PA7\n\
i2c_software_sda_pin: $(MCU_NAME):PA6\n\
aht10_report_time: 10\n\
\n\


  # -------------------------------------
  # Custom heater setup
  # -------------------------------------

  config CUSTOM_HEATER_SETUP
    def_bool y
misc_hardware_heater := \
[heater_generic $(UNIT_NAME)_heater]\n\
gcode_id:  $(UNIT_NAME)_heater\n\
heater_pin: $(MCU_NAME):PC14\n\
sensor_type: temperature_combined\n\
sensor_list: temperature_sensor $(UNIT_NAME)_env_left$(comma) temperature_sensor $(UNIT_NAME)_env_right\n\
combination_method: mean\n\
maximum_deviation: 100\n\
control: pid\n\
pid_Kp: 51.604\n\
pid_Ki: 1.121\n\
pid_Kd: 593.934\n\
min_temp: -100\n\
max_temp: 70\n\
\n\
[verify_heater $(UNIT_NAME)_heater]\n\
max_error: 300\n\
check_gain_time: 600\n\
hysteresis: 10\n\
heating_gain: 1\n\
\n\
[temperature_sensor $(UNIT_NAME)_ptc_ntc100k]\n\
sensor_pin: $(MCU_NAME):PA4\n\
sensor_type: Generic 3950\n\
pullup_resistor: 2200\n\
\n\


  # -------------------------------------
  # Custom heater fan setup
  # Note: this could use default set mechanism but could cause upgrade issues
  # -------------------------------------

  config CUSTOM_HEATER_FAN_SETUP
    def_bool y
misc_hardware_heater_fan := \
[heater_fan $(UNIT_NAME)_fan]\n\
pin: $(MCU_NAME):PC15\n\
shutdown_speed: 0\n\
heater: $(UNIT_NAME)_heater\n\
\n\


  # -------------------------------------
  # Custom controller fan setup
  # -------------------------------------

  config CUSTOM_FAN_SETUP
    def_bool y
misc_hardware_fan := \
# Electronics cooling fan\n\
[controller_fan $(UNIT_NAME)_mcu_fan]\n\
pin: $(MCU_NAME):PA14\n\
stepper: mmu_stepper $(UNIT_NAME)_selector$(comma) mmu_stepper $(UNIT_NAME)_gear\n\
\n\


  # -------------------------------------
  # Custom NFC reader setup
  # -------------------------------------

  config CUSTOM_NFC_READER_SETUP
    def_bool y
misc_hardware_nfc_reader := \
# NFC reader gates 0/1\n\
[mmu_nfc_reader $(UNIT_NAME)_nfc01]\n\
reader_type           : rc522\n\
cs_pin                : $(MCU_NAME):PB14\n\
spi_bus               : spi2_PB2_PB11_PB10\n\
spi_speed             : 1000000\n\
debug                 : 0\n\
\n\
# NFC reader gates 2/3\n\
[mmu_nfc_reader $(UNIT_NAME)_nfc23]\n\
reader_type           : rc522\n\
cs_pin                : $(MCU_NAME):PA8\n\
spi_bus               : spi2_PB2_PB11_PB10\n\
spi_speed             : 1000000\n\
debug                 : 0\n\

  config PARAM_MISC_HARDWARE
    default "$(ml,$(misc_hardware_led)$(misc_hardware_environment_sensor)$(misc_hardware_heater)$(misc_hardware_heater_fan)$(misc_hardware_fan)$(misc_hardware_nfc_reader))"


  # -------------------------------------
  # Buffer
  # -------------------------------------

  if OPTION_VVD_BUFFER
    config PIN_EXIT_SENSOR_0
      default "$(MCU_NAME)_buffer:PA0"
    config PIN_EXIT_SENSOR_1
      default "$(MCU_NAME)_buffer:PA1"
    config PIN_EXIT_SENSOR_2
      default "$(MCU_NAME)_buffer:PA2"
    config PIN_EXIT_SENSOR_3
      default "$(MCU_NAME)_buffer:PA3"

    config PIN_BUFFER_TENSION
      default "$(MCU_NAME)_buffer:PA4"
    config PIN_BUFFER_COMPRESSION
      default "$(MCU_NAME)_buffer:PA5"
  endif

endif
```

## installer/boards/per_gate/Kconfig.ebb_gen1
```kconfig
config BOARD_TYPE_EBB_GEN1
  bool "EBB36/42 gen1 MCU"
  help
    This covers the gen 1 EBB36 and EBB42 boards
    (v1.1 and v 1.2)

if BOARD_TYPE_EBB_GEN1
  config PARAM_BOARD_TYPE
    default "EBB36/42 gen1"

  choice CHOICE_MMU_CONNECTION_TYPE
    default CHOICE_MMU_CONNECTION_TYPE_CANBUS
  endchoice
  choice CHOICE_MMU_SERIAL_CONNECTION
    default $(mmu_serial_config,1,stm32)
  endchoice


# -------------------------------------
# Regular use
# -------------------------------------

  if !MMU_HAS_PER_GATE_MCU

    config PIN_GEAR_UART
      default "$(MCU_NAME):PA15"
    config PIN_GEAR_STEP
      default "$(MCU_NAME):PD0"
    config PIN_GEAR_DIR
      default "$(MCU_NAME):PD1"
    config PIN_GEAR_ENABLE
      default "!$(MCU_NAME):PD2"
    config PIN_GEAR_DIAG
      default ""

    config PIN_ENTRY_SENSOR_0
      default "^(MCU_NAME):PB7"

    config PIN_EXIT_SENSOR_0
      default "^(MCU_NAME):PB5"

    config PIN_EJECT_BUTTON_0
      default "^!$(MCU_NAME):PB6"

    config PIN_NEOPIXEL
      default "$(MCU_NAME):PD3"

    config PIN_FAN
      default "$(MCU_NAME):PA0"

    config PIN_BUFFER_TENSION
      default "^$(MCU_NAME):PB8"
    config PIN_BUFFER_COMPRESSION
      default "^$(MCU_NAME):PB9"

    if OPTION_PSF_BUFFER
      config PIN_BUFFER_ANALOG
        default "$(MCU_NAME):PA3"
    endif

  endif

# -------------------------------------
# Per gate
# -------------------------------------

  if MMU_HAS_PER_GATE_MCU

    config PIN_GEAR_UART
      default "$(MCU_NAME)_gate0:PA15"
    config PIN_GEAR_STEP
      default "$(MCU_NAME)_gate0:PD0"
    config PIN_GEAR_DIR
      default "$(MCU_NAME)_gate0:PD1"
    config PIN_GEAR_ENABLE
      default "!$(MCU_NAME)_gate0:PD2"
    config PIN_GEAR_DIAG
      default ""

    @repeat var=gate min=1 max=11@
    if PARAM_NUM_GATES > $(gate)

      config PIN_GEAR_UART_$(gate)
        default "$(MCU_NAME)_gate$(gate):PA15"
      config PIN_GEAR_STEP_$(gate)
        default "$(MCU_NAME)_gate$(gate):PD0"
      config PIN_GEAR_DIR_$(gate)
        default "$(MCU_NAME)_gate$(gate):PD1"
      config PIN_GEAR_ENABLE_$(gate)
        default "!$(MCU_NAME)_gate$(gate):PD2"
      config PIN_GEAR_DIAG_$(gate)
        default ""

    endif
    @endrepeat@

    @repeat var=gate min=0 max=11@
    if PARAM_NUM_GATES > $(gate)

      config PIN_ENTRY_SENSOR_$(gate)
        default "^$(MCU_NAME)_gate$(gate):PB7"

      config PIN_EXIT_SENSOR_$(gate)
        default "^$(MCU_NAME)_gate$(gate):PB5"

      config PIN_EJECT_BUTTON_$(gate)
        default "^!$(MCU_NAME)_gate$(gate):PB6"

      config PIN_NEOPIXEL_$(gate)
        default "$(MCU_NAME)_gate$(gate):PD3"

      config PIN_FAN_$(gate)
        default "$(MCU_NAME)_gate$(gate):PA0"

    endif
    @endrepeat@

    # Buffer. Assumed on gate 0 MCU ---
    config PIN_BUFFER_TENSION
      default "^$(MCU_NAME)_gate0:PB8"
    config PIN_BUFFER_COMPRESSION
      default "^$(MCU_NAME)_gate0:PB9"

    if OPTION_PSF_BUFFER
      config PIN_BUFFER_ANALOG
        default "$(MCU_NAME)_gate0:PA3"
    endif

    # i2c3 (PB3/PB4) is the only hardware i2c bus routed on the EBB; it
    # carries both the per-gate environment sensors and the per-gate NFC
    # readers. Offer it to both by chipdef name - the feature files carry
    # no chipdef knowledge of their own.
    @repeat var=gate min=0 max=11@
    if PARAM_NUM_GATES > $(gate)

      choice CHOICE_ENVIRONMENT_SENSOR_I2C_BUS_$(gate)
        default CHOICE_ENVIRONMENT_SENSOR_I2C_BUS_EBB_I2C3_PB3_PB4_$(gate) if BOARD_TYPE_EBB_GEN1

        config CHOICE_ENVIRONMENT_SENSOR_I2C_BUS_EBB_I2C3_PB3_PB4_$(gate)
          bool "i2c3_PB3_PB4"
          depends on BOARD_TYPE_EBB_GEN1
      endchoice
      config PARAM_ENVIRONMENT_SENSOR_I2C_BUS_$(gate)
        default "i2c3_PB3_PB4" if CHOICE_ENVIRONMENT_SENSOR_I2C_BUS_EBB_I2C3_PB3_PB4_$(gate)

      choice CHOICE_NFC_READER_I2C_BUS_$(gate)
        default CHOICE_NFC_READER_I2C_BUS_EBB_I2C3_PB3_PB4_$(gate) if BOARD_TYPE_EBB_GEN1

        config CHOICE_NFC_READER_I2C_BUS_EBB_I2C3_PB3_PB4_$(gate)
          bool "i2c3_PB3_PB4"
          depends on BOARD_TYPE_EBB_GEN1
      endchoice
      config PARAM_NFC_READER_I2C_BUS_$(gate)
        default "i2c3_PB3_PB4" if CHOICE_NFC_READER_I2C_BUS_EBB_I2C3_PB3_PB4_$(gate)

    endif
    @endrepeat@

  endif

endif
```
