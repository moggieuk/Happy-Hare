## installer/Kconfig.per_gate
```kconfig
# Per-gate hardware configuration for modular MMU designs.
#
# MMU_HAS_PER_GATE_CONFIG controls this presentation and the gate-aligned
# environment/heater/fan associations. It is intentionally independent of
# MMU_HAS_PER_GATE_MCU, which describes the MCU connection topology.

if MMU_HAS_PER_GATE_CONFIG

  comment "_"
  comment "_Per-gate config"

  @repeat var=i min=0 max=11@
    if PARAM_NUM_GATES > $(i)

      menu "Gate $(i) config"
        help
          Configure the environment sensor, heater, and fans for gate $(i).

        # -------------------------------------
        # Environment sensor
        # -------------------------------------

        if MMU_HAS_ENVIRONMENT_SENSOR && !CUSTOM_ENVIRONMENT_SENSOR_SETUP

          config PARAM_ENVIRONMENT_SENSOR_$(i)
            string

          menuconfig PARAM_ENVIRONMENT_SENSOR_GATE_$(i)
            bool "Environment sensor"
            default y
            help
              Create an environment sensor for this gate.

          if PARAM_ENVIRONMENT_SENSOR_GATE_$(i)

            config PARAM_ENVIRONMENT_SENSOR_$(i)
              string "Sensor name       "
              default "$(UNIT_NAME)_Env$(i)"
              help
                Name of the environment sensor section in the printer config.

            env_sensor_suffix := _$(i)
            source "components/Kconfig.environment_sensor_type"

            choice CHOICE_ENVIRONMENT_SENSOR_I2C_BUS_TYPE_$(i)
              prompt "i2c bus type      "
              default CHOICE_ENVIRONMENT_SENSOR_I2C_HARDWARE_$(i)
              help
                Select whether to use a hardware or software i2c bus.

              config CHOICE_ENVIRONMENT_SENSOR_I2C_HARDWARE_$(i)
                bool "Hardware i2c"

              config CHOICE_ENVIRONMENT_SENSOR_I2C_SOFTWARE_$(i)
                bool "Software i2c"
            endchoice

            config PARAM_ENVIRONMENT_SENSOR_I2C_BUS_TYPE_$(i)
              string
              default "software" if CHOICE_ENVIRONMENT_SENSOR_I2C_SOFTWARE_$(i)
              default "hardware"

            if CHOICE_ENVIRONMENT_SENSOR_I2C_HARDWARE_$(i)
              choice CHOICE_ENVIRONMENT_SENSOR_I2C_BUS_$(i)
                prompt "i2c bus name      "
                help
                  Select the hardware i2c bus used by this gate's sensor.
                  Board files offer the buses this board actually routes;
                  "Custom bus name" accepts any Klipper i2c bus name.

                config CHOICE_ENVIRONMENT_SENSOR_I2C_BUS_OTHER_$(i)
                  bool "Custom bus name"
              endchoice

              config PARAM_ENVIRONMENT_SENSOR_I2C_BUS_$(i)
                string "Custom i2c bus name    " if CHOICE_ENVIRONMENT_SENSOR_I2C_BUS_OTHER_$(i)
                default "" if CHOICE_ENVIRONMENT_SENSOR_I2C_BUS_OTHER_$(i)
                help
                  Leave blank to use the MCU's default hardware i2c bus.
            endif

            env_sensor_suffix := _$(i)
            source "components/Kconfig.environment_sensor_address"

            if CHOICE_ENVIRONMENT_SENSOR_I2C_SOFTWARE_$(i)
              config PIN_ENVIRONMENT_SENSOR_SCL_$(i)
                string "SCL pin           "
                validator "$(pin_validator)"
                default ""
                help
                  $(pin_help)

              config PIN_ENVIRONMENT_SENSOR_SDA_$(i)
                string "SDA pin           "
                validator "$(pin_validator)"
                default ""
                help
                  $(pin_help)
            endif
          endif
        endif

        # -------------------------------------
        # Enclosure heater association
        # -------------------------------------

        if MMU_HAS_HEATER && !CUSTOM_HEATER_SETUP
          menuconfig PARAM_FILAMENT_HEATER_GATE_$(i)
            bool "Enclosure heater"
            default y
            help
              Associate an existing Klipper heater with this gate.

          config PARAM_FILAMENT_HEATER_$(i)
            string "Heater name       " if PARAM_FILAMENT_HEATER_GATE_$(i)
            default "$(UNIT_NAME)_heater$(i)"
            help
              Full or short name of the heater for this gate.
        endif

        # -------------------------------------
        # Happy Hare managed fan
        # -------------------------------------

        if MMU_HAS_FANS && !CUSTOM_FAN_SETUP
          config PARAM_FAN_GATE_$(i)
            bool "Managed environment fan"
            default y
            help
              Create a [fan_generic] managed by Happy Hare for this gate.

          if PARAM_FAN_GATE_$(i)
            menu "Fan h/w config"
              help
                Configure the managed fan output for this gate.

              config PARAM_FAN_MAX_POWER_$(i)
                float "Fan maximum power  "
                default 1.0
                range 0.1 1.0
                help
                  Maximum power setting for this gate's fan (0.1 to 1.0).

              config PARAM_FAN_KICK_START_TIME_$(i)
                float "Fan kick start time"
                default 0.5
                range 0 3.0
                help
                  Time in seconds to run this gate's fan at full power before
                  resetting to its target speed.

              config PIN_FAN_$(i)
                string "Fan pin            "
                validator "$(pin_validator)"
                help
                  Leave blank if this gate does not have a managed fan installed.

              config BOOL_HIDE_FAN_$(i)
                bool "Hide in Mainsail / Fluidd"
                default y
                help
                  Prefix the fan name with an underscore to hide it in the UI.
                  Disable to show the fan. Automatic fan control is unchanged.

              config PARAM_FAN_NAME_$(i)
                string
                default "_$(UNIT_NAME)_fan$(i)" if BOOL_HIDE_FAN_$(i)
                default "$(UNIT_NAME)_fan$(i)"

            endmenu
          endif
        endif

        # -------------------------------------
        # Controller fan
        # -------------------------------------

        if MMU_HAS_CONTROLLER_FAN && !CUSTOM_CONTROLLER_FAN_SETUP
          config PARAM_CONTROLLER_FAN_GATE_$(i)
            bool "Controller fan"
            default y
            help
              Create a [controller_fan] for this gate that runs while the
              gate's gear stepper is enabled.

          if PARAM_CONTROLLER_FAN_GATE_$(i)
            menu "Controller fan h/w config"
              help
                Configure the controller fan output for this gate.

              config PARAM_CONTROLLER_FAN_MAX_POWER_$(i)
                float "Fan maximum power  "
                default 1.0
                range 0.1 1.0
                help
                  Maximum power setting for this gate's controller fan (0.1 to 1.0).

              config PARAM_CONTROLLER_FAN_KICK_START_TIME_$(i)
                float "Fan kick start time"
                default 0.5
                range 0 3.0
                help
                  Time in seconds to run this gate's controller fan at full
                  power before resetting to its target speed.

              config PARAM_CONTROLLER_FAN_SPEED_$(i)
                float "Fan speed          "
                default 1.0
                range 0.0 1.0
                help
                  Fan speed while this gate's gear stepper is enabled (0.0 to 1.0).

              config PARAM_CONTROLLER_FAN_IDLE_TIMEOUT_$(i)
                int "Fan idle timeout   "
                default 30
                range 0 3600
                help
                  Time in seconds the fan keeps running after this gate's
                  gear stepper is disabled.

              config PIN_CONTROLLER_FAN_$(i)
                string "Controller fan pin "
                validator "$(pin_validator)"
                help
                  Leave blank if this gate does not have a controller fan installed.

              config BOOL_HIDE_CONTROLLER_FAN_$(i)
                bool "Hide in Mainsail / Fluidd"
                default y
                help
                  Prefix the fan name with an underscore to hide it in the UI.
                  Disable to show the fan. Automatic fan control is unchanged.

              config PARAM_CONTROLLER_FAN_NAME_$(i)
                string
                default "_$(UNIT_NAME)_controller_fan$(i)" if BOOL_HIDE_CONTROLLER_FAN_$(i)
                default "$(UNIT_NAME)_controller_fan$(i)"

            endmenu
          endif
        endif

        # -------------------------------------
        # Fixed heater fan
        # -------------------------------------

        if MMU_HAS_HEATER && !CUSTOM_HEATER_FAN_SETUP
          config PARAM_HEATER_FAN_GATE_$(i)
            bool "Heater fan"
            depends on (!CUSTOM_HEATER_SETUP && PARAM_FILAMENT_HEATER_GATE_$(i)) || (CUSTOM_HEATER_SETUP && PARAM_FILAMENT_HEATER_$(i) != "")
            default y
            help
              Create a fixed [heater_fan] tied directly to this gate's heater.

          if PARAM_HEATER_FAN_GATE_$(i)
            menu "Heater fan h/w config"
              help
                Configure the Klipper heater fan output for this gate.

              config PARAM_HEATER_FAN_MAX_POWER_$(i)
                float "Fan maximum power  "
                default 1.0
                range 0.1 1.0
                help
                  Maximum power setting for this gate's heater fan (0.1 to 1.0).

              config PARAM_HEATER_FAN_KICK_START_TIME_$(i)
                float "Fan kick start time"
                default 0.5
                range 0 3.0
                help
                  Time in seconds to run this gate's heater fan at full power
                  before resetting to its target speed.

              config PARAM_HEATER_FAN_SPEED_$(i)
                float "Fan speed          "
                default 1.0
                range 0.0 1.0
                help
                  Fan speed while this gate's heater is active (0.0 to 1.0).

              config PARAM_HEATER_FAN_SHUTDOWN_SPEED_$(i)
                float "Fan shutdown speed "
                default 1.0
                range 0.0 1.0
                help
                  Fan speed while this gate's MCU is shutting down (0.0 to 1.0).

              config PARAM_HEATER_FAN_HEATER_TEMP_$(i)
                float "Fan heater temp    "
                default 45.0
                range 0 120
                help
                  Temperature (°C) of this gate's heater above which its fan
                  runs, even when the heater is off.

              config PIN_HEATER_FAN_$(i)
                string "Heater fan pin     "
                validator "$(pin_validator)"
                help
                  Leave blank if this gate does not have a heater fan installed.

              config BOOL_HIDE_HEATER_FAN_$(i)
                bool "Hide in Mainsail / Fluidd"
                default y
                help
                  Prefix the fan name with an underscore to hide it in the UI.
                  Disable to show the fan. Automatic fan control is unchanged.

              config PARAM_HEATER_FAN_NAME_$(i)
                string
                default "_$(UNIT_NAME)_heater_fan$(i)" if BOOL_HIDE_HEATER_FAN_$(i)
                default "$(UNIT_NAME)_heater_fan$(i)"

            endmenu
          endif
        endif

      endmenu
    endif
  @endrepeat@

endif
```
