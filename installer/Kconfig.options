## installer/Kconfig.pins
```kconfig
# This defines the symbol types, pins menu layout and changes to defaults.
# The defaults are set in the Kconfig.board_type under the boards directory.
#
# Responsible for defining all "PIN_*" parameters and board-specific UART addresses
# Note types must always be defined, the prompts are based on MMU capabilities
#
# Assumed that max gates:
#   for type-A boards is 12 (although currently max is 8)
#   for type-B boards is 5 (Chameleon X5)

# Gear and selector TMC drivers share one definition with the Blobifier.
# Every variable is re-assigned immediately before each source, because they
# are global for the whole parse.
prefix       := GEAR
run_current  := 0.7
hold_current := 0.1
stallguard   := 60
source "components/Kconfig.tmc_driver_types"

prefix       := SELECTOR
run_current  := 0.5
hold_current := 0.2
stallguard   := 75
source "components/Kconfig.tmc_driver_types"

# One column for every prompt on this page, so values line up wherever they
# appear. Stated once, so adding a prompt never means re-measuring by hand.
pin_pad      := 29

menu "Pins / TMC"
  help
    Configure TMC driver types for gear and selector steppers and MCU pin assignments.

# -------------------------------------
# Gear TMC driver
# -------------------------------------

  comment "_Gear Stepper(s)"

  prefix       := GEAR
  label        := Gear
  pad_width    := $(pin_pad)
  source "components/Kconfig.tmc_driver_menu"

# -------------------------------------
# Gear stepper
# -------------------------------------

  menu "Gear pins"
    prefix    := GEAR
    label     := Gear
    pad_width := $(pin_pad)
    source "components/Kconfig.tmc_driver_menu_pins"
    config PARAM_GEAR_UART_ADDRESS
      int
      prompt "$(pad,$(pin_pad),Gear UART addr)" if PARAM_GEAR_TMC != "" && !BOOL_GEAR_TMC_SPI
      default 0
      range 0 3
      depends on BOARD_TYPE_EASY_BRD || BOARD_TYPE_SKR_PICO_1 || BOARD_TYPE_OTHER || BOARD_TYPE_MANUAL
    config PIN_GEAR_STEP
      string "$(pad,$(pin_pad),Gear step pin)"
    config PIN_GEAR_DIR
      string "$(pad,$(pin_pad),Gear dir pin)"
    config PIN_GEAR_ENABLE
      string "$(pad,$(pin_pad),Gear enable pin)"
    config PIN_GEAR_DIAG
      string
      prompt "$(pad,$(pin_pad),Gear diag pin)" if PARAM_GEAR_TMC != ""
    config PARAM_GEAR_STALLGUARD_THRESHOLD
      prompt "$(pad,$(pin_pad),Gear stallguard)" if BOOL_GEAR_TMC_HAS_STALLGUARD && PIN_GEAR_DIAG != ""
      help
        Sensitivity for "touch" homing, written only when a diag pin is set.
        Expect to tune it. The scale depends on the chip: SGTHRS is 0-255
        and higher is more sensitive, SGT is -64..63 and lower is more
        sensitive.

    @repeat var=i min=1 max=11@
      config PARAM_GEAR_UART_ADDRESS_$(i)
        int
        default 0
        range 0 3
    @endrepeat@

    @repeat var=i min=1 max=11@
      config PIN_GEAR_UART_$(i)
        string
      config PIN_GEAR_CS_$(i)
        string
      config PIN_GEAR_STEP_$(i)
        string
      config PIN_GEAR_DIR_$(i)
        string
      config PIN_GEAR_ENABLE_$(i)
        string
      config PIN_GEAR_DIAG_$(i)
        string
    @endrepeat@

    if MULTIGEAR
      @repeat var=i min=1 max=11@
        if PARAM_NUM_GATES > $(i)
          comment "_"
          config PIN_GEAR_UART_$(i)
            prompt "$(pad,$(pin_pad),Gear $(i) UART pin)" if PARAM_GEAR_TMC != "" && !BOOL_GEAR_TMC_SPI
          config PIN_GEAR_CS_$(i)
            prompt "$(pad,$(pin_pad),Gear $(i) CS pin)" if BOOL_GEAR_TMC_SPI
          config PARAM_GEAR_UART_ADDRESS_$(i)
            prompt "$(pad,$(pin_pad),Gear $(i) UART addr)" if PARAM_GEAR_TMC != "" && (BOARD_TYPE_EASY_BRD || BOARD_TYPE_SKR_PICO_1 || BOARD_TYPE_OTHER || BOARD_TYPE_MANUAL)
          config PIN_GEAR_STEP_$(i)
            prompt "$(pad,$(pin_pad),Gear $(i) step pin)"
          config PIN_GEAR_DIR_$(i)
            prompt "$(pad,$(pin_pad),Gear $(i) dir pin)"
          config PIN_GEAR_ENABLE_$(i)
            prompt "$(pad,$(pin_pad),Gear $(i) enable pin)"
          config PIN_GEAR_DIAG_$(i)
            prompt "$(pad,$(pin_pad),Gear $(i) diag pin)" if PARAM_GEAR_TMC != ""
        endif
      @endrepeat@
    endif

  endmenu

# -------------------------------------
# Selector stepper and servo
# -------------------------------------

  config PIN_SELECTOR_STEP
    string
  config PIN_SELECTOR_DIR
    string
  config PIN_SELECTOR_ENABLE
    string
  config PIN_SELECTOR_DIAG
    string
  config PIN_SELECTOR_ENDSTOP
    string
  @repeat var=i min=4 max=11@
    config PIN_GATE_ENDSTOP_$(i)
      string
  @endrepeat@

  comment "_"

# -------------------------------------
# Selector TMC driver
# -------------------------------------

  comment "_Selector Stepper" if MMU_HAS_SELECTOR_STEPPER || MMU_HAS_SELECTOR_SERVO

  if MMU_HAS_SELECTOR_STEPPER
    prefix       := SELECTOR
    label        := Selector
    pad_width    := $(pin_pad)
    source "components/Kconfig.tmc_driver_menu"
  endif

  menu "Selector pins"
    depends on MMU_HAS_SELECTOR_STEPPER || MMU_HAS_SELECTOR_SERVO

    if MMU_HAS_SELECTOR_STEPPER
      prefix    := SELECTOR
      label     := Selector
      pad_width := $(pin_pad)
      source "components/Kconfig.tmc_driver_menu_pins"
      config PARAM_SELECTOR_UART_ADDRESS
        int "$(pad,$(pin_pad),Selector UART address)"
        default 1
        range 0 3
        depends on BOARD_TYPE_EASY_BRD || BOARD_TYPE_SKR_PICO_1 || BOARD_TYPE_OTHER || BOARD_TYPE_MANUAL
      config PIN_SELECTOR_STEP
        prompt "$(pad,$(pin_pad),Selector step pin)"
      config PIN_SELECTOR_DIR
        prompt "$(pad,$(pin_pad),Selector dir pin)"
      config PIN_SELECTOR_ENABLE
        prompt "$(pad,$(pin_pad),Selector enable pin)"
      config PIN_SELECTOR_ENDSTOP
        prompt "$(pad,$(pin_pad),Selector endstop pin)"
      config PIN_SELECTOR_DIAG
        prompt "$(pad,$(pin_pad),Selector diag pin)"
      config PARAM_SELECTOR_STALLGUARD_THRESHOLD
        prompt "$(pad,$(pin_pad),Selector stallguard)" if BOOL_SELECTOR_TMC_HAS_STALLGUARD && PIN_SELECTOR_DIAG != ""
        help
          Sensitivity for selector "touch" movement, written only when a
          diag pin is set. Expect to tune it. The scale depends on the chip:
          SGTHRS is 0-255 and higher is more sensitive, SGT is -64..63 and
          lower is more sensitive.
    endif

    if INDEXED_SELECTOR
      @repeat var=i min=0 max=3@
        config PIN_GATE_ENDSTOP_$(i)
          string
          prompt "$(pad,$(pin_pad),Gate $(i) endstop pin)" if PARAM_NUM_GATES > $(i)
      @endrepeat@
    endif

    config PIN_SELECTOR_SERVO
      string
      prompt "$(pad,$(pin_pad),Servo pin)" if MMU_HAS_SELECTOR_SERVO
  endmenu

# -------------------------------------
# eSpooler
# -------------------------------------

  config HAS_ESPOOLER_ENABLE_PIN
    def_bool n

  comment "_" if MMU_HAS_SELECTOR_STEPPER || MMU_HAS_SELECTOR_SERVO

  menu "eSpooler pins"
    depends on MMU_HAS_ESPOOLER

    @repeat var=i min=0 max=11@
      if PARAM_NUM_GATES > $(i)
        comment "_"
        config PIN_ESPOOLER_EN_$(i)
          string
          prompt "$(pad,$(pin_pad),eSpooler enable $(i) pin)" if HAS_ESPOOLER_ENABLE_PIN
        config PIN_ESPOOLER_RWD_$(i)
          string
          prompt "$(pad,$(pin_pad),eSpooler rewind $(i) pin)"
        config PIN_ESPOOLER_FWD_$(i)
          string
          prompt "$(pad,$(pin_pad),eSpooler forward $(i) pin)"
        config PIN_ESPOOLER_TRIG_$(i)
          string
          prompt "$(pad,$(pin_pad),eSpooler trigger $(i) pin)"
      endif
    @endrepeat@
  endmenu

# -------------------------------------
# Eject buttons
# -------------------------------------

  menu "Mmu eject buttons"
    depends on MMU_HAS_EJECT_BUTTONS

    @repeat var=i min=0 max=11@
      config PIN_EJECT_BUTTON_$(i)
        string
        prompt "$(pad,$(pin_pad),Eject button $(i) pin)" if PARAM_NUM_GATES > $(i)
    @endrepeat@
  endmenu

# -------------------------------------
# Sync-Feedback Buffer
# -------------------------------------

  @repeat var=i min=0 max=3@
    config PIN_BUFFER_SENSOR_$(i)
      string
  @endrepeat@
 
  menu "Sync-feedback Buffer"
    depends on MMU_HAS_SYNC_FEEDBACK_BUFFER && !MMU_SHARED_SYNC_FEEDBACK_BUFFER

    config PIN_BUFFER_TENSION
      string
      prompt "$(pad,$(pin_pad),Sync feedback tension pin)" if MMU_HAS_SENSOR_BUFFER_TENSION
    config PIN_BUFFER_COMPRESSION
      string
      prompt "$(pad,$(pin_pad),Sync feedback compression pin)" if MMU_HAS_SENSOR_BUFFER_COMPRESSION
    config PIN_BUFFER_ANALOG
      string
      prompt "$(pad,$(pin_pad),Proportional (analog) pin)" if MMU_HAS_SENSOR_BUFFER_PROPORTIONAL
    config PIN_BUFFER_NEOPIXEL
      string
      prompt "$(pad,$(pin_pad),Buffer neopixel pin)" if MMU_HAS_LEDS && !CUSTOM_LED_SETUP
  endmenu

# -------------------------------------
# Entry sensor
# -------------------------------------

  menu "Mmu entry sensor pins"
    depends on MMU_HAS_SENSOR_ENTRY

    @repeat var=i min=0 max=11@
      config PIN_ENTRY_SENSOR_$(i)
        string
        prompt "$(pad,$(pin_pad),Entry sensor $(i) pin)" if PARAM_NUM_GATES > $(i)
    @endrepeat@
  endmenu

# -------------------------------------
# Exit sensor
# -------------------------------------

  menu "Mmu exit sensor pins"
    depends on MMU_HAS_SENSOR_EXIT

    @repeat var=i min=0 max=11@
      config PIN_EXIT_SENSOR_$(i)
        string
        prompt "$(pad,$(pin_pad),Exit sensor $(i) pin)" if PARAM_NUM_GATES > $(i)
    @endrepeat@
  endmenu

# -------------------------------------
# Shared Exit sensor
# -------------------------------------

  config PIN_SHARED_EXIT_SENSOR
    string "$(pad,$(pin_pad),Shared exit sensor pin)" if MMU_HAS_SENSOR_SHARED_EXIT

# -------------------------------------
# Misc pins
# -------------------------------------

  config PIN_ENCODER
    string
    prompt "$(pad,$(pin_pad),Encoder pin)" if MMU_HAS_ENCODER && !MMU_SHARED_ENCODER

  config PIN_NEOPIXEL
    string
    prompt "$(pad,$(pin_pad),Neopixel pin)" if MMU_HAS_LEDS && !MMU_HAS_PER_GATE_MCU && !CUSTOM_LED_SETUP

  menu "Neopixel per-gate pins" 
    depends on MMU_HAS_LEDS && MMU_HAS_PER_GATE_MCU

    @repeat var=i min=0 max=11@
      config PIN_NEOPIXEL_$(i)
        string "$(pad,$(pin_pad),Neopixel gate $(i) pin)" if PARAM_NUM_GATES > $(i)
    @endrepeat@
  endmenu

  menu "Neopixel box pins" 
    depends on MMU_HAS_LEDS && MMU_HAS_PER_GATE_MCU

    @repeat var=i min=0 max=11@
      config PIN_NEOPIXEL_BOX_$(i)
        string "$(pad,$(pin_pad),Neopixel box gate $(i) pin)" if PARAM_NUM_GATES > $(i)
    @endrepeat@
  endmenu

# -------------------------------------
# Managed fans
# -------------------------------------

  config PIN_FAN
    string
    prompt "$(pad,$(pin_pad),Managed fan pin)" if MMU_HAS_FANS && !MMU_HAS_PER_GATE_CONFIG && !CUSTOM_FAN_SETUP

  menu "Managed fan per-gate pins"
    depends on MMU_HAS_FANS && MMU_HAS_PER_GATE_CONFIG && !CUSTOM_FAN_SETUP

    @repeat var=i min=0 max=11@
      config PIN_FAN_$(i)
        string
        prompt "$(pad,$(pin_pad),Managed fan gate $(i) pin)" if PARAM_NUM_GATES > $(i) && PARAM_FAN_GATE_$(i)
    @endrepeat@
  endmenu

# -------------------------------------
# Heater fans
# -------------------------------------

  config PIN_HEATER_FAN
    string
    prompt "$(pad,$(pin_pad),Heater fan pin)" if MMU_HAS_HEATER_FANS && !MMU_HAS_PER_GATE_CONFIG && !CUSTOM_HEATER_FAN_SETUP

  menu "Heater fan per-gate pins"
    depends on MMU_HAS_HEATER && MMU_HAS_PER_GATE_CONFIG && !CUSTOM_HEATER_FAN_SETUP

    @repeat var=i min=0 max=11@
      config PIN_HEATER_FAN_$(i)
        string
        prompt "$(pad,$(pin_pad),Heater fan gate $(i) pin)" if PARAM_NUM_GATES > $(i) && PARAM_HEATER_FAN_GATE_$(i)
    @endrepeat@
  endmenu

# -------------------------------------
# Per-printer pins
# -------------------------------------

  source "Kconfig.shared_pins"

endmenu
```

## installer/Kconfig.preload_eject
```kconfig
# This module defines types and parameters for control of the filament
# preloading and ejection.
#
# Responsible for setting:
#   PARAM_GATE_PRELOAD_ENDSTOP
#   PARAM_GATE_PRELOAD_PARKING_DISTANCE
#   PARAM_GATE_PRELOAD_HOMING_MAX
#   PARAM_GATE_AUTOLOAD
#   PARAM_GATE_PRELOAD_ATTEMPTS
#   PARAM_GATE_FINAL_EJECT_DISTANCE

menu "Filament preloading and ejection"

  # -------------------------------------
  # Gate preload endstop
  # -------------------------------------

  choice CHOICE_GATE_PRELOAD_ENDSTOP
    prompt "Gate preload endstop        "
    help
      Typically this will be the individual mmu exit sensor if one is configured, otherwise
      the same as the gate homing endstop.

    default CHOICE_GATE_PRELOAD_ENDSTOP_EXIT if MMU_HAS_SENSOR_EXIT
    default CHOICE_GATE_PRELOAD_ENDSTOP_DEFAULT

    config CHOICE_GATE_PRELOAD_ENDSTOP_DEFAULT
      bool "Same as gate homing endstop"
      help
        Use gate homing endstop (no individual mmu exit sensors are available)

    config CHOICE_GATE_PRELOAD_ENDSTOP_EXIT
      bool "Individual mmu exit sensors" if MMU_HAS_SENSOR_EXIT
      help
        Use individual per-gate exit sensor (often implemented as the per-gate hub entry sensor)
        This can be useful on type-B MMU's when preloading filament while another gate has filament
        loaded and the gate endstop is shared.

    config CHOICE_GATE_PRELOAD_ENDSTOP_NONE
      bool "No sensor / fixed move"
      help
        Perform one fixed forward preload move. The configured parking distance is ignored.
        Filament presence cannot be verified, so the gate will remain marked unknown.
        Per-gate NFC preload scanning and its associated clear/jog moves are not used.

        When crossloading, the configured distance must remain inside the target gate's
        independent filament path. Crossload capability alone does not guarantee that a
        shared hub or downstream filament path is clear.
  endchoice

  # Create no-prompt param from choice
  config PARAM_GATE_PRELOAD_ENDSTOP
    string
    default "mmu_exit" if CHOICE_GATE_PRELOAD_ENDSTOP_EXIT
    default "none"     if CHOICE_GATE_PRELOAD_ENDSTOP_NONE
    default ""         # Defaults to gate homing endstop


  # -------------------------------------
  # Movement params
  # -------------------------------------

  config PARAM_GATE_PRELOAD_HOMING_MAX
    float "Preload homing distance     "
    default PARAM_GATE_HOMING_MAX
    help
      Maximum homing distance (mm) to the configured preload endstop.

      With no preload sensor this becomes the exact fixed forward move distance.

      Usually this is the same as gate homing distance

  config PARAM_GATE_PRELOAD_PARKING_DISTANCE
    float
    prompt "Preload parking distance    " if !CHOICE_GATE_PRELOAD_ENDSTOP_NONE
    default PARAM_GATE_PARKING_DISTANCE
    help
      Filament parking distance (mm) after homing to configured gate homing sensor
      or per-gate "mmu_exit" sensor if available.
      This setting is ignored when no preload sensor is selected.
      Usually this is the same as gate parking distance

      Negative values for movement in the retract direction (back off sensor)
      Positive values for movement in the extrude direction (past sensor)

  config PARAM_GATE_AUTOLOAD
    boolint "Automatically load gate when entry sensor triggers?"
    default 1
    depends on MMU_HAS_SENSOR_ENTRY
    help
      If mmu entry sensor fitted this controls the automatic loading of the gate

  config PARAM_GATE_PRELOAD_ATTEMPTS
    int
    prompt "Number of preload attempts  " if !CHOICE_GATE_PRELOAD_ENDSTOP_NONE
    default 1 if CHOICE_GATE_PRELOAD_ENDSTOP_NONE
    default 2
    help
      Number of attempts to make at loading the filament after preload is issued.

      Fixed at one when no preload sensor is selected.

  comment "_"

  config PARAM_GATE_FINAL_EJECT_DISTANCE
    float "Final eject distance        "
    default 20
    help
      Additional distance to eject filament on MMU_EJECT to clear MMU's grip

endmenu
```
