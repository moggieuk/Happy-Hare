## installer/boards/Kconfig.chameleon_x5_1
```kconfig
#
# This is an mcu originally designed for the QuattroBox v2
# but is generically useful for other MMUs
#

config BOARD_TYPE_CHAMELEON_X5_1_0
  bool "Chameleon X5 v1 / designed for QuattroBox v2"
  help
    This board was custom designed for the QuattroBox v2

if BOARD_TYPE_CHAMELEON_X5_1_0
  config PARAM_BOARD_TYPE
    default "Chameleon X5 v1"

  config HAS_ESPOOLER_ENABLE_PIN
    default n

  choice CHOICE_MMU_CONNECTION_TYPE
    default CHOICE_MMU_CONNECTION_TYPE_SERIAL
  endchoice
  choice CHOICE_MMU_SERIAL_CONNECTION
    default $(mmu_serial_config,1,stm32)
  endchoice

  config PIN_GEAR_UART 
    default "$(MCU_NAME):PB2" 
  config PIN_GEAR_STEP
    default "$(MCU_NAME):PD10" 
  config PIN_GEAR_DIR
    default "$(MCU_NAME):PD11" 
  config PIN_GEAR_ENABLE
    default "!$(MCU_NAME):PD9" 
  config PIN_GEAR_DIAG
    default "$(MCU_NAME):PE15" 

  config PIN_GEAR_UART_1 
    default "$(MCU_NAME):PD13" 
  config PIN_GEAR_STEP_1
    default "$(MCU_NAME):PD14" 
  config PIN_GEAR_DIR_1
    default "$(MCU_NAME):PD15" 
  config PIN_GEAR_ENABLE_1
    default "!$(MCU_NAME):PA13" 
  config PIN_GEAR_DIAG_1
    default "$(MCU_NAME):PD12" 

  config PIN_GEAR_UART_2 
    default "$(MCU_NAME):PC14" 
  config PIN_GEAR_STEP_2
    default "$(MCU_NAME):PE6" 
  config PIN_GEAR_DIR_2
    default "$(MCU_NAME):PE5" 
  config PIN_GEAR_ENABLE_2
    default "!$(MCU_NAME):PE4" 
  config PIN_GEAR_DIAG_2
    default "$(MCU_NAME):PC15" 

  config PIN_GEAR_UART_3 
    default "$(MCU_NAME):PA14" 
  config PIN_GEAR_STEP_3
    default "$(MCU_NAME):PC13" 
  config PIN_GEAR_DIR_3
    default "$(MCU_NAME):PA15" 
  config PIN_GEAR_ENABLE_3
    default "!$(MCU_NAME):PC10" 
  config PIN_GEAR_DIAG_3
    default "$(MCU_NAME):PE3" 

  config PIN_GEAR_UART_4 
    default "$(MCU_NAME):PD2" 
  config PIN_GEAR_STEP_4
    default "$(MCU_NAME):PD3" 
  config PIN_GEAR_DIR_4
    default "$(MCU_NAME):PD4" 
  config PIN_GEAR_ENABLE_4
    default "!$(MCU_NAME):PC11" 
  config PIN_GEAR_DIAG_4
    default "$(MCU_NAME):PC12" 

  config PIN_ENTRY_SENSOR_0
    default "^$(MCU_NAME):PE11"
  config PIN_ENTRY_SENSOR_1
    default "^$(MCU_NAME):PB1"
  config PIN_ENTRY_SENSOR_2
    default "^$(MCU_NAME):PA0"
  config PIN_ENTRY_SENSOR_3
    default "^$(MCU_NAME):PA4"
  config PIN_ENTRY_SENSOR_4
    default "^$(MCU_NAME):PE8"

  config PIN_EXIT_SENSOR_0
    default "^$(MCU_NAME):PE10"
  config PIN_EXIT_SENSOR_1
    default "^$(MCU_NAME):PE7"
  config PIN_EXIT_SENSOR_2
    default "^$(MCU_NAME):PA1"
  config PIN_EXIT_SENSOR_3
    default "^$(MCU_NAME):PA3"
  config PIN_EXIT_SENSOR_4
    default "^$(MCU_NAME):PE9"  


  config PIN_ENCODER
    default "^$(MCU_NAME):PA5"

  config PIN_NEOPIXEL
    default "$(MCU_NAME):PA2" 


  # Aka "Hub"
  config PIN_SHARED_EXIT_SENSOR
    default "^$(MCU_NAME):PA6"


  config PIN_BUFFER_TENSION
    default "^$(MCU_NAME):PC5"
  config PIN_BUFFER_COMPRESSION
    default "^$(MCU_NAME):PA7"


  config PIN_EJECT_BUTTON_0
    default "^$(MCU_NAME):PB14"
  config PIN_EJECT_BUTTON_1
    default "^$(MCU_NAME):PB12"
  config PIN_EJECT_BUTTON_2
    default "^$(MCU_NAME):PD8"
  config PIN_EJECT_BUTTON_3
    default "^$(MCU_NAME):PE14"
  config PIN_EJECT_BUTTON_4
    default "^$(MCU_NAME):PE12"


  # -------------------------------------
  # Environment sensor (I2C1 header)
  # PA8/PC9 is also the F407's hardware bus "i2c3"
  # -------------------------------------

  choice CHOICE_ENVIRONMENT_SENSOR_I2C_BUS_TYPE
    default CHOICE_ENVIRONMENT_SENSOR_I2C_SOFTWARE
  endchoice
  config PIN_ENVIRONMENT_SENSOR_SCL
    default "PA8"
  config PIN_ENVIRONMENT_SENSOR_SDA
    default "PC9"


  # -------------------------------------
  # Heater fans (FAN2 + FAN3)
  # -------------------------------------

  config PIN_HEATER_FAN
    default "$(MCU_NAME):PB8, $(MCU_NAME):PB9"


  # -------------------------------------
  # Managed fan (FAN4)
  # -------------------------------------

  config PIN_FAN
    default "$(MCU_NAME):PB5"


  # -------------------------------------
  # QuattroBox v2 wiring (only with that machine)
  # Proportional buffer on the T2 thermistor port, heater on HEAT0 averaging
  # T0 and T1, outside BME280 on I2C1, exhaust servo on CH4's LED pin (unused
  # with four gates) and the board fan on FAN1
  # -------------------------------------

  config PIN_BUFFER_ANALOG
    default "$(MCU_NAME):PC2" if MMU_TYPE_QUATTRO_BOX_2_0


  # -------------------------------------
  # Custom heater setup
  # -------------------------------------

  config CUSTOM_HEATER_SETUP
    def_bool y if MMU_TYPE_QUATTRO_BOX_2_0

mh_heater_chameleon_x5_1 := \
[temperature_sensor $(UNIT_NAME)_Heater_A]\n\
sensor_type: Generic 3950\n\
sensor_pin: $(MCU_NAME):PC0\n\
\n\
[temperature_sensor $(UNIT_NAME)_Heater_B]\n\
sensor_type: Generic 3950\n\
sensor_pin: $(MCU_NAME):PC1\n\
\n\
[heater_generic $(UNIT_NAME)_heater]\n\
heater_pin: $(MCU_NAME):PC6\n\
sensor_type: temperature_combined\n\
sensor_list: temperature_sensor $(UNIT_NAME)_Heater_A$(comma) temperature_sensor $(UNIT_NAME)_Heater_B\n\
combination_method: mean\n\
maximum_deviation: 50\n\
control: pid\n\
pid_Kp: 51.604\n\
pid_Ki: 1.121\n\
pid_Kd: 593.934\n\
min_temp: -100\n\
max_temp: 110\n\
\n\


  # -------------------------------------
  # Custom controller fan setup
  # -------------------------------------

mh_controller_fan_chameleon_x5_1 := \
# Electronics cooling fan\n\
[controller_fan $(UNIT_NAME)_fan]\n\
stepper: mmu_stepper $(UNIT_NAME)_gear$(comma) mmu_stepper $(UNIT_NAME)_gear_1$(comma) mmu_stepper $(UNIT_NAME)_gear_2$(comma) mmu_stepper $(UNIT_NAME)_gear_3\n\
pin: $(MCU_NAME):PB4\n\
max_power: 0.8\n\
shutdown_speed: 0.0\n\
fan_speed: 1.0\n\
\n\


  # -------------------------------------
  # Other custom setup
  # -------------------------------------

mh_other_chameleon_x5_1 := \
[temperature_sensor $(UNIT_NAME)_Outside]\n\
sensor_type: BME280\n\
i2c_address: 119\n\
i2c_mcu: $(MCU_NAME)\n\
i2c_software_scl_pin: $(MCU_NAME):PA8\n\
i2c_software_sda_pin: $(MCU_NAME):PC9\n\
\n\
[mmu_servo $(UNIT_NAME)_exhaust]\n\
pin: $(MCU_NAME):PB0\n\
minimum_pulse_width: 0.001\n\
maximum_pulse_width: 0.002\n\
maximum_servo_angle: 180\n\
\n\


  config PARAM_MISC_HARDWARE
    default "$(ml,$(mh_heater_chameleon_x5_1)$(mh_controller_fan_chameleon_x5_1)$(mh_other_chameleon_x5_1))" if MMU_TYPE_QUATTRO_BOX_2_0 && MMU_HAS_HEATER && CUSTOM_HEATER_SETUP
    default "$(ml,$(mh_controller_fan_chameleon_x5_1)$(mh_other_chameleon_x5_1))"                            if MMU_TYPE_QUATTRO_BOX_2_0

endif
```

## installer/boards/Kconfig.erb_1
```kconfig
config BOARD_TYPE_ERB_1
  bool "Fysetc Burrows ERB v1"

if BOARD_TYPE_ERB_1
  config PARAM_BOARD_TYPE
    default "Fysetc Burrows ERB v1"

  choice CHOICE_MMU_CONNECTION_TYPE
    default CHOICE_MMU_CONNECTION_TYPE_SERIAL
  endchoice
  choice CHOICE_MMU_SERIAL_CONNECTION
    default $(mmu_serial_config,1,rp2040)
  endchoice

  config PIN_GEAR_UART
    default "$(MCU_NAME):gpio20" 
  config PIN_GEAR_STEP
    default "$(MCU_NAME):gpio10" 
  config PIN_GEAR_DIR
    default "!$(MCU_NAME):gpio9" 
  config PIN_GEAR_ENABLE
    default "!$(MCU_NAME):gpio8"
  config PIN_GEAR_DIAG
    default "$(MCU_NAME):gpio13"

  config PIN_SELECTOR_UART
    default "$(MCU_NAME):gpio17" 
  config PIN_SELECTOR_STEP
    default "$(MCU_NAME):gpio16" 
  config PIN_SELECTOR_DIR
    default "!$(MCU_NAME):gpio15" 
  config PIN_SELECTOR_ENABLE
    default "!$(MCU_NAME):gpio14" 
  config PIN_SELECTOR_DIAG
    default "$(MCU_NAME):gpio19"
  config PIN_SELECTOR_ENDSTOP
    default "^$(MCU_NAME):gpio24"
  config PIN_SELECTOR_SERVO
    default "$(MCU_NAME):gpio23" 

  config PIN_ENTRY_SENSOR_0
    default "^$(MCU_NAME):gpio0"
  config PIN_ENTRY_SENSOR_1
    default "^$(MCU_NAME):gpio1"
  config PIN_ENTRY_SENSOR_2
    default "^$(MCU_NAME):gpio2"
  config PIN_ENTRY_SENSOR_3
    default "^$(MCU_NAME):gpio3"
  config PIN_ENTRY_SENSOR_4
    default "^$(MCU_NAME):gpio4"
  config PIN_ENTRY_SENSOR_5
    default "^$(MCU_NAME):gpio5"
  config PIN_ENTRY_SENSOR_6
    default "^$(MCU_NAME):gpio6"
  config PIN_ENTRY_SENSOR_7
    default "^$(MCU_NAME):gpio7"
  config PIN_ENTRY_SENSOR_8
    default "^$(MCU_NAME):gpio26"
  config PIN_ENTRY_SENSOR_9
    default "^$(MCU_NAME):gpio27"
  config PIN_ENTRY_SENSOR_10
    default "^$(MCU_NAME):gpio28"
  config PIN_ENTRY_SENSOR_11
    default "^$(MCU_NAME):gpio29"

  config PIN_ENCODER
    default "^$(MCU_NAME):gpio22" if MMU_HAS_ENCODER
  config PIN_SHARED_EXIT_SENSOR
    default "^$(MCU_NAME):gpio22" if !MMU_HAS_ENCODER
  config PIN_NEOPIXEL
    default "$(MCU_NAME):gpio21"

# No fan headers

  # The I2C1 pins on the EXTRA PINS header: hardware i2c1b, SCL gpio7 / SDA gpio6.
  # They are also entry sensors 6 and 7, so the bus is only free up to six gates
  # The header has no 3.3V: pull-ups to 5V would back-drive the RP2040
  i2c_board       := BOARD_TYPE_ERB_1 && PARAM_NUM_GATES <= 6
  i2c_tag         := ERB_1_I2C1
  i2c_bus         := i2c1b
  i2c_label       := i2c1b [[DIM]]/ I2C1 pins[[/DIM]]
  i2c_env         := y
  i2c_env_default := n
  i2c_nfc         := y
  i2c_nfc_default := n
  source "components/Kconfig.i2c_board_bus"
endif
```

## installer/boards/Kconfig.mmb_1_1
```kconfig
config BOARD_TYPE_MMB_1_1
  bool "BTT MMB v1.1 with CANbus"

if BOARD_TYPE_MMB_1_1
  config PARAM_BOARD_TYPE
    default "BTT MMB v1.1"

  choice CHOICE_MMU_CONNECTION_TYPE
    default CHOICE_MMU_CONNECTION_TYPE_SERIAL
  endchoice
  choice CHOICE_MMU_SERIAL_CONNECTION
    default $(mmu_serial_config,1,stm32)
  endchoice

  config PIN_GEAR_UART 
    default "$(MCU_NAME):PA10" 
  config PIN_GEAR_STEP
    default "$(MCU_NAME):PB15" 
  config PIN_GEAR_DIR
    default "$(MCU_NAME):PB14" 
  config PIN_GEAR_ENABLE
    default "!$(MCU_NAME):PB8" 
  # Diag pins share headers with sensors; a fitted sensor keeps the header
  config PIN_GEAR_DIAG
    default "$(MCU_NAME):PA3" if !(MULTIGEAR && MMU_HAS_SENSOR_ENTRY && PIN_ENTRY_SENSOR_1 = "$(MCU_NAME):PA3") && \
        !(MMU_HAS_SENSOR_SHARED_EXIT && PIN_SHARED_EXIT_SENSOR = "^$(MCU_NAME):PA3")

  if MULTIGEAR
    config PIN_GEAR_UART_1 
      default "$(MCU_NAME):PC7" 
    config PIN_GEAR_STEP_1
      default "$(MCU_NAME):PD2" 
    config PIN_GEAR_DIR_1
      default "$(MCU_NAME):PB13" 
    config PIN_GEAR_ENABLE_1
      default "!$(MCU_NAME):PD1" 
    config PIN_GEAR_DIAG_1
      default "$(MCU_NAME):PA4" 

    config PIN_GEAR_UART_2 
      default "$(MCU_NAME):PC6" 
    config PIN_GEAR_STEP_2
      default "$(MCU_NAME):PD0" 
    config PIN_GEAR_DIR_2
      default "$(MCU_NAME):PD3" 
    config PIN_GEAR_ENABLE_2
      default "!$(MCU_NAME):PA15" 
    config PIN_GEAR_DIAG_2
      default "$(MCU_NAME):PB9" if !(MMU_HAS_SENSOR_ENTRY && PIN_ENTRY_SENSOR_2 = "$(MCU_NAME):PB9")

    config PIN_GEAR_UART_3 
      default "$(MCU_NAME):PA9" 
    config PIN_GEAR_STEP_3
      default "$(MCU_NAME):PB6" 
    config PIN_GEAR_DIR_3
      default "$(MCU_NAME):PB7" 
    config PIN_GEAR_ENABLE_3
      default "!$(MCU_NAME):PB5" 
    config PIN_GEAR_DIAG_3
      default "$(MCU_NAME):PA8" if !(MMU_HAS_SENSOR_ENTRY && PIN_ENTRY_SENSOR_3 = "$(MCU_NAME):PA8")

    config PIN_ENTRY_SENSOR_0
      default "$(MCU_NAME):PB11" 
    config PIN_ENTRY_SENSOR_1
      default "$(MCU_NAME):PA3" 
    config PIN_ENTRY_SENSOR_2
      default "$(MCU_NAME):PB9" 
    config PIN_ENTRY_SENSOR_3
      default "$(MCU_NAME):PA8" 

    config PIN_EXIT_SENSOR_0
      default "$(MCU_NAME):PC15"
    config PIN_EXIT_SENSOR_1
      default "$(MCU_NAME):PC13"
    config PIN_EXIT_SENSOR_2
      default "$(MCU_NAME):PC14"
    config PIN_EXIT_SENSOR_3
      default "$(MCU_NAME):PB12"
    
    config PIN_ESPOOLER_RWD_0
      default "$(MCU_NAME):PA0"
    config PIN_ESPOOLER_RWD_1
      default "$(MCU_NAME):PA1" if !(MMU_HAS_ENCODER && PIN_ENCODER = "^$(MCU_NAME):PA1")
    config PIN_ESPOOLER_RWD_2
      default "$(MCU_NAME):PB10"
    config PIN_ESPOOLER_RWD_3
      default "$(MCU_NAME):PB2"
  endif

  if !MULTIGEAR
    config PIN_SELECTOR_UART
      default "$(MCU_NAME):PC7" 
    config PIN_SELECTOR_STEP
      default "$(MCU_NAME):PD2" 
    config PIN_SELECTOR_DIR
      default "$(MCU_NAME):PB13" 
    config PIN_SELECTOR_ENABLE
      default "!$(MCU_NAME):PD1" 
    config PIN_SELECTOR_DIAG
      default "$(MCU_NAME):PA4" 
    config PIN_SELECTOR_ENDSTOP
      default "^$(MCU_NAME):PB2" 
    config PIN_SELECTOR_SERVO
      default "$(MCU_NAME):PA0" 

    config PIN_ENTRY_SENSOR_0
      default "^$(MCU_NAME):PB9" 
    config PIN_ENTRY_SENSOR_1
      default "^$(MCU_NAME):PA8" 
    config PIN_ENTRY_SENSOR_2
      default "^$(MCU_NAME):PC15" 
    config PIN_ENTRY_SENSOR_3
      default "^$(MCU_NAME):PC13" 
    config PIN_ENTRY_SENSOR_4
      default "^$(MCU_NAME):PC14"
    config PIN_ENTRY_SENSOR_5
      default "^$(MCU_NAME):PB12"
    config PIN_ENTRY_SENSOR_6
      default "^$(MCU_NAME):PB11"
    config PIN_ENTRY_SENSOR_7
      default "^$(MCU_NAME):PB10"
  endif

  config PIN_ENCODER
    default "^$(MCU_NAME):PA1" if MMU_HAS_ENCODER
  config PIN_NEOPIXEL
    default "$(MCU_NAME):PA2" 
  config PIN_SHARED_EXIT_SENSOR
    default "^$(MCU_NAME):PA3" if !MMU_HAS_ENCODER && !(MULTIGEAR && MMU_HAS_SENSOR_ENTRY && PIN_ENTRY_SENSOR_1 = "$(MCU_NAME):PA3")

# No fan headers (the MOT header is a 5V servo output)

  # I2C header: hardware i2c3, SCL PB3 / SDA PB4 (BTT's schematic notes call it I2C2)
  i2c_board       := BOARD_TYPE_MMB_1_1
  i2c_tag         := MMB_1_1_I2C3
  i2c_bus         := i2c3_PB3_PB4
  i2c_label       := i2c3_PB3_PB4 [[DIM]]/ I2C header[[/DIM]]
  i2c_env         := y
  i2c_env_default := y
  i2c_nfc         := y
  i2c_nfc_default := n
  source "components/Kconfig.i2c_board_bus"
endif
```

## installer/boards/Kconfig.owlfc_mini_1_0
```kconfig
#
# OwlFC-Mini v1.0 is a two-lane controller designed for NightOwl.
#

config BOARD_TYPE_OWLFC_MINI_1_0
  bool "OwlFC-Mini v1.0 / designed for NightOwl"
  depends on PARAM_NUM_GATES <= 2
  help
    Custom controller designed for NightOwl. The board supports a
    maximum of two lanes.

if BOARD_TYPE_OWLFC_MINI_1_0
  config PARAM_BOARD_TYPE
    default "OwlFC-Mini v1.0"

  choice CHOICE_MMU_CONNECTION_TYPE
    default CHOICE_MMU_CONNECTION_TYPE_SERIAL
  endchoice
  choice CHOICE_MMU_SERIAL_CONNECTION
    default $(mmu_serial_config,1,stm32)
  endchoice

  config PARAM_GEAR_SENSE_RESISTOR
    default 0.180

  # Motor 1 / lane 1
  config PIN_GEAR_UART
    default "$(MCU_NAME):PB13"
  config PIN_GEAR_STEP
    default "$(MCU_NAME):PB15"
  config PIN_GEAR_DIR
    default "$(MCU_NAME):PB14"
  config PIN_GEAR_ENABLE
    default "!$(MCU_NAME):PA8"

  # Motor 2 / lane 2
  config PIN_GEAR_UART_1
    default "$(MCU_NAME):PC7"
  config PIN_GEAR_STEP_1
    default "$(MCU_NAME):PC6"
  config PIN_GEAR_DIR_1
    default "$(MCU_NAME):PA9"
  config PIN_GEAR_ENABLE_1
    default "!$(MCU_NAME):PA10"

  config PIN_ENTRY_SENSOR_0
    default "^$(MCU_NAME):PB1"
  config PIN_EXIT_SENSOR_0
    default "^$(MCU_NAME):PB11"
  config PIN_ENTRY_SENSOR_1
    default "^$(MCU_NAME):PB12"
  config PIN_EXIT_SENSOR_1
    default "^$(MCU_NAME):PB4"

  config PIN_SHARED_EXIT_SENSOR
    default "^$(MCU_NAME):PB5"

  config PIN_BUFFER_COMPRESSION
    default "^$(MCU_NAME):PA2"
  config PIN_BUFFER_TENSION
    default "^$(MCU_NAME):PA3"

  config PIN_NEOPIXEL
    default "$(MCU_NAME):PB3"

  # Unassigned spare switch inputs:
  #   SW6: PB10
  #   SW7: PB2

endif
```
