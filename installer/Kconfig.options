## installer/Kconfig.toolhead
```kconfig
# Type setting and raw modification of toolhead dimensional parameters and toolhead sensors:
#
# Although a toolhead can be unique to each mmu unit this installer currently
# assumes a single one is configured, named "default" in the mmu.cfg
#
# Responsible for defining/setting:
#   MMU_HAS_SENSOR_TOOLHEAD (and PIN_EXTRUDER_SENSOR)
#   MMU_HAS_SENSOR_EXTRUDER (and PIN_EXTRUDER_SENSOR)
#   MMU_HAS_TOOLHEAD_CUTTER
#
# Responsible for setting:
#   PARAM_TOOLHEAD_EXTRUDER_TO_NOZZLE
#   PARAM_TOOLHEAD_SENSOR_TO_NOZZLE
#   PARAM_TOOLHEAD_ENTRY_TO_EXTRUDER
#   PARAM_TOOLHEAD_RESIDUAL_FILAMENT
#   PARAM_TOOLHEAD_OOZE_REDUCTION
#   PARAM_TOOLHEAD_UNLOAD_SAFETY_MARGIN
#   PARAM_TOOLHEAD_UNLOAD_VALIDATION

config MMU_HAS_SENSOR_TOOLHEAD
  def_bool n

config PIN_TOOLHEAD_SENSOR
  string

config MMU_HAS_SENSOR_EXTRUDER
  def_bool n

config PIN_EXTRUDER_SENSOR
  string

config MMU_HAS_TOOLHEAD_CUTTER
  def_bool n


menu "Toolhead sensors/settings"
  help
    Configure toolhead sensors and physical dimensions of your toolhead.

    Also configure some properties like how much filament remains in the extruder after unload.
    They are used to ensure exact toolhead filament loading without excessive oozing.
    Note: If you have a toolhead sensor you can automate the calculation of these parameters!
    Read about the 'MMU_CALIBRATE_TOOLHEAD' command in the Toolhead Calibration doc:
    https://moggieuk.github.io/Happy-Hare-Doc/Calibration-Toolhead/

# -------------------------------------
# Toolhead features
# -------------------------------------

  config MMU_HAS_TOOLHEAD_CUTTER
    prompt "Has toolhead cutter?"
    help
      Select if you have a filament cutter built into the toolhead that
      uses toolhead motion for cutting action.

      The cutting macro will automatically be added


# -------------------------------------
# Toolhead sensors
# -------------------------------------

  comment "_"
  comment "_Toolhead sensors"

  config MMU_HAS_SENSOR_TOOLHEAD
    prompt "Has toolhead sensor?"
    help
      Select if you have a filament sensor inside of your toolhead after
      the extruder drive. This is normally connected to a pin on your main
      printer MCU so specify it here.

  config PIN_TOOLHEAD_SENSOR
    prompt "Toolhead sensor pin    "
    validator "$(pin_validator)"
    depends on MMU_HAS_SENSOR_TOOLHEAD
    help
      Can also be set under "Pins" section
      $(pin_help)

  config MMU_HAS_SENSOR_EXTRUDER
    prompt "Has extruder (entry) sensor?"
    help
      Select if you have a filament sensor at or just prior to
      the extruder entry. This is normally connected to a pin on your main
      printer MCU so specify it here.
  
  config PIN_EXTRUDER_SENSOR
    prompt "Extruder sensor pin    "
    validator "$(pin_validator)"
    depends on MMU_HAS_SENSOR_EXTRUDER
    help
      Can also be set under "Pins" section
      $(pin_help)

  config PARAM_REGISTER_TOOLHEAD_SENSORS
    boolint "Register toolhead sensors in Mainsail/Fluidd"
    default 1
    help
      Whether to register the sensors for visibility in klipper UI's
      and with QUERY_SENSOR command. There is no harm in doing this but
      it can be disabled to reduce clutter.
# -------------------------------------
# Toolhead dimensions
# -------------------------------------

  comment "_"
  comment "_Toolhead dimensions"
  comment "Toolhead: [[VALUE:PARAM_TOOLHEAD_TYPE]]" if !CHOICE_TOOLHEAD_TYPE_OTHER
    dim

  config PARAM_TOOLHEAD_EXTRUDER_TO_NOZZLE
    float "Extruder entrance to nozzle"
    help
      Distance (mm) from extruder gears (entrance) to nozzle

  config PARAM_TOOLHEAD_SENSOR_TO_NOZZLE
    float "Toolhead sensor to nozzle  "
    help
      Distance (mm) from "toolhead" sensor to nozzle
    depends on MMU_HAS_SENSOR_TOOLHEAD

  config PARAM_TOOLHEAD_ENTRY_TO_EXTRUDER
    float "Extruder sensor to entry   "
    help
      Distance (mm) from extruder "entry" sensor to extruder gears
    depends on MMU_HAS_SENSOR_EXTRUDER

  config PARAM_TOOLHEAD_RESIDUAL_FILAMENT
    float "Residual filament          "
    help
      This setting represents how much residual filament (mm) is left behind in the nozzle when filament is
      removed. it is thus used to reduce the extruder loading length and prevent excessive blobbing but also
      in the calculation of purge volume.
      Note that this value can also be measured with 'MMU_CALIBRATE_TOOLHEAD' command.
      See "Calibrating the Toolhead" in the Blobbing and Stringing doc:
      https://moggieuk.github.io/Happy-Hare-Doc/Blobbing-and-Stringing/

# This is for tuning and can mask other issues with toolhead dimensions
  config PARAM_TOOLHEAD_OOZE_REDUCTION
    float "Ooze reduction             "
    range -5 5
    default 0
    help
      This is for tuning to fix blobbing. Zero or a small positive value is normal: positive values reduce
      the extruder load length. If using a wipetower and you experience blobs on it, increase this value
      (reduce the quantity of filament loaded). If you experience gaps, decrease this value.
      Negative values increase the extruder load length and may indicate that 'toolhead_residual_filament'
      is too large or 'toolhead_extruder_to_nozzle' is too small. Check these settings if a negative value
      is needed. Needing more than +5mm of reduction also suggests the toolhead settings are incorrect.
      Recommend starting with 0

  # Per unit in a multi-unit setup (Endstops and Bowden movement)
  config PARAM_TOOLHEAD_UNLOAD_SAFETY_MARGIN
    float "Unload safety margin       " if !MULTI_UNIT
    default 10
    help
      Extra movement (mm) added to the extruder unload movement to ensure filament is free of the extruder.
      This provides tolerance for slightly incorrect configuration or extruder slippage.

  config PARAM_TOOLHEAD_UNLOAD_VALIDATION
    int "Unload validation          " if !MULTI_UNIT
    range 0 2
    default 0
    help
      0 = existing warnings only, 1 = also validate the extruder unload and warn, 2 = pause instead.
      With a toolhead or extruder sensor the distance taken to clear it is checked against the tip park
      position. That can catch a missed cut if the cut fragment (blade_pos - retract_length) is big enough.
      Without one the encoder or sync-feedback buffer checks the filament left the extruder.
      Try 1 first and check the debug log before using 2.

endmenu
```

## installer/Kconfig.vent
```kconfig
# Vent servo(s) of the heated chamber. Sourced from Kconfig.heater: venting is part of
# the drying cycle, so it is only offered with a heater (but not tied to a heater fan)
#
# Responsible for setting:
#   MMU_HAS_VENT_SERVO
#
# Vent servo parameter tokens which must be inside if MMU_HAS_VENT_SERVO clause in cfg templates:
#   PIN_VENT_SERVO, PARAM_VENT_SERVO_MIN_PULSE_WIDTH, PARAM_VENT_SERVO_MAX_PULSE_WIDTH,
#   PARAM_VENT_SERVO_MAXIMUM_ANGLE (shared configuration)
#   PARAM_VENT_SERVO_GATE_X, PIN_VENT_SERVO_X, PARAM_VENT_SERVO_MIN_PULSE_WIDTH_X,
#   PARAM_VENT_SERVO_MAX_PULSE_WIDTH_X, PARAM_VENT_SERVO_MAXIMUM_ANGLE_X
#   (per-gate configuration)
# The pulse widths and max angle come from components/Kconfig.servo
#
# Can be disabled and forced off with:
#   select UNSELECT_MMU_HAS_VENT_SERVO


config UNSELECT_MMU_HAS_VENT_SERVO
  def_bool n

# Venting is part of the drying cycle, so it needs the heater (but not a heater fan)
if MMU_HAS_HEATER && !UNSELECT_MMU_HAS_VENT_SERVO
  config MMU_HAS_VENT_SERVO
    prompt "Has enclosure vent servo?"
    default n
    help
      Select if a servo opens and closes a vent in the filament enclosure.
      Venting is part of the drying cycle: Happy Hare opens it every
      heater_vent_interval minutes while drying and closes it again after
      the vent open time. The angles and timings are set with the other
      venting options in "Heater and humidity control". With per-gate
      configuration each gate can have its own vent servo.
endif


# -------------------------------------
# Vent servo config
# -------------------------------------

menu "Vent servo h/w config"
  visible if MMU_HAS_VENT_SERVO
  help
    Configure the pin and PWM range of the enclosure vent servo, or with
    per-gate configuration of each gate's vent servo.

  if MMU_HAS_VENT_SERVO
    config PIN_VENT_SERVO
      string
      prompt "Vent servo pin       " if !MMU_HAS_PER_GATE_CONFIG
      validator "$(pin_validator)"
      default ""
      help
        $(pin_help)
  endif

  prefix              := VENT_SERVO
  servo_suffix        :=
  servo_visible       := !MMU_HAS_PER_GATE_CONFIG
  label               := Servo
  pad_width           := 21
  servo_min_pulse     := 0.001
  servo_max_pulse     := 0.002
  servo_initial_angle :=
  servo_initial_on    :=
  servo_rest_angle    :=
  servo_min_hint      :=
  servo_max_hint      :=
  servo_angle_hint    :=
  source "components/Kconfig.servo"

  @repeat var=i min=0 max=11@
    menuconfig PARAM_VENT_SERVO_GATE_$(i)
      bool
      prompt "Gate $(i) vent servo" if MMU_HAS_PER_GATE_CONFIG && PARAM_NUM_GATES > $(i)
      default y if MMU_HAS_VENT_SERVO && MMU_HAS_PER_GATE_CONFIG && PARAM_NUM_GATES > $(i)
      help
        This gate has its own enclosure vent servo, opened while the
        gate is drying.

    if PARAM_VENT_SERVO_GATE_$(i)
      config PIN_VENT_SERVO_$(i)
        string "Vent servo pin       "
        validator "$(pin_validator)"
        help
          Leave blank if this gate does not have a vent servo installed.
    endif

    prefix              := VENT_SERVO
    servo_suffix        := _$(i)
    servo_visible       := MMU_HAS_PER_GATE_CONFIG && PARAM_NUM_GATES > $(i) && PARAM_VENT_SERVO_GATE_$(i)
    label               := Servo
    pad_width           := 21
    servo_min_pulse     := 0.001
    servo_max_pulse     := 0.002
    servo_initial_angle :=
    servo_initial_on    :=
    servo_rest_angle    :=
    servo_min_hint      :=
    servo_max_hint      :=
    servo_angle_hint    :=
    source "components/Kconfig.servo"
  @endrepeat@

endmenu
```
