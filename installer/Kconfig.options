## installer/Kconfig.purging
```kconfig
# Defines parameter token types and defaults for purging
#
# Feature flags and derived bus settings:
#   MMU_HAS_BLOBIFIER
#   MMU_HAS_BLOBIFIER_BUCKET_SWITCH
#   BOOL_BLOBIFIER_TMC_CAN_UART
#   BOOL_BLOBIFIER_TMC_CAN_SPI
#   BOOL_BLOBIFIER_TMC_SPI
#   BOOL_BLOBIFIER_TMC_HAS_HOLD_CURRENT
#   BOOL_BLOBIFIER_TMC_HAS_STEALTHCHOP
#   BOOL_BLOBIFIER_TMC_HAS_RREF
#   BOOL_BLOBIFIER_TMC_SPI_SOFTWARE
#
# Blobifier bucket switch:
#   PIN_BLOBIFIER_BUCKET_SWITCH
#
# Blobifier servo tray:
#   PIN_BLOBIFIER_SERVO
#   PARAM_BLOBIFIER_MINIMUM_PULSE_WIDTH
#   PARAM_BLOBIFIER_MAXIMUM_PULSE_WIDTH
#
# Blobifier stepper tray: (only used when CHOICE_BLOBIFIER_TYPE_STEPPER)
#   PIN_BLOBIFIER_STEP
#   PIN_BLOBIFIER_DIR
#   PIN_BLOBIFIER_ENABLE
#   PIN_BLOBIFIER_ENDSTOP
#   PARAM_BLOBIFIER_TMC
#   PIN_BLOBIFIER_UART
#   PIN_BLOBIFIER_CS
#   PIN_BLOBIFIER_SPI_SCLK
#   PIN_BLOBIFIER_SPI_MOSI
#   PIN_BLOBIFIER_SPI_MISO
#   PARAM_BLOBIFIER_SPI_BUS
#   PARAM_BLOBIFIER_RUN_CURRENT
#   PARAM_BLOBIFIER_HOLD_CURRENT
#   PARAM_BLOBIFIER_SENSE_RESISTOR
#   PARAM_BLOBIFIER_RREF
#
# Purge macro and behavior:
#   PARAM_PURGE_MACRO
#   PARAM_FORCE_PURGE_STANDALONE
#   PARAM_EXTRUDER_PURGE_CURRENT

config MMU_HAS_BLOBIFIER
  def_bool n

config PIN_BLOBIFIER_SERVO
  string
  default ""

config PIN_BLOBIFIER_BUCKET_SWITCH
  string
  default ""

config MMU_HAS_BLOBIFIER_BUCKET_SWITCH
  bool
  default y

config PIN_BLOBIFIER_STEP
  string
  default ""

config PIN_BLOBIFIER_DIR
  string
  default ""

config PIN_BLOBIFIER_ENABLE
  string
  default ""

config PIN_BLOBIFIER_ENDSTOP
  string
  default ""

# The TMC driver definitions are shared with the other steppers. Every
# variable is re-assigned immediately before each source, because they are
# global for the whole parse and Kconfig.purging is itself sourced twice.
prefix       := BLOBIFIER
run_current  := 0.6
hold_current := 0.1
stallguard   := 0
source "components/Kconfig.tmc_driver_types"


# -------------------------------------
# Purging menu
# -------------------------------------

menu "Purging"
  help
    Purging

  # -------------------------------------
  # Blobifier configuration
  # -------------------------------------

  config MMU_HAS_BLOBIFIER
    prompt "Have Blobifier?"
    help
      Enable this if you have a Blobifier purging system fitted.

      NOTE: There is a lot of setup for Blobifier. After enabling this
      be sure to edit Macro variables

  if MMU_HAS_BLOBIFIER
    config MMU_HAS_BLOBIFIER_BUCKET_SWITCH
      prompt "Have Blobifier bucket switch?"
      help
        Enable this only if a switch detects whether the Blobifier collection
        bucket is installed. Blobifier itself does not require a bucket switch.

    if MMU_HAS_BLOBIFIER_BUCKET_SWITCH
      config PIN_BLOBIFIER_BUCKET_SWITCH
        prompt "Blobifier bucket switch pin"
        help
          The pull-up ( ^ ) is important here. For example: ^mcu:PA1
    endif

    choice CHOICE_BLOBIFIER_TYPE
      prompt "Blobifier tray actuator    "
      default CHOICE_BLOBIFIER_TYPE_SERVO
      help
        How the Blobifier tray is actuated: a servo (default) or a manual_stepper.

      config CHOICE_BLOBIFIER_TYPE_SERVO
        bool "Servo"
      config CHOICE_BLOBIFIER_TYPE_STEPPER
        bool "Stepper"
    endchoice

    if CHOICE_BLOBIFIER_TYPE_SERVO
      config PIN_BLOBIFIER_SERVO
        prompt "Blobifier servo pin        "

      config PARAM_BLOBIFIER_MINIMUM_PULSE_WIDTH
        float "Servo min pulse width      "
        default 0.00053
        help
          Adjust until a 'BLOBIFIER_SERVO POS=out' extends the tray fully without a buzzing sound

          The default value is likely to be close so don't worry about this for now

      config PARAM_BLOBIFIER_MAXIMUM_PULSE_WIDTH
        float "Servo max pulse width      "
        default 0.0023
        help
          Adjust until a 'BLOBIFIER_SERVO POS=in' retracts the tray fully without a buzzing sound

          The default value is likely to be close so don't worry about this for now
    endif

    if CHOICE_BLOBIFIER_TYPE_STEPPER
      config PIN_BLOBIFIER_STEP
        prompt "Stepper step pin           "
      config PIN_BLOBIFIER_DIR
        prompt "Stepper dir pin            "
      config PIN_BLOBIFIER_ENABLE
        prompt "Stepper enable pin         "
      config PIN_BLOBIFIER_ENDSTOP
        prompt "Stepper endstop pin        "
        help
          The pull-up/invert ( ^! ) is typically required here
      prefix     := BLOBIFIER
      label      := Stepper
      pad_width  := 27
      source "components/Kconfig.tmc_driver_menu"
      source "components/Kconfig.tmc_driver_menu_pins"
      source "components/Kconfig.tmc_driver_menu_current"
    endif
  endif


  # -------------------------------------
  # Standalone purge choice
  # -------------------------------------

  comment "_"
  comment "_Essential purge configuration"

  choice CHOICE_PURGE_MACRO
    prompt "Select standalone purging option"
    default CHOICE_PURGE_MACRO_BLOBIFIER if MMU_HAS_BLOBIFIER
    default CHOICE_PURGE_MACRO_PURGE
    help
      How to perform standalone purging operation.

    config CHOICE_PURGE_MACRO_PURGE
      bool "Simple purge into bucket"
      help
        This simple built in macro simply purges the required volume of
        filament.  Position can be controlled so this is done into a
        purge bucket.

    if MMU_HAS_BLOBIFIER
      config CHOICE_PURGE_MACRO_BLOBIFIER
        bool "Blobifier"
        help
          This popular choice purges into "poop" sized pellets which
          are optionally caught by a collection bucket.
    endif

    config CHOICE_PURGE_MACRO_SLICER
      bool "Slicer managed"
      help
        Purging is controlled and managed by the slicer rather than Happy-Hare.

    config CHOICE_PURGE_MACRO_OTHER
      bool "Other / manually entered"
      help
        Specify a custom macro to call to perform purging

    config PURGE_MACRO_OTHER
      string "Purging macro" if CHOICE_PURGE_MACRO_OTHER
      default "-enter-your-macro-"
      help
        Name of macro to call to perform the standalone purging operation.
  endchoice

  config PARAM_PURGE_MACRO
    string
    default "_MMU_PURGE"      if CHOICE_PURGE_MACRO_PURGE
    default "BLOBIFIER"       if CHOICE_PURGE_MACRO_BLOBIFIER
    default ""                if CHOICE_PURGE_MACRO_SLICER
    default PURGE_MACRO_OTHER if CHOICE_PURGE_MACRO_OTHER
    default ""


  # -------------------------------------
  # Other purge options
  # -------------------------------------

  config PARAM_FORCE_PURGE_STANDALONE
    boolint "Happy Hare controlled in-print purge"
    default 0 if CHOICE_PURGE_MACRO_SLICER
    default 1
    help
      You can choose whether you want the slicer or Happy Hare (recommended) to control filament purging.
      To use intelligent volume purging or purge systems like Blobifier ensure this selection is checked
      and be sure to TURN OFF in your slicer
  config PARAM_EXTRUDER_PURGE_CURRENT
    int "Extruder purging current       "
    default 100
    help
      % of extruder current (100%-150%) to use when purging (100 to disable feature)

endmenu
```

## installer/Kconfig.selector_stepper
```kconfig
# Selector stepper parameter tokens for hardware and speeds
# Must be in a "if MMU_HAS_SELECTOR" clause in cfg templates
#
# Responsible for setting:
#   PARAM_SELECTOR_GEAR_RATIO
#   PARAM_SELECTOR_ROTATION_DISTANCE
#   PARAM_SELECTOR_RUN_CURRENT
#   PARAM_SELECTOR_HOLD_CURRENT
#   PARAM_SELECTOR_ENDSTOP_NAME
#   PARAM_SELECTOR_ACCEL
#   PARAM_SELECTOR_FULL_STEPS_PER_ROTATION
#   PARAM_STARTUP_HOME_SELECTOR
#
#   PARAM_SELECTOR_TOUCH_ENABLED
#
#   PARAM_SELECTOR_GATE_DIRECTIONS
#   PARAM_SELECTOR_RELEASE_GATES


if MMU_HAS_SELECTOR_STEPPER
  menu "Selector stepper"

# -------------------------------------
# Basic stepper settings
# -------------------------------------

    config PARAM_SELECTOR_GEAR_RATIO
      string "Selector gear ratio             "
      default "1:1"

    config PARAM_SELECTOR_ROTATION_DISTANCE
      float "Selector rotation distance      "
      default 40

    config PARAM_SELECTOR_RUN_CURRENT
      float "Selector run current            "
      default 0.5

    config PARAM_SELECTOR_HOLD_CURRENT
      float "Selector hold current           "
      default 0.2

    config PARAM_SELECTOR_ENDSTOP_NAME
      string
      default "mmu_sel_home"

    config PARAM_SELECTOR_ACCEL
      float "Selector stepper acceleration   "
      default 1200

    config PARAM_SELECTOR_FULL_STEPS_PER_ROTATION
      int "Selector full steps per rotation"
      default 200
      help
        200 for 1.8 degree, 400 for 0.9 degree

    config BOOL_STARTUP_HOME_SELECTOR
      bool "Home selector at startup?"
      default n
      help
        1 = force MMU homing on startup if unloaded, then reselect the last gate used
        0 = trust the position saved at shutdown, so no homing is needed (an explicit
            MMU_MOTORS_OFF discards that saved position and does require a re-home)

    config PARAM_STARTUP_HOME_SELECTOR
      int
      default 1 if BOOL_STARTUP_HOME_SELECTOR
      default 0


# -------------------------------------
# Selector touch Operation
# -------------------------------------

  config BOOL_SELECTOR_TOUCH_ENABLED
    bool "Enable touch selector movement using TMC Stallguard?"
    help
      This allows for additional selector recovery steps but is difficult to tune.
      Not recommended if you are new to MMU/Happy-Hare.
      The MCU must have DIAG output for steppers. Possible to configure later
    depends on MMU_HAS_SELECTOR_STEPPER && (LINEAR_SELECTOR || LINEAR_SERVO_SELECTOR)
  config PARAM_SELECTOR_TOUCH_ENABLED
    int
    default 1 if BOOL_SELECTOR_TOUCH_ENABLED
    default 0

  if BOARD_TYPE_EASY_BRD
    comment " !!! IMPORTANT: Set the J6 jumper pins to 2-3 and 4-5, i.e. .[..][..] on the EASY-BRD. MAKE A NOTE NOW !!! "
      depends on BOOL_SELECTOR_TOUCH_ENABLED
    comment " !!! IMPORTANT: Set the J6 jumper pins to 1-2 and 4-5, i.e. [..].[..] on the EASY-BRD. MAKE A NOTE NOW !!! "
      depends on !BOOL_SELECTOR_TOUCH_ENABLED
  endif


# -------------------------------------
# RotarySelector additions
# -------------------------------------

    if ROTARY_SELECTOR || TESTING_SELECTOR

      comment "_"
      comment "_Rotary selector"

      config PARAM_SELECTOR_GATE_DIRECTIONS
        string "Selector gate directions  "
        array_editor "," PARAM_NUM_GATES
        generated_default "0" "" ", " 0 PARAM_NUM_GATES
        help
          An array with entry for each gate representing the direction of movement of the gear stepper
          when the gate is selected. This is used in the 3D-Chameleon design. E.g. "1, 1, 0, 0"
            0 = normal direction
            1 = reverse direction
          The length should match the number of gates

      config PARAM_SELECTOR_RELEASE_GATES
        string "Selector release gates    "
        array_editor "," PARAM_NUM_GATES
        generated_default "{(%i + 1) % %d}" "PARAM_NUM_GATES" ", " 0 PARAM_NUM_GATES
        help
          An array with entry for each gate representing which gate to select to release the filament in
          the designated gate. (Only works if 'filament_always_gripped: 0').
          E.g. "2, 3, 0, 1" to release gate 0, select gate 2, to release gate 1, select gate 3, etc.
          The length should match the number of gates
    endif


# -------------------------------------
# Index Selector additions
# -------------------------------------

    if INDEXED_SELECTOR || TESTING_SELECTOR

      comment "_"
      comment "_Indexed selector"

      config PARAM_SELECTOR_GATE_ORDER
        string "Selector gate order       "
        array_editor "," PARAM_NUM_GATES
        generated_default "%i" "" ", " 0 PARAM_NUM_GATES
        help
          Comma separated list representing the order of gates when selector is moving in a forward
          direction. This allows for efficient gate selection. Can also be automatically calibrated
          with the MMU_CALIBRATE_SELECTOR_INDEXES command.
          The length should match the number of gates

      config PARAM_SELECTOR_ENDSTOP_WIDTH
        float "Selector endstop width    "
        default 10
        help
          Width of gate selection endstop. It allows for accurate centering on the gate.
          Can also be automatically calibrated (per-gate) with the MMU_CALIBRATE_SELECTOR_INDEXES command
    endif

  endmenu
endif 
```
