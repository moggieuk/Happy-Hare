## installer/Kconfig.heater
```kconfig
# Configuration of the MMU heated chamber: heater(s), heater fan(s) and vent servo(s)
#
# Responsible for setting:
#   MMU_HAS_HEATER
#   MMU_HAS_HEATER_FANS (shared configuration only)
#   MMU_HAS_VENT_SERVO (via Kconfig.vent; only with a heater as venting is part of the drying cycle)
#
# Heater parameter tokens which must be inside if MMU_HAS_HEATER clause in cfg templates:
#   PARAM_FILAMENT_HEATER
#   PARAM_HEATER_MAX_TEMP
#   PARAM_HEATER_DEFAULT_DRY_TEMP
#   PARAM_HEATER_DEFAULT_DRY_TIME
#   PARAM_HEATER_DEFAULT_DRY_HUMIDITY
#   PARAM_HEATER_VENT_MACRO
#   PARAM_HEATER_VENT_INTERVAL
#   PARAM_HEATER_VENT_OPEN_ANGLE, PARAM_HEATER_VENT_CLOSE_ANGLE, PARAM_HEATER_VENT_RUN_FAN,
#   PARAM_HEATER_VENT_DURATION, PARAM_HEATER_VENT_SERVO_DURATION
#   PARAM_HEATER_ROTATE_INTERVAL (if MMU_HAS_ESPOOLER)
#
# Heater fan parameter tokens:
#   PARAM_HEATER_FAN_MAX_POWER, PARAM_HEATER_FAN_KICK_START_TIME,
#   PARAM_HEATER_FAN_SPEED, PARAM_HEATER_FAN_SHUTDOWN_SPEED,
#   PARAM_HEATER_FAN_HEATER_TEMP, PIN_HEATER_FAN, PARAM_HEATER_FAN_NAME
#     (shared configuration)
#   PARAM_HEATER_FAN_MAX_POWER_X, PARAM_HEATER_FAN_KICK_START_TIME_X,
#   PARAM_HEATER_FAN_SPEED_X, PARAM_HEATER_FAN_SHUTDOWN_SPEED_X,
#   PARAM_HEATER_FAN_HEATER_TEMP_X, PIN_HEATER_FAN_X, PARAM_HEATER_FAN_NAME_X
#     (per-gate configuration)
#
# The vent servo is configured in Kconfig.vent, sourced at the end of this file
#
# Can be disabled and forced off with:
#   select UNSELECT_MMU_HAS_HEATER


comment "_"
comment "_Heated Chamber"

config UNSELECT_MMU_HAS_HEATER
  def_bool n

if !UNSELECT_MMU_HAS_HEATER
  config MMU_HAS_HEATER
    prompt "Has enclosure heater(s)?"
    depends on !UNSELECT_MMU_HAS_HEATER
    forceshow
    default n
    help
        Select if the MMU has a heater in the filament storage enclosure
endif
comment "$(misc_hardware_hint)" if MMU_HAS_HEATER && CUSTOM_HEATER_SETUP
  dim

# -------------------------------------
# Heater hardware config
# -------------------------------------

if MMU_HAS_HEATER && !CUSTOM_HEATER_SETUP && !MMU_HAS_PER_GATE_CONFIG
  menu "Heater h/w config"
    help
      Associate an existing Klipper enclosure heater with this MMU unit.

    comment "Happy Hare does not currently create klipper heater objects for you"
    comment "so you need to manually create these and enter object names here   "

    # ------------------------------------
    # Single heater
    # ------------------------------------

    config PARAM_FILAMENT_HEATER
      string "Enclosure heater name     "
      default ""
      help
        Enter the full name of the heater used to heat the filament enclosure.

        E.g. If you have a section like this: [heater_generic MMU_heater], then enter
             without the square brackets: "MMU_heater"


  endmenu
endif

if MMU_HAS_HEATER && !CUSTOM_HEATER_SETUP && MMU_HAS_PER_GATE_CONFIG
  menu "Heater h/w config"
    help
      Associate an existing Klipper heater with each gate.

    comment "Happy Hare does not currently create klipper heater objects for you"
    comment "so you need to manually create these and enter object names here   "

    @repeat var=i min=0 max=11@
      if PARAM_NUM_GATES > $(i)
        menuconfig PARAM_FILAMENT_HEATER_GATE_$(i)
          bool "Gate $(i) heater"
          default y
          help
            Associate an existing Klipper heater with this gate.

        config PARAM_FILAMENT_HEATER_$(i)
          string "Heater name       " if PARAM_FILAMENT_HEATER_GATE_$(i)
          default "$(UNIT_NAME)_heater$(i)"
          help
            Full or short name of the heater for this gate.
      endif
    @endrepeat@
  endmenu
endif


# -------------------------------------
# Heater and humidity control config
# -------------------------------------

if MMU_HAS_HEATER
  menu "Heater and humidity control"
    help
      Configure drying limits, defaults, venting, and spool rotation behavior.
      Use MMU_HEATER at runtime to control heater temperatures and drying
      cycles, including humidity targets, venting, and spool rotation.

    if MMU_HAS_PER_GATE_CONFIG
      config PARAM_MAX_CONCURRENT_HEATERS
        int "Maximum concurrent heaters"
        default 1
        help
          Limit the number of simultaneously active heaters (power/PSU protection)
    endif


    # -------------------------------------
    # Heater controller parameters
    # -------------------------------------

    config PARAM_HEATER_MAX_TEMP
      string "Maximum heater temperature"
      default "65"
      help
        This set the absolute limit for heater operation and is designed
        to protect the MMU construction. Individual filament temps are
        defined in 'drying_data' in mmu.cfg

    config PARAM_HEATER_DEFAULT_DRY_TEMP
      string "Default drying temperature"
      default "45"
      help
        Default drying temperature if filament type is not matched in drying_data

    config PARAM_HEATER_DEFAULT_DRY_TIME
      string "Default drying time       "
      default "300"
      help
        Default drying cycle time in minutes

    config PARAM_HEATER_DEFAULT_DRY_HUMIDITY
      string "Default drying humidity   "
      default "25"
      help
        Default humidity % goal. Drying will terminate if this value is reached

    config PARAM_HEATER_VENT_INTERVAL
      string "Vent interval             "
      default "0"
      help
        Interval in minutes between vent openings during a drying cycle, 0=disable venting

    config PARAM_HEATER_VENT_DURATION
      float "Vent open time (s)        "
      default 10
      range 1 3600
      help
        How long the vent stays open each time it is opened, in seconds.

    config PARAM_HEATER_VENT_RUN_FAN
      boolint "Run fan while venting?"
      default 1
      help
        Force the unit's managed fan(s) on while the vent is open, then restore
        the mode they were in. Works with or without a vent servo. Has no
        effect without a managed fan.

    config PARAM_HEATER_VENT_OPEN_ANGLE
      float "Vent servo open angle     "
      default 90
      depends on MMU_HAS_VENT_SERVO
      help
        Vent servo angle with the vent open.

    config PARAM_HEATER_VENT_CLOSE_ANGLE
      float "Vent servo closed angle   "
      default 0
      depends on MMU_HAS_VENT_SERVO
      help
        Vent servo angle with the vent closed.

    config PARAM_HEATER_VENT_SERVO_DURATION
      float "Vent servo pulse time (s) "
      default 1.0
      depends on MMU_HAS_VENT_SERVO
      help
        How long, in seconds, the servo is driven to move the vent. The signal
        then stops so the servo doesn't jitter while the vent is held.

        0 keeps the signal on all the time, so the servo stays powered and
        actively holds its position. Only use 0 if the vent won't stay put
        unpowered: a constantly driven servo can buzz, jitter or run warm.

    config PARAM_HEATER_VENT_MACRO
      string "Vent macro                "
      default "" if MMU_HAS_VENT_SERVO
      default "_MMU_VENT"
      help
        Optional macro called each time the vent opens and closes, with
        UNIT=<unit> OPEN=1 or OPEN=0 (and GATES=<gates> with per-gate heaters).
        Happy Hare moves any vent servo and runs the fan itself, so this is
        only needed for extra venting hardware. _MMU_VENT is a logging-only
        example to copy. Leave empty for none.

    config PARAM_HEATER_ROTATE_INTERVAL
      string "Rotate interval           "
      default "5"
      depends on MMU_HAS_ESPOOLER || MMU_GEAR_ROTATES_SPOOL
      help
        Interval in minutes to rotate filament (requires the filament end attached to spool)
  endmenu


endif # MMU_HAS_HEATER


# -------------------------------------
# Heater fan enable
# -------------------------------------

# An if block rather than 'depends on', so the hint comment below isn't
# indented as this prompt's implicit child
if MMU_HAS_HEATER && !MMU_HAS_PER_GATE_CONFIG
  config MMU_HAS_HEATER_FANS
    bool "Configure heater fan(s)?"
    help
      Create a fixed Klipper [heater_fan] associated directly with the shared
      enclosure heater. Use it for a fan that blows across the heater or
      spreads its warmth: Klipper runs it whenever the heater is on and until
      the element has cooled. A passive heater without a fan needs none.
      With per-gate configuration each gate's heater fan is selected in the
      heater fan h/w config instead.
endif

comment "$(misc_hardware_hint)" if MMU_HAS_HEATER_FANS && CUSTOM_HEATER_FAN_SETUP
  dim


# -------------------------------------
# Heater fan hardware config
# -------------------------------------

menu "Heater fan h/w config"
  visible if MMU_HAS_HEATER_FANS && !CUSTOM_HEATER_FAN_SETUP && !MMU_HAS_PER_GATE_CONFIG
  help
    Configure the shared Klipper heater fan output and operating speeds.

  config PARAM_HEATER_FAN_MAX_POWER
    float "Fan maximum power  "
    default 1.0
    range 0.1 1.0
    help
      Maximum power setting for the heater fan (0.1 to 1.0).

  config PARAM_HEATER_FAN_KICK_START_TIME
    float "Fan kick start time"
    default 0.5
    range 0 3.0
    help
      Time in seconds to run the heater fan at full power before resetting
      to its target speed.

  config PARAM_HEATER_FAN_SPEED
    float "Fan speed          "
    default 1.0
    range 0.0 1.0
    help
      Fan speed while the associated heater is active (0.0 to 1.0).

  config PARAM_HEATER_FAN_SHUTDOWN_SPEED
    float "Fan shutdown speed "
    default 1.0
    range 0.0 1.0
    help
      Fan speed while the MCU is shutting down (0.0 to 1.0).

  config PARAM_HEATER_FAN_HEATER_TEMP
    float "Fan heater temp    "
    default 45.0
    range 0 120
    help
      Heater temperature (°C) above which the fan runs, even when the
      heater is off.

  config PIN_HEATER_FAN
    string "Heater fan pin(s)  "
    validator "$(pin_list_validator)"
    default ""
    help
      Pin for the fan associated with the shared enclosure heater.
      Separate several fans that run together with commas; they are
      driven as one [heater_fan] through a [multi_pin] alias.

  config BOOL_HIDE_HEATER_FAN
    bool "Hide in Mainsail / Fluidd"
    default y
    help
      Prefix the fan name with an underscore to hide it in the UI.
      Disable to show the fan. Automatic fan control is unchanged.

  config PARAM_HEATER_FAN_NAME
    string
    default "_$(UNIT_NAME)_heater_fan" if BOOL_HIDE_HEATER_FAN
    default "$(UNIT_NAME)_heater_fan"

endmenu

if MMU_HAS_HEATER && !CUSTOM_HEATER_FAN_SETUP && MMU_HAS_PER_GATE_CONFIG
  menu "Heater fan h/w config"
    help
      Configure the Klipper heater fan of each gate.

    @repeat var=i min=0 max=11@
      if PARAM_NUM_GATES > $(i)
        menuconfig PARAM_HEATER_FAN_GATE_$(i)
          bool "Gate $(i) heater fan"
          depends on (!CUSTOM_HEATER_SETUP && PARAM_FILAMENT_HEATER_GATE_$(i)) || (CUSTOM_HEATER_SETUP && PARAM_FILAMENT_HEATER_$(i) != "")
          default y
          help
            Create a fixed [heater_fan] tied directly to this gate's heater.

        if PARAM_HEATER_FAN_GATE_$(i)
          config PARAM_HEATER_FAN_MAX_POWER_$(i)
            float "Fan maximum power  "
            default 1.0
            range 0.1 1.0
            help
              Maximum power setting for this gate's heater fan (0.1 to 1.0).

          config PARAM_HEATER_FAN_KICK_START_TIME_$(i)
            float "Fan kick start time"
            default 0.5
            range 0 3.0
            help
              Time in seconds to run this gate's heater fan at full power
              before resetting to its target speed.

          config PARAM_HEATER_FAN_SPEED_$(i)
            float "Fan speed          "
            default 1.0
            range 0.0 1.0
            help
              Fan speed while this gate's heater is active (0.0 to 1.0).

          config PARAM_HEATER_FAN_SHUTDOWN_SPEED_$(i)
            float "Fan shutdown speed "
            default 1.0
            range 0.0 1.0
            help
              Fan speed while this gate's MCU is shutting down (0.0 to 1.0).

          config PARAM_HEATER_FAN_HEATER_TEMP_$(i)
            float "Fan heater temp    "
            default 45.0
            range 0 120
            help
              Temperature (°C) of this gate's heater above which its fan
              runs, even when the heater is off.

          config PIN_HEATER_FAN_$(i)
            string "Heater fan pin     "
            validator "$(pin_validator)"
            help
              Leave blank if this gate does not have a heater fan installed.

          config PARAM_HEATER_FAN_NAME_$(i)
            string
            default "_$(UNIT_NAME)_heater_fan$(i)" if BOOL_HIDE_HEATER_FAN
            default "$(UNIT_NAME)_heater_fan$(i)"
        endif
      endif
    @endrepeat@

    config BOOL_HIDE_HEATER_FAN
      bool "Hide in Mainsail / Fluidd"
      default y
      help
        Prefix every gate's fan name with an underscore to hide them in the UI.
        Disable to show the fans. Automatic fan control is unchanged.
  endmenu
endif


# -------------------------------------
# Vent servo (venting is part of the drying cycle)
# -------------------------------------

source "Kconfig.vent"
```
