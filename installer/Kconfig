## installer/Kconfig.espooler
```kconfig
# Responsible for setting:
#   MMU_HAS_ESPOOLER
#
# Espooler parameter tokens which must be inside if MMU_HAS_ESPOOLER clause in cfg templates:
# PIN_ESPOOLER_EN_<gate> (depends on HAS_ESPOOLER_ENABLE_PIN)
# PIN_ESPOOLER_RWD_<gate>
# PIN_ESPOOLER_FWD_<gate>
# PIN_ESPOOLER_TRIG_<gate>
#
# PARAM_ESPOOLER_MIN_DISTANCE
# PARAM_ESPOOLER_MAX_STEPPER_SPEED
# PARAM_ESPOOLER_MIN_STEPPER_SPEED
# PARAM_ESPOOLER_SPEED_EXPONENT
# PARAM_ESPOOLER_ASSIST_REDUCED_SPEED
# PARAM_ESPOOLER_FULL_SPOOL_POWER
# PARAM_ESPOOLER_PRINTING_POWER
# PARAM_ESPOOLER_OPERATIONS
# PARAM_ESPOOLER_ASSIST_EXTRUDER_MOVE_LENGTH
# PARAM_ESPOOLER_ASSIST_BURST_POWER
# PARAM_ESPOOLER_ASSIST_BURST_DURATION
# PARAM_ESPOOLER_ASSIST_BURST_TRIGGER
# PARAM_ESPOOLER_ASSIST_BURST_TRIGGER_MAX
# PARAM_ESPOOLER_REWIND_BURST_POWER
# PARAM_ESPOOLER_REWIND_BURST_DURATION
# PARAM_ESPOOLER_PWM
# PARAM_ESPOOLER_HARDWARE_PWM
# PARAM_ESPOOLER_CYCLE_TIME
# PARAM_ESPOOLER_SCALE
# PARAM_ESPOOLER_VALUE
# PARAM_ESPOOLER_SHUTDOWN_VALUE
#
# Can be disabled and forced off with:
#   select UNSELECT_MMU_HAS_ESPOOLER


config UNSELECT_MMU_HAS_ESPOOLER
  def_bool n

comment "_"
comment "_Espooler"

if !UNSELECT_MMU_HAS_ESPOOLER
config MMU_HAS_ESPOOLER
  prompt "Has eSpooler?"
  forceshow
  default n
  help
    An eSpooler is primarily used to rewind filament to prevent
    it tangling but can also be driven to assist loading and even
    assist in print. Select if you have added a DC motor controlled
    eSpooler.
endif


# -------------------------------------
# Espooler config
# -------------------------------------

if MMU_HAS_ESPOOLER

  menu "eSpooler config"

# -------------------------------------
# eSpooler operation
# -------------------------------------

    config PARAM_ESPOOLER_MIN_DISTANCE
      float "Espooler minimum move distance   "
      default 30
      help
        Individual stepper movements less than this distance will not activate espooler

    config PARAM_ESPOOLER_MAX_STEPPER_SPEED
      float "Espooler max stepper speed       "
      default 300
      help
        Gear stepper speed at which espooler will be at maximum power

    config PARAM_ESPOOLER_MIN_STEPPER_SPEED
      float "Espooler min stepper speed       "
      default 0
      help
        Gear stepper speed at which espooler will become inactive (useful for non PWM control)

    config PARAM_ESPOOLER_SPEED_EXPONENT
      float "Espooler speed exponent          "
      default 0.5
      help
        Controls non-linear espooler power relative to stepper speed. Typically the espooler will be
        controlled with PWM signal. This will be at the maximum at speeds equal or above
        'espooler_max_stepper_speed'. The PWM signal will scale downwards towards 0 for slower speeds.
        The falloff being controlled by this setting according to this formula (0.5 is a good starting value):
          espooler_pwm = (stepper_speed / espooler_max_stepper_speed) ^ espooler_speed_exponent

    config PARAM_ESPOOLER_ASSIST_REDUCED_SPEED
      int "Espooler assist reduced speed    "
      range 0 100
      default 50
      help
        Control the % of the rewind speed that is applied to assisting load (want rewind to be faster)

    config PARAM_ESPOOLER_FULL_SPOOL_POWER
      int "Espooler full spool power        "
      range 10 100
      default 100
      help
        The % of normal rewind/assist power used on a full spool, rising
        linearly to 100% as the spool empties (a full spool turns slower
        for the same filament speed). 100 = disabled.
        Needs the spool's remaining and full weight, from Spoolman or
        'MMU_GATE_MAP GATE=.. WEIGHT=.. INITIAL_WEIGHT=..'

    config PARAM_ESPOOLER_PRINTING_POWER
      int "Espooler printing power          "
      range 0 100
      default 0
      help
        If >0, fixes the % of PWM power while printing. 0=allows burst movement

    config PARAM_ESPOOLER_OPERATIONS
      string "Espooler enabled operations      "
      default "rewind, assist, print"
      array_editor ","
      help
        Regardless of h/w you can enable/disable actions. E.g. remove 'print' to turn off operation while printing. Options:
          rewind - when filament is being unloaded under MMU control (aka respool)
          assist - when filament is being loaded under MMU control (% of "rewind" speed but with minimum of "print" power)
          print  - while printing. Generally set 'espooler_printing_power' to a low percentage just to
                   allow motor to be turned freely or set to 0 to enable/allow "burst" assist movements
        If using a digitally controlled espooler motor (not PWM), then you should remove "print" and set
        'espooler_min_stepper_speed' to prevent "over movement"

    comment "_"
    comment "Assist burst (ASSIST direction, e.g. print/loosen)"

    config PARAM_ESPOOLER_ASSIST_EXTRUDER_MOVE_LENGTH
      float "Espooler assist extruder move    "
      default 100
      help
        This burst configuration is used to control the small rotation in the ASSIST direction
        optionally used when 'print' operation is enabled, 'espooler_printing_power: 0' and is
        triggered (tension switch or extruder movement). It can also be used to loosen filament with
        'MMU_ESPOOLER COMMAND=assist BURST=1'.

        Distance (mm) extruder needs to move between each assist burst

    config PARAM_ESPOOLER_ASSIST_BURST_POWER
      int "Espooler assist burst power      "
      range 0 100
      default 100
      help
        The % power of the burst move

    config PARAM_ESPOOLER_ASSIST_BURST_DURATION
      float "Espooler assist burst duration   "
      default 0.4
      help
        The duration of the burst move in seconds

    config PARAM_ESPOOLER_ASSIST_BURST_TRIGGER
      boolint "Trigger assist switch fitted?"
      default 0
      help
        If trigger assist switch is fitted 0=disable, 1=enable

    config PARAM_ESPOOLER_ASSIST_BURST_TRIGGER_MAX
      int
      default 3

    config PARAM_ESPOOLER_ASSIST_BURST_TRIGGER_MAX
      prompt "Espooler assist burst trigger max"
      depends on PARAM_ESPOOLER_ASSIST_BURST_TRIGGER
      keep_when_hidden
      help
        If trigger assist switch is fitted this limits the max number of back-to-back advances

    comment "_"
    comment "Rewind burst (REWIND direction, e.g. drying/tighten)"

    config PARAM_ESPOOLER_REWIND_BURST_POWER
      int "Espooler rewind burst power      "
      range 0 100
      default 100
      help
        This burst configuration is used to control the small rotation in the REWIND direction
        optionally used when running the filament drying cycle. The goal is to rotate the spool
        60-90 degrees. It can also be used to tighten the filament with
        'MMU_ESPOOLER COMMAND=rewind BURST=1'.

        The % power of the rewind burst move

    config PARAM_ESPOOLER_REWIND_BURST_DURATION
      float "Espooler rewind burst duration   "
      default 0.4
      help
        The duration of the rewind burst move in seconds

    comment "_"
    menu "Advanced"

      config PARAM_ESPOOLER_PWM
        boolint "PWM motor control?"
        default 1
        help
          On (typical): the motor pins are PWM, so motor power follows gear
          speed and the % power settings above.
          Off: the pins are simply on (full power) or off. Then also remove
          "print" from "Espooler enabled operations" and set "Espooler min
          stepper speed" to avoid over-rotating the spool.

      config PARAM_ESPOOLER_HARDWARE_PWM
        boolint
        prompt "Hardware PWM?" if PARAM_ESPOOLER_PWM
        default 0
        keep_when_hidden
        help
          Use the MCU's hardware PWM instead of software PWM. The motor pins
          must support it, and the real cycle time may then differ from
          "PWM cycle time". Software PWM (off) works on any pin.
          See "hardware_pwm" in Klipper's [output_pin] documentation.

      config PARAM_ESPOOLER_CYCLE_TIME
        float
        prompt "$(pad,29,PWM cycle time)" if PARAM_ESPOOLER_PWM
        default 0.1
        keep_when_hidden
        help
          The length of one PWM on/off cycle in seconds (0.1 = 10Hz).
          Shorter gives smoother motor drive but more MCU load; with software
          PWM Klipper recommends 0.01 or more.
          See "cycle_time" in Klipper's [output_pin] documentation.

      config PARAM_ESPOOLER_SCALE
        float
        prompt "$(pad,29,Scale)" if PARAM_ESPOOLER_PWM
        default 1
        keep_when_hidden
        help
          Motor power (0-100%) is divided by this to give the PWM duty.
          1 = full range. 2 caps the motors at 50% duty, e.g. for a motor
          rated below the supply voltage. Below 1 they reach full duty sooner.
          "Value" and "Shutdown value" are given in the same units as Scale.

      config PARAM_ESPOOLER_VALUE
        float "$(pad,33,Value)"
        default 0
        help
          The motor pin value Klipper sets at startup, before Happy Hare
          drives the espooler (0 to "Scale"). 0 keeps the motors off, which
          is almost always what you want.
          Without PWM any value above 0 means on (full power).
          See "value" in Klipper's [output_pin] documentation.

      config PARAM_ESPOOLER_SHUTDOWN_VALUE
        float "$(pad,33,Shutdown value)"
        default 0
        help
          The motor pin value the MCU falls back to when Klipper shuts it
          down, e.g. on an error or emergency stop. 0 stops the motors, which
          is almost always what you want.
          With software PWM it must be 0 or "Scale"; values in between need
          hardware PWM (0 to "Scale").
          Without PWM any value above 0 means on (full power).
          See "shutdown_value" in Klipper's [output_pin] documentation.

    endmenu

# -------------------------------------
# eSpooler pins
# -------------------------------------

    comment "_"
    comment "_eSpooler pins"

    @repeat var=i min=0 max=$(max_gate)@
      if PARAM_NUM_GATES > $(i)
        comment "_" if $(i) > 0
        config PIN_ESPOOLER_EN_$(i)
          prompt "eSpooler enable $(i) pin " if HAS_ESPOOLER_ENABLE_PIN
          validator "$(pin_validator)"
          help
            $(pin_help)
        config PIN_ESPOOLER_RWD_$(i)
          prompt "eSpooler rewind $(i) pin "
          validator "$(pin_validator)"
          help
            $(pin_help)
        config PIN_ESPOOLER_FWD_$(i)
          prompt "eSpooler forward $(i) pin"
          validator "$(pin_validator)"
          help
            $(pin_help)
        config PIN_ESPOOLER_TRIG_$(i)
          prompt "eSpooler trigger $(i) pin"
          validator "$(pin_validator)"
          help
            $(pin_help)
      endif
    @endrepeat@

  endmenu
endif
```

## installer/Kconfig.extruder_speeds
```kconfig
# Extruder movement speeds, shared by all mmu_units (in [mmu_parameters])
#
# Sourced inside "Speeds" for a single unit, and as the multi-unit entry
# point's "Extruder speeds" menu
#
# Responsible for setting:
#   PARAM_EXTRUDER_LOAD_SPEED
#   PARAM_EXTRUDER_UNLOAD_SPEED
#   PARAM_EXTRUDER_SYNC_LOAD_SPEED
#   PARAM_EXTRUDER_SYNC_UNLOAD_SPEED
#   PARAM_EXTRUDER_SYNC_ACCEL
#   PARAM_EXTRUDER_HOMING_SPEED
#   PARAM_EXTRUDER_ACCEL

  comment "_Extruder movement speeds (mm/s)"

  config PARAM_EXTRUDER_LOAD_SPEED
    float "Extruder load speed             "
    default 16
    help
      Speed of load move inside extruder from homing position to meltzone

  config PARAM_EXTRUDER_UNLOAD_SPEED
    float "Extruder unload speed           "
    default 16
    help
      Speed of unload moves inside of extruder
      (very initial move from meltzone is 50% of this)

  config PARAM_EXTRUDER_SYNC_LOAD_SPEED
    float "Extruder sync load speed        "
    default 18
    help
      Speed of load move inside extruder from homing position to meltzone
      when synced with MMU gear stepper

  config PARAM_EXTRUDER_SYNC_UNLOAD_SPEED
    float "Extruder sync unload speed      "
    default 18
    help
      Speed of unload moves inside of extruder when synced with MMU gear stepper
      (very initial move from meltzone is 50% of this)

  config PARAM_EXTRUDER_SYNC_ACCEL
    float "Extruder sync acceleration      "
    default 400
    help
      Acceleration of moves led by the MMU gear stepper with the extruder synced
      to it (limited to the extruder acceleration)

  config PARAM_EXTRUDER_HOMING_SPEED
    float "Extruder homing speed           "
    default 16
    help
      Speed of extruder only homing moves (e.g. to toolhead sensor)

  config PARAM_EXTRUDER_ACCEL
    float "Extruder acceleration           "
    default 1500
    help
      The acceleration of the extruder stepper is limited to this value when performing MMU
      filament load/unload moves. This prevents too rapid a movement that could cause the
      extruder stepper to loose steps
```
