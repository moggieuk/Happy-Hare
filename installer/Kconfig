## installer/Kconfig.flowguard
```kconfig
# This module is responsible for flowguard configuration
#
# Responsible for setting:
#   PARAM_FLOWGUARD_ENABLED
#   PARAM_FLOWGUARD_MAX_RELIEF
#   PARAM_FLOWGUARD_ENCODER_MODE
#   PARAM_FLOWGUARD_ENCODER_MAX_MOTION
#   PARAM_TANGLE_PREVENTION_ENABLED
#   PARAM_TANGLE_PREVENTION_THRESHOLD
#   PARAM_TANGLE_PREVENTION_RELEASE

menu "FlowGuard (clog/tangle/runout detection)"
depends on MMU_HAS_SYNC_FEEDBACK_BUFFER || MMU_HAS_ENCODER

config BOOL_FLOWGUARD_ENABLED
  bool "Enable sync-feedback base FlowGuard (sync speed correction, clog/tangle/runout)?"
  default y
  help
    FlowGuard is a feature that uses the sync-feedback buffer and/or encoder to detect
    filament clogs, tangles and runouts. If enabled the print will be paused to allow
    you to correct the issue, possibly saving your print but certainly saving your printer.
config PARAM_FLOWGUARD_ENABLED
  int
  default 1 if BOOL_FLOWGUARD_ENABLED
  default 0

config PARAM_FLOWGUARD_MAX_RELIEF
  float
  default 40

config PARAM_FLOWGUARD_MAX_RELIEF
  prompt "Max relief movement"
  depends on MMU_HAS_SYNC_FEEDBACK_BUFFER && BOOL_FLOWGUARD_ENABLED
  help
    The amount of relief movement (effective mm change in filament length between MMU and extruder) that
    Happy Hare will wait until triggering a clog or runout. A smaller value is more sensitive to triggering. Since
    the relief movement is highly dependent on filament "spring" in the bowden tube, filament friction, and
    'sync_feedback_buffer_range', it is generally good to start high and then decrease if a more sensitive trigger is desired.
    Analog proportional (type P) sensors can generally have a much lower value. Increase if you have false triggers.


if MMU_HAS_SYNC_FEEDBACK_BUFFER
  config BOOL_TANGLE_PREVENTION_ENABLED
    bool "Enable tangle prevention (boost gear current on high spool tension)?"
    default y
    help
      Tangle prevention boosts the gear stepper current to 100% when the proportional sync-feedback
      sensor reports high filament tension (the gear struggling to pull filament from the spool),
      then restores normal current once tension eases. This helps pull through minor spool
      resistance before it develops into a tangle. Requires a proportional (type P) sensor.

  config PARAM_TANGLE_PREVENTION_ENABLED
    int
    default 1 if BOOL_TANGLE_PREVENTION_ENABLED
    default 0

  config PARAM_TANGLE_PREVENTION_THRESHOLD
    float
    default 0.3

  config PARAM_TANGLE_PREVENTION_THRESHOLD
    prompt "Tension threshold to boost gear current"
    depends on BOOL_TANGLE_PREVENTION_ENABLED
    help
      Proportional sensor tension level (0.2-0.9, fraction of the tension half of the sensor range) at which the
      gear current is boosted to 100%. Lower values trigger the boost sooner. Increase if you get false triggers.

  config PARAM_TANGLE_PREVENTION_RELEASE
    float
    default 0.2

  config PARAM_TANGLE_PREVENTION_RELEASE
    prompt "Tension level to restore gear current"
    depends on BOOL_TANGLE_PREVENTION_ENABLED
    help
      Tension level (0.15-0.8) at which the boosted gear current is restored to normal once tension eases. Must be
      below the threshold - the gap between the two provides hysteresis to prevent the current thrashing on and off.
endif


if MMU_HAS_ENCODER
  config BOOL_FLOWGUARD_ENCODER_MODE
    bool "Enable encoder based FlowGuard (clog/tangle/runout detection)?"
    help
      Encoder runout/clog/tangle detection watches for movement over either a static or automatically adjusted distance - if
      no encoder movement is seen when the extruder moves this distance runout/ clog/tangle event will be generated. Allowing
      the distance to be adjusted automatically will generally allow for a quicker trigger but use a static length
      (mode=1, set encoder_max_motion) if you get false triggers (see flowguard guide on wiki for more details).
      Note that this feature cannot distinguish between clog or tangle.

  config BOOL_FLOWGUARD_ENCODER_MODE_AUTO
    bool "Enable automatic detection length?"
    help
      This constantly tunes the clog/tangle/runout detection length to help avoid false triggering
    depends on BOOL_FLOWGUARD_ENCODER_MODE
    default y

  config PARAM_FLOWGUARD_ENCODER_MODE
    int 
    default 2 if BOOL_FLOWGUARD_ENCODER_MODE_AUTO
    default 1 if BOOL_FLOWGUARD_ENCODER_MODE
    default 0

  config PARAM_FLOWGUARD_ENCODER_MAX_MOTION
    float
    default 20

  config PARAM_FLOWGUARD_ENCODER_MAX_MOTION
    prompt "Extruder max motion"
    depends on BOOL_FLOWGUARD_ENCODER_MODE && !BOOL_FLOWGUARD_ENCODER_MODE_AUTO
    help
      The encoder_max_motion is the absolute max permitted extruder movement without the encoder seeing movement when using
      non-automatic mode (mode=1). Smaller values are more sensitive but beware of going too small - slack and friction in the
      bowden may cause gaps in encoder movement. Increase if you have false triggers.
      Note that this value is overridden by any calibrated value stored in 'mmu_vars.cfg' if in automatic mode (mode=2).
endif

endmenu
```

## installer/Kconfig.gates
```kconfig
# This module defines types and parameters for control of the filament at the gate
# E.g. gate parking, preloading, etc.
#
# Responsible for setting:
#   PARAM_GATE_PARKING_DISTANCE
#   PARAM_GATE_HOMING_MAX
#   PARAM_GATE_PRELOAD_PARKING_DISTANCE
#   PARAM_GATE_PRELOAD_HOMING_MAX
#   PARAM_GATE_PRELOAD_ATTEMPTS
#   PARAM_GATE_FINAL_EJECT_DISTANCE
#   PARAM_GATE_LOAD_ATTEMPTS
#   PARAM_GATE_AUTOLOAD

menu "Gate loading & parking"

  config PARAM_GATE_HOMING_MAX
    float "Maximum homing distance     "
    default 100
    help
      Maximum extra move distance (mm) to home (or actual move distance if
      using "encoder" endstop)

  config PARAM_GATE_PARKING_DISTANCE
    float "Gate parking distance       "
    default -23
    help
      Parking position relative to homing endstop. Must be -ve (retraction)
      unless endstop is mmu_exit and filament can be left past the sensor
      without restricting loading from another gate.

      Negative values for movement in the retract direction (back off sensor)
      Positive values for movement in the extrude direction (past sensor)

  config PARAM_GATE_PRELOAD_HOMING_MAX
    float "Preload homing distance     "
    default PARAM_GATE_HOMING_MAX
    help
      Maximum homing distance (mm) to the mmu_exit endstop

      Usually this is the same as gate homing distance

  config PARAM_GATE_PRELOAD_PARKING_DISTANCE
    float "Preload parking distance    "
    default PARAM_GATE_PARKING_DISTANCE
    help
      Filament parking distance (mm) after homing to configured gate homing sensor
      or per-gate "mmu_exit" sensor if available.

      Negative values for movement in the retract direction (back off sensor)
      Positive values for movement in the extrude direction (past sensor)

      Usually this is the same as gate parking distance

  config PARAM_GATE_PRELOAD_ATTEMPTS
    int "Number of preload attempts  "
    default 2
    help
      Number of attempts to make at loading the filament after preload is issued.

  config PARAM_GATE_FINAL_EJECT_DISTANCE
    float "Final eject distance        "
    default 20
    help
      Additional distance to eject filament on MMU_EJECT to clear MMU's grip

  config PARAM_GATE_LOAD_ATTEMPTS
    int "Number of gate load attempts"
    range 1 20
    default 2
    depends on LINEAR_SERVO_SELECTOR || TESTING_SELECTOR
    help
      Number of times MMU will attempt to grab the filament on initial load (type-A designs with servo)

  config PARAM_GATE_AUTOLOAD
    boolint "Automatically load gate when entry sensor triggers?"
    default 1
    depends on MMU_HAS_SENSOR_ENTRY
    help
      If mmu entry sensor fitted this controls the automatic loading of the gate

endmenu
```

## installer/Kconfig.gear_stepper
```kconfig
# Gear stepper parameter tokens for hardware and speeds
#
# Responsible for setting:
#   PARAM_GEAR_GEAR_RATIO
#   PARAM_GEAR_ROTATION_DISTANCE
#   PARAM_GEAR_RUN_CURRENT
#   PARAM_GEAR_HOLD_CURRENT
#   PARAM_GEAR_FULL_STEPS_PER_ROTATION
#   PARAM_GEAR_SENSE_RESISTOR
#   PARAM_GEAR_STALLGUARD_THRESHOLD (prompt only; declared with the TMC driver)
#   BOOL_GEAR_OVERRIDE_<n> and PARAM_GEAR_<param>_<n> per-gear overrides (multigear)

gear_pad       := 25
float_or_empty := ([0-9]+([.][0-9]*)?|[.][0-9]+)?
int_or_empty   := ([0-9]+)?
ratio_or_empty := ([0-9.]+ *: *[0-9.]+( *, *[0-9.]+ *: *[0-9.]+)*)?

menu "Gear stepper"

  config PARAM_GEAR_GEAR_RATIO
    string "$(pad,$(gear_pad),Gear ratio)"
    default "1:1"

  config PARAM_GEAR_ROTATION_DISTANCE
    float "$(pad,$(gear_pad),Gear rotation distance)"
    default 22.7316868

  prefix    := GEAR
  label     := Gear
  pad_width := $(gear_pad)
  source "components/Kconfig.tmc_driver_menu_current"

  config PARAM_GEAR_STALLGUARD_THRESHOLD
    prompt "$(pad,$(gear_pad),Gear stallguard threshold)" if BOOL_GEAR_TMC_HAS_STALLGUARD && PIN_GEAR_DIAG != ""
    help
      Sensitivity for "touch" homing, written only when a diag pin is set.
      Expect to tune it. The scale depends on the chip: SGTHRS is 0-255
      and higher is more sensitive, SGT is -64..63 and lower is more
      sensitive.

  config PARAM_GEAR_MICROSTEPS
    int "$(pad,$(gear_pad),Microsteps)"
    default 16

  config PARAM_GEAR_FULL_STEPS_PER_ROTATION
    int "$(pad,$(gear_pad),Full steps per rotation)"
    default 200
    help
      200 for 1.8 degree, 400 for 0.9 degree

  # Stallguard is not inherited by mmu_unit, so every gear's value is written and an
  # untouched one must equal gear 0's. Declared outside the 'if' blocks below, which
  # would otherwise also gate the default
  @repeat var=i min=1 max=11@
    config PARAM_GEAR_STALLGUARD_THRESHOLD_$(i)
      int
      default PARAM_GEAR_STALLGUARD_THRESHOLD
  @endrepeat@

  if MULTIGEAR
    menu "Per-gear overrides"
      help
        Every gear stepper inherits the settings above from gear 0.
        Enable a gear here to give it different values. Leave a field
        empty to keep inheriting it.

      @repeat var=i min=1 max=11@
        if PARAM_NUM_GATES > $(i)
          menuconfig BOOL_GEAR_OVERRIDE_$(i)
            bool "Gear $(i) overrides"
            default n
            default_when_hidden
            help
              Override inherited settings for gear $(i). Turning this off
              clears its values.

          config PARAM_GEAR_GEAR_RATIO_$(i)
            string
            prompt "$(pad,$(gear_pad),Gear ratio)" if BOOL_GEAR_OVERRIDE_$(i)
            validator "$(ratio_or_empty)"
            help
              E.g. 80:20. Leave empty to inherit from gear 0.
          config PARAM_GEAR_ROTATION_DISTANCE_$(i)
            string
            prompt "$(pad,$(gear_pad),Rotation distance)" if BOOL_GEAR_OVERRIDE_$(i)
            validator "$(float_or_empty)"
            help
              Calibrated rotation distances replace this. With
              variable_rotation_distances off, calibrating any gate
              sets every gate.
          config PARAM_GEAR_RUN_CURRENT_$(i)
            string
            prompt "$(pad,$(gear_pad),Run current)" if BOOL_GEAR_OVERRIDE_$(i) && PARAM_GEAR_TMC != ""
            validator "$(float_or_empty)"
          config PARAM_GEAR_HOLD_CURRENT_$(i)
            string
            prompt "$(pad,$(gear_pad),Hold current)" if BOOL_GEAR_OVERRIDE_$(i) && BOOL_GEAR_TMC_HAS_HOLD_CURRENT
            validator "$(float_or_empty)"
          config PARAM_GEAR_SENSE_RESISTOR_$(i)
            string
            prompt "$(pad,$(gear_pad),Sense resistor)" if BOOL_GEAR_OVERRIDE_$(i) && PARAM_GEAR_TMC != "" && !BOOL_GEAR_TMC_HAS_RREF
            validator "$(float_or_empty)"
          config PARAM_GEAR_RREF_$(i)
            string
            prompt "$(pad,$(gear_pad),Rref (ohms))" if BOOL_GEAR_OVERRIDE_$(i) && BOOL_GEAR_TMC_HAS_RREF
            validator "$(int_or_empty)"
          config PARAM_GEAR_STALLGUARD_THRESHOLD_$(i)
            prompt "$(pad,$(gear_pad),Stallguard threshold)" if BOOL_GEAR_OVERRIDE_$(i) && \
                BOOL_GEAR_TMC_HAS_STALLGUARD && PIN_GEAR_DIAG != "" && PIN_GEAR_DIAG_$(i) != ""
            help
              Used only when this gear has a diag pin. Defaults to the
              gear 0 value; same scale as that.
          config PARAM_GEAR_MICROSTEPS_$(i)
            string
            prompt "$(pad,$(gear_pad),Microsteps)" if BOOL_GEAR_OVERRIDE_$(i)
            validator "$(int_or_empty)"
          config PARAM_GEAR_FULL_STEPS_PER_ROTATION_$(i)
            string
            prompt "$(pad,$(gear_pad),Full steps per rotation)" if BOOL_GEAR_OVERRIDE_$(i)
            validator "$(int_or_empty)"
        endif
      @endrepeat@
    endmenu
  endif

endmenu
```
