## installer/Kconfig.environment_sensor
```kconfig
# Environment sensors(s)
#
# Responsible for setting:
#   MMU_HAS_ENVIRONMENT_SENSOR
#   MMU_HAS_PER_GATE_CONFIG
#
# Single MCU:
#   PARAM_ENVIRONMENT_SENSOR_TYPE
#   PARAM_SENSOR_REPORT_TIME_PARAM
#   PARAM_ENVIRONMENT_SENSOR_REPORT_TIME
#   PARAM_ENVIRONMENT_SENSOR_I2C_ADDRESS
#
#   CHOICE_ENVIRONMENT_SENSOR_I2C_HARDWARE (i2c bus type)
#     PARAM_ENVIRONMENT_SENSOR_I2C_BUS
#
#   CHOICE_ENVIRONMENT_SENSOR_I2C_SOFTWARE (i2c bus type)
#     PIN_ENVIRONMENT_SENSOR_SCL
#     PIN_ENVIRONMENT_SENSOR_SDA
#
# Per-gate:
#   as above with _<gate_index> extension
#
# MCU CPU temperature sensors:
#   BOOL_CREATE_MCU_ENVIRONMENT_SENSORS, BOOL_HIDE_MCU_ENVIRONMENT_SENSORS
#   PARAM_MCU_ENVIRONMENT_SENSOR_NAME, PARAM_BUFFER_MCU_ENVIRONMENT_SENSOR_NAME
#   PARAM_MCU_ENVIRONMENT_SENSOR_NAME_X (per-gate MCU)
#
# Everything but the sensor name comes from components/Kconfig.environment_sensor,
# shared by both layouts. The shared sensor's fixed i2c bus list is added here
#
# SUPPORTED SENSOR TYPES
#   - AHT10     (humidity/temperature, legacy name known to every Klipper/Kalico)
#   - AHT1X     (humidity/temperature, Klipper after v0.13.0 or Kalico v2026.06+)
#   - AHT2X     (humidity/temperature, Klipper after v0.13.0 or Kalico v2026.06+)
#   - AHT3X     (humidity/temperature, Klipper after v0.13.0 or Kalico v2026.06+)
#   - BME280    (humidity/temperature/pressure; also BMP180/BMP280/BMP388/BME680)
#   - HTU21D    (humidity/temperature)
#   - SI7013, SI7020, SI7021, SHT21 (humidity/temperature, HTU21D family)
#   - SHT3X     (humidity/temperature, SHT30/SHT31/SHT35)
#   - LM75      (temperature only)
#
# SUPPORTED I2C HARDWARE BUS OPTIONS:
#   - i2c2_PB10_PB11  (default)
#   - i2c3_PB3_PB4    (alternative)
#
# Can be disabled and forced off with:
#   select UNSELECT_MMU_HAS_ENVIRONMENT_SENSOR


comment "_"
comment "_Environment Sensors"

config UNSELECT_MMU_HAS_ENVIRONMENT_SENSOR
  def_bool n

if !UNSELECT_MMU_HAS_ENVIRONMENT_SENSOR
  config MMU_HAS_ENVIRONMENT_SENSOR
    bool "Has environment sensors?"
    forceshow
    default n
    help
      Select if the MMU has a humidity/temperature sensor in the filament storage enclosure
endif
comment "$(misc_hardware_hint)" if MMU_HAS_ENVIRONMENT_SENSOR && CUSTOM_ENVIRONMENT_SENSOR_SETUP
  dim


# -------------------------------------
# Environment/temperature sensor config
# -------------------------------------

if MMU_HAS_ENVIRONMENT_SENSOR && !CUSTOM_ENVIRONMENT_SENSOR_SETUP && !MMU_HAS_PER_GATE_CONFIG
  menu "Environment sensor h/w config"
    help
      Configure the shared enclosure temperature and humidity sensor.

    config PARAM_ENVIRONMENT_SENSOR
      string "Sensor name       "
      default "$(UNIT_NAME)_Env"
      help
        Name of the environment sensor section in the printer config
        E.g., "temperature_sensor MMU_enclosure" or just "MMU_enclosure"


    env_sensor_suffix     :=
    env_sensor_custom_bus := n
    env_sensor_bus_hint   :=
    source "components/Kconfig.environment_sensor"

    if CHOICE_ENVIRONMENT_SENSOR_I2C_HARDWARE
      choice CHOICE_ENVIRONMENT_SENSOR_I2C_BUS
        default CHOICE_ENVIRONMENT_SENSOR_I2C_BUS_I2C3 if BOARD_TYPE_EBB_GEN1
        default CHOICE_ENVIRONMENT_SENSOR_I2C_BUS_I2C2

        config CHOICE_ENVIRONMENT_SENSOR_I2C_BUS_I2C2
          bool "i2c2_PB10_PB11"
          help
            Hardware i2c bus i2c2 with SCL on PB10 and SDA on PB11

        config CHOICE_ENVIRONMENT_SENSOR_I2C_BUS_I2C3
          bool "i2c3_PB3_PB4"
          help
            Hardware i2c bus i2c3 with SCL on PB3 and SDA on PB4
      endchoice

      config PARAM_ENVIRONMENT_SENSOR_I2C_BUS
        default "i2c2_PB10_PB11" if CHOICE_ENVIRONMENT_SENSOR_I2C_BUS_I2C2
        default "i2c3_PB3_PB4"   if CHOICE_ENVIRONMENT_SENSOR_I2C_BUS_I2C3
    endif
  endmenu
endif

if MMU_HAS_ENVIRONMENT_SENSOR && !CUSTOM_ENVIRONMENT_SENSOR_SETUP && MMU_HAS_PER_GATE_CONFIG
  menu "Environment sensor h/w config"
    help
      Configure the temperature and humidity sensor of each gate.

    @repeat var=i min=0 max=11@
      if PARAM_NUM_GATES > $(i)

        config PARAM_ENVIRONMENT_SENSOR_$(i)
          string

        menuconfig PARAM_ENVIRONMENT_SENSOR_GATE_$(i)
          bool "Gate $(i) sensor"
          default y
          help
            Create an environment sensor for this gate.

        if PARAM_ENVIRONMENT_SENSOR_GATE_$(i)

          config PARAM_ENVIRONMENT_SENSOR_$(i)
            string "Sensor name       "
            default "$(UNIT_NAME)_Env$(i)"
            help
              Name of the environment sensor section in the printer config.

          env_sensor_suffix     := _$(i)
          env_sensor_custom_bus := y
          env_sensor_bus_hint   := $(nl)Board files offer the buses this board actually routes;$(nl)"Custom bus name" accepts any Klipper i2c bus name.
          source "components/Kconfig.environment_sensor"
        endif
      endif
    @endrepeat@
  endmenu
endif


# -------------------------------------
# MCU CPU Temperature sensors
# -------------------------------------

config BOOL_CREATE_MCU_ENVIRONMENT_SENSORS
  bool "Create MCU CPU sensors?"
  depends on !BOARD_TYPE_MANUAL
  default y
  help
    Create [temperature_sensor] sections for the MCUs themselves for CPU temperature monitoring.

if BOOL_CREATE_MCU_ENVIRONMENT_SENSORS
  config BOOL_HIDE_MCU_ENVIRONMENT_SENSORS
    bool "Hide in Mainsail / Fluidd"
    default n if MMU_HAS_PER_GATE_MCU
    default y
    help
      Prefix the MCU sensor names with an underscore to hide them in the UI.
      Disable to show the sensors. Fan temperature control is unchanged.

  config PARAM_MCU_ENVIRONMENT_SENSOR_NAME
    string
    default "_$(UNIT_NAME)_mcu" if BOOL_HIDE_MCU_ENVIRONMENT_SENSORS
    default "$(UNIT_NAME)_mcu"

  config PARAM_BUFFER_MCU_ENVIRONMENT_SENSOR_NAME
    string
    default "_$(UNIT_NAME)_mcu_buffer" if BOOL_HIDE_MCU_ENVIRONMENT_SENSORS
    default "$(UNIT_NAME)_mcu_buffer"

  @repeat var=i min=0 max=11@
    config PARAM_MCU_ENVIRONMENT_SENSOR_NAME_$(i)
      string
      default "_$(UNIT_NAME)_mcu$(i)" if BOOL_HIDE_MCU_ENVIRONMENT_SENSORS
      default "$(UNIT_NAME)_mcu$(i)"
  @endrepeat@
endif
```
