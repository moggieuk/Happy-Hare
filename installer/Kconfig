## installer/Kconfig.idler_stepper
```kconfig
# Idler stepper parameter tokens for hardware and speeds
# Must be in a "if MMU_HAS_IDLER" clause in cfg templates
#
# Responsible for setting:
#   PARAM_IDLER_GEAR_RATIO
#   PARAM_IDLER_ROTATION_DISTANCE
#   PARAM_IDLER_RUN_CURRENT
#   PARAM_IDLER_HOLD_CURRENT
#   PARAM_IDLER_FULL_STEPS_PER_ROTATION
#   PARAM_IDLER_TMC
#   PARAM_IDLER_SPI_BUS
#
# The idler is a stepper-driven filament grip barrel (e.g. Prusa MMU3)
# homed with stallguard "touch" on the TMC virtual endstop (mmu_idler_touch)


if MMU_HAS_IDLER
  menu "Idler stepper"

    config PARAM_IDLER_GEAR_RATIO
      string "Idler gear ratio               "
      default "1:1"

    config PARAM_IDLER_ROTATION_DISTANCE
      float "Idler rotation distance        "
      default 40
      help
        Distance the idler barrel moves for one full rotation.
        MMU3 moves the idler one gate position per rotation/num_gates.

    config PARAM_IDLER_RUN_CURRENT
      float "Idler run current              "
      default 0.5

    config PARAM_IDLER_HOLD_CURRENT
      float "Idler hold current             "
      default 0.2

    config PARAM_IDLER_FULL_STEPS_PER_ROTATION
      int "Idler full steps per rotation  "
      default 200
      help
        200 for 1.8 degree, 400 for 0.9 degree

    config PARAM_IDLER_MICROSTEPS
      int "Idler microsteps               "
      default 16
      help
        Don't need high fidelity

    config PARAM_IDLER_STEALTHCHOP
      float "Idler stealthchop threshold    "
      default 100
      help
        Speeds below this use stealthChop. Set 0 for always spreadCycle --
        REQUIRED for tmc2130 StallGuard homing (stealthChop disables it).

    config PARAM_IDLER_SGT
      int "Idler StallGuard threshold (SGT)"
      default 10
      help
        tmc2130 only. StallGuard sensitivity: -64 to 63 (higher = less
        sensitive). The Prusa MMU3 firmware tunes the idler at 2-10 -- the
        stock 60 never trips on the light barrel, while 0 and below
        false-trigger on free motion. 6 still false-triggers on the homing
        acceleration transient; 10-12 trip exactly at the stop.

    config PARAM_IDLER_TMC
      string "Idler TMC driver type          "
      default "tmc2130"
      help
        The idler needs a TMC driver with stallguard for "touch" homing

    config PARAM_IDLER_SPI_BUS
      string "Idler SPI bus                  "
      default "spi"
      help
        Only used when the idler TMC is a SPI chip (e.g. tmc2130)

    config PARAM_IDLER_DWELL
      float "Idler dwell time               "
      default 0.4
      help
        Minimum time given to the idler to complete movement prior to next move

    config PARAM_IDLER_BUZZ_GEAR_ON_DOWN
      int "Buzz gear on idler down        "
      default 3
      help
        Whether to "buzz" the gear stepper on idler down to aid engagement
        (0 to disable)

    config PARAM_IDLER_HOMING_SPEED
      float "Idler homing speed             "
      default 20
      help
        Speed of the idler homing move (stallguard "touch")

    config PARAM_IDLER_HOMING_MOVE_DIST
      float "Idler homing move distance     "
      default 40
      help
        Distance to search for the idler home position. The MMU3 idler barrel
        homes by driving against its mechanical stop (stallguard), so this
        must be at least one full rotation.

  endmenu
endif
```

## installer/Kconfig.klipper
```kconfig
menu "Advanced Klipper tuning"
  help
    Compatibility and timing workarounds applied by Happy Hare when Klipper starts.
    These settings are shared by all MMU units. Keep the defaults unless troubleshooting
    a specific problem; timing workarounds do not fix wiring or overloaded hardware.

  config PARAM_UPDATE_TRSYNC
    boolint "Increase homing synchronization timeout?"
    default 0
    help
      Raise Klipper's TRSYNC_TIMEOUT to at least 0.05 seconds. This can help with
      timing failures during homing, particularly with CANbus-connected MCUs.
      It does not resolve every "Timer too close" error. The change is applied in
      memory at startup without editing Klipper files and affects Klipper globally.
      Default 0 leaves Klipper's timeout unchanged.

  config PARAM_UPDATE_BIT_MAX_TIME
    boolint "Relax NeoPixel timing tolerance?"
    default 1
    help
      Raise Klipper's NeoPixel BIT_MAX_TIME to at least 0.000030 seconds (30 us).
      This workaround can help older LEDs that produce "Unable to obtain
      'neopixel_result' response" errors in klippy.log.
      It is applied in memory at startup without editing Klipper files and affects
      all Klipper NeoPixels. Default 1 preserves Happy Hare's shipped configuration;
      set to 0 to leave Klipper's timing unchanged.

  config PARAM_UPDATE_AHT10_COMMANDS
    boolint "Use AHT30-compatible commands with the legacy AHT10 driver?"
    default 0
    help
      Compatibility workaround for the BTT ViViD AHT30 sensor on older Klipper
      versions without native support. Configure the sensor using the AHT10 driver
      and enable this to replace that driver's command table at startup.
      This affects all sensors using that driver, not just the MMU sensor.
      Leave disabled when using native sensor support. Default 0 leaves the
      Klipper command table unchanged.

endmenu
```
