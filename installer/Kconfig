## installer/Kconfig.calibration
```kconfig
# Calibration and autotuning parameter token types and defaults
#
# Behavior parameters are generally determined by MMU type, use
#   "imply  XXX"          .. to suggest on
#   "select XXX"          .. to force on
#   "select UNSELECT_XXX" .. to force off/disable
#
# Responsible for setting:
#   PARAM_AUTOCAL_BOWDEN_LENGTH
#   PARAM_AUTOTUNE_BOWDEN_LENGTH
#   PARAM_SKIP_CAL_ROTATION_DISTANCE
#   PARAM_AUTOTUNE_ROTATION_DISTANCE
#   PARAM_SKIP_CAL_ENCODER

menu "Calibration/Autotuning"

  config PARAM_AUTOCAL_BOWDEN_LENGTH
    boolint "Auto calibrate bowden length"
    default 1 if \
      MMU_HAS_SENSOR_EXTRUDER || \
      (MMU_HAS_SYNC_FEEDBACK_BUFFER && \
       (MMU_HAS_SENSOR_BUFFER_COMPRESSION || \
        MMU_HAS_SENSOR_BUFFER_PROPORTIONAL))
    help
      Automated bowden length calibration.
      The calibrated bowden length will be established on first load. It can also be set
      manually or reset with MMU_CALIBRATE_BOWDEN. Best results require the use of
      sync-feedback-compression or extruder sensor but gear-touch or encoder will also work.
      Note that 'extruder_homing_endstop' cannot be 'none'
  config PARAM_AUTOTUNE_BOWDEN_LENGTH
    boolint "Autotune bowden length"
    default 0
    help
      Automated bowden length tuning.
      Once calibrated this setting will tune the bowden distance over time.
      Works best with extruder or toolhead sensor because this provides an
      accurate homing point near the extruder
  config PARAM_SKIP_CAL_ROTATION_DISTANCE
    boolint "Don't force rotation distance calibration"
    default 1
    help
      Skip rotation distance calibration (MMU_CALIBRATE_GEAR).
      This will rely on installed default value (although it can still be calibrated).
      Usually a good choice if autotune is enabled.
  config PARAM_AUTOTUNE_ROTATION_DISTANCE
    boolint "Autotune rotation distance"
    default 0
    #default y if MMU_HAS_SYNC_FEEDBACK_BUFFER && \
    #    ((MMU_HAS_SENSOR_BUFFER_COMPRESSION && \
    #      MMU_HAS_SENSOR_BUFFER_TENSION) || \
    #     MMU_HAS_SENSOR_BUFFER_PROPORTIONAL)
    help
      Automated gate calibration/tuning.
      Requires sync-feedback sensor (aka "buffer") with both compression and tension switches
      or accurately calibrated encoder (encoder works only with gate 0)
  config PARAM_SKIP_CAL_ENCODER
    boolint "Don't force encoder calibration"
    default 1
    help
      Skip encoder calibration (MMU_CALIBRATE_ENCODER).
      Will rely on installed default value (although it can still be calibrated).
      Not recommended but allows for easier initial setup especially when using 'autotune_encoder'
endmenu
```

## installer/Kconfig.encoder
```kconfig
# Responsible for setting:
#   MMU_HAS_ENCODER
#
# Encoder parameter tokens which must be inside if MMU_HAS_ENCODER clause in cfg templates:
#   MMU_SHARED_ENCODER
#   PARAM_ENCODER_NAME
#   PARAM_ENCODER_RESOLUTION
#   PARAM_GATE_ENDSTOP_TO_ENCODER
#   PARAM_ENCODER_MOVE_STEP_SIZE
#   PIN_ENCODER (duplicate with pins)
#   PARAM_BOWDEN_PRE_UNLOAD_TEST
#   PARAM_BOWDEN_PRE_UNLOAD_ERROR_TOLERANCE
#   PARAM_ENCODER_MOVE_VALIDATION
#   PARAM_BOWDEN_APPLY_CORRECTION
#   PARAM_BOWDEN_ALLOWABLE_ENCODER_DELTA
#   PARAM_BOWDEN_MOVE_ERROR_TOLERANCE
#   PARAM_TOOLHEAD_MOVE_ERROR_TOLERANCE
#   PARAM_TOOLHEAD_POST_LOAD_TIGHTEN
#
# Can be disabled and forced off with:
#   select UNSELECT_MMU_HAS_ENCODER


comment "_"
comment "_Encoder"

config UNSELECT_MMU_HAS_ENCODER
  def_bool n

if !UNSELECT_MMU_HAS_ENCODER
  config MMU_HAS_ENCODER
    prompt "Has encoder?"
    forceshow
    default n
    help
      An encoder measures filament movement and can be used to validate
      movement, detect clogs, monitor flow rate and detect filament
      collision with the extruder in lieu of a toolhead switch sensor.
endif


# -------------------------------------
# Encoder config
# -------------------------------------

if MMU_HAS_ENCODER
  menu "Encoder config"

    config MMU_SHARED_ENCODER
      bool "Use shared encoder?"
      default n
      help
        Select if this unit uses an encoder it doesn't define: one owned by
        another unit, or a [mmu_encoder ...] section in your own config. A shared
        encoder must see the filament from each MMU, so this is not common.

    config PARAM_ENCODER_NAME
      string "$(pad,32,Encoder name)" if !MMU_SHARED_ENCODER
      validator "$(object_name_validator)"
      help
        The Klipper object name of this unit's encoder: [mmu_encoder [[B]][[VALUE:PARAM_ENCODER_NAME]][[/B]]].
        Another unit can share it by this name.
        Use lowercase letters, digits, "_" and "-", starting with a letter.

    config PARAM_ENCODER_NAME
      string "$(pad,32,Shared encoder object name)" if MMU_SHARED_ENCODER
      # A sharer's saved name, unless it is older installs' placeholder
      default "$(saved-config-value,PARAM_ENCODER_NAME)" if MMU_SHARED_ENCODER && "$(saved-config-value,MMU_SHARED_ENCODER)" = "y" && \
        "$(saved-config-value,PARAM_ENCODER_NAME)" != "-specify name-"
      default "" if MMU_SHARED_ENCODER
      default UNIT_NAME
      help
        The name of the encoder this unit uses: [mmu_encoder [[B]][[VALUE:PARAM_ENCODER_NAME]][[/B]]].
        Either another unit's "Encoder name" or a section in your own config.
        This unit renders no [mmu_encoder] section of its own.

    comment "Known shared encoders: $(first-nonempty,$(owner-names,encoder),none)" if MMU_SHARED_ENCODER
      dim

    # The shared name is another unit's own encoder
    config SHARED_ENCODER_FOUND
      bool
      @repeat var=i min=0 max=$(owner-max,encoder)@
      default y if MMU_SHARED_ENCODER && "$(owner-name,encoder,$(i))" != "" && PARAM_ENCODER_NAME = "$(owner-name,encoder,$(i))"
      @endrepeat@

    comment "No other unit owns this encoder: define it in your own config" if \
        MMU_SHARED_ENCODER && !SHARED_ENCODER_FOUND && PARAM_ENCODER_NAME != ""
      dim

    if !MMU_SHARED_ENCODER
      choice CHOICE_ENCODER_TYPE
        prompt "Type"
        default CHOICE_ENCODER_TYPE_BINKY_12
        help
          Select the base of the encoder design. This will set the default resolution.

        config CHOICE_ENCODER_TYPE_BINKY_8
          bool "Binky 8 vane wheel"
          help
            Select for Binky based encoders with an 8 vane encoder wheel.

        config CHOICE_ENCODER_TYPE_BINKY_10
          bool "Binky 10 vane wheel"
          help
            Select for Binky based encoders with an 10 vane encoder wheel.

        config CHOICE_ENCODER_TYPE_BINKY_12
          bool "Binky 12 vane wheel"
          help
            Select for Binky based encoders with an 12 vane encoder wheel.

        config CHOICE_ENCODER_TYPE_TCRT5000
          bool "TCRT 5000 based"
          help
            Select for older TCRT5000 based encoders.
            (this was the one fitted to ERCF v1.1)

        config CHOICE_ENCODER_TYPE_OTHER
          bool "Other"
          help
            Select for any other encoder and ensure you set the resolution correctly.
      endchoice

      config PARAM_ENCODER_RESOLUTION
        help
          Ensure this matches the resolution of your encoder. It represents
          filament movement (mm) for each sensor pulse. Note that this is
          only used as an initial value and it overridden by calibration.

          (defaults are based on a 23.5mm rotation distance BMG gear)
        float "Uncalibrated encoder resolution "
        default 0.7059 if CHOICE_ENCODER_TYPE_TCRT5000
        default 0.979  if CHOICE_ENCODER_TYPE_BINKY_12
        default 1.175  if CHOICE_ENCODER_TYPE_BINKY_10
        default 1.469  if CHOICE_ENCODER_TYPE_BINKY_8
        default 1.0    if CHOICE_ENCODER_TYPE_OTHER
        default 1.0

      config PIN_ENCODER
        prompt "Encoder pin                     "
        validator "$(pin_validator)"
        help
          $(pin_help)

    endif

    config PARAM_GATE_ENDSTOP_TO_ENCODER
      float "Gate endstop to encoder distance"
      default 10 if MMU_HAS_SENSOR_SHARED_EXIT || MMU_HAS_SENSOR_EXIT
      default 0
      help
        The distance from the gate endstop to when the encoder "sees" the filament.
        If the gate endstop is the encoder then this is ignored, however, if using
        a shared_exit endstop we need to know how much of the movement is not
        seen by the encoder. If this is not set the encoder will always measure
        less that the actual movement. Set on every unit, including one that
        shares another unit's encoder, because each unit has its own gate endstop.

    config PARAM_ENCODER_MOVE_STEP_SIZE
      float "$(pad,32,Encoder small move step size)"
      range 5 25
      default 15.0
      help
        ADVANCED: Length (mm) of the short encoder-checked moves: the bowden
        pre-unload test, the check for filament left in the extruder gears and
        each step when unloading back to an encoder gate endstop. A final
        extruder unload no longer than this skips the encoder check, as does
        a load once a buffer has confirmed grip. Shorter is quicker but
        harder for the encoder to see.

    if !MMU_SHARED_ENCODER
      config PARAM_REGISTER_AS_SENSOR
        boolint "Register as virtual switch sensor"
        default 1
        help
          This controls whether the encoder appears as a (virtual) filament switch
          sensor in UI's like Mainsail and Fluidd.
          Note that it is always available as an sensor/endstop. This controls
          just the visibility in UI's

    endif

    comment "_"
    comment "_Encoder Validation Options"

    config PARAM_BOWDEN_PRE_UNLOAD_TEST
      boolint "Check for bowden movement before full unload pull?"
      default 1
      help
        This safety check uses the encoder to verify the filament is free of the
        extruder before the fast bowden unload, to reduce the possibility of
        grinding filament. Tune it with "Pre-unload test tolerance %".
        1 to check for bowden movement before full pull (slower), 0 don't check (faster)

    config PARAM_BOWDEN_PRE_UNLOAD_ERROR_TOLERANCE
      int
      prompt "$(pad,32,Pre-unload test tolerance %)" if PARAM_BOWDEN_PRE_UNLOAD_TEST
      range 0 100
      default 50
      keep_when_hidden
      help
        ADVANCED: How much of the pre-unload test move the encoder may miss
        before the test fails, as a % of the move. A failure means the filament
        looks stuck in the extruder, so the fast bowden unload is not attempted.
        50% usually works well. Raise it if the test fails when the filament is
        free; 100 effectively disables the test.

    config PARAM_ENCODER_MOVE_VALIDATION
      boolint "Use encoder to validate movement distance?"
      default 1
      help
        ADVANCED: Determines if encoder measurement should be used to validate movement distance.
        Disabling eliminates slight pause between moves but is less safe

    config PARAM_BOWDEN_APPLY_CORRECTION
      boolint
      prompt "Apply bowden correction moves?" if PARAM_ENCODER_MOVE_VALIDATION
      default 0
      keep_when_hidden
      help
        Make correction moves when the fast bowden load falls short, e.g. from
        missed steps caused by "jerking" on a heavy spool. Happy Hare believes
        the encoder and moves the filament to within "Bowden allowable encoder
        delta" of the end of the bowden. Needs a reliable encoder; not
        recommended for very high speed loading (>350mm/s).

    config PARAM_BOWDEN_ALLOWABLE_ENCODER_DELTA
      float
      prompt "$(pad,32,Bowden allowable encoder delta)" if PARAM_ENCODER_MOVE_VALIDATION
      default 20.0
      keep_when_hidden
      help
        Slippage threshold (mm) for the fast bowden move. When the encoder
        measures a load or unload short by at least this much, a slippage
        warning is logged and the move is left out of auto-calibration.
        With bowden correction on, correction moves try to bring the load
        within this distance of the target.

    config PARAM_BOWDEN_MOVE_ERROR_TOLERANCE
      int
      prompt "$(pad,32,Bowden move error tolerance %)" if PARAM_ENCODER_MOVE_VALIDATION
      range 0 100
      default 60
      keep_when_hidden
      help
        ADVANCED: How much of the fast bowden load move the encoder may miss
        before the load fails, as a % of the move ("filament stuck in the gate").
        Lower is stricter; 100 effectively turns the check off.

    config PARAM_TOOLHEAD_MOVE_ERROR_TOLERANCE
      int
      prompt "$(pad,32,Toolhead move error tolerance %)" if PARAM_ENCODER_MOVE_VALIDATION
      range 0 100
      default 80
      keep_when_hidden
      help
        ADVANCED: How much of the final extruder load the encoder may miss before
        the load fails, as a % of the move (unload only warns). Not used when the
        load homes to a toolhead sensor or a sync-feedback buffer confirms grip.
        A failure usually means load speed or filament friction is too high:
        fix those before raising this.
        Lower is stricter; 100 effectively turns the check off.

    config PARAM_TOOLHEAD_POST_LOAD_TIGHTEN
      int
      prompt "$(pad,32,Post-load tighten %)" if PARAM_ENCODER_MOVE_VALIDATION
      range 0 100
      default 60
      keep_when_hidden
      help
        After a load, pull the filament back with the gear at 50% current to take
        up bowden slack that can cause a false encoder clog detection. The pull is
        this % of the clog detection length, at most 15mm. Only used with encoder
        flowguard enabled and the gear not synced to the extruder. 0 to disable.

  endmenu
endif
```
