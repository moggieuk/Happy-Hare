## installer/Kconfig.motor_sync
```kconfig
# This module is responsible for sync-feedback buffer and
# motor synchronization parameters:
#
#   PARAM_SYNC_FEEDBACK_ENABLED
#
#   PARAM_SYNC_TO_EXTRUDER
#   PARAM_SYNC_FORM_TIP
#   PARAM_SYNC_PURGE
#   PARAM_SYNC_GEAR_CURRENT
#   PARAM_TOOLHEAD_POST_LOAD_TENSION_ADJUST
#   PARAM_TOOLHEAD_ENTRY_TENSION_TEST

menu "MMU/Extruder sync"
  help
    Some MMU designs allow fine control over when the MMU stepper is
    synced with the extruder stepper. Synchronization helps to
    overcome friction in the filament path.

  if MMU_HAS_SYNC_FEEDBACK_BUFFER
    config PARAM_SYNC_FEEDBACK_ENABLED
      boolint "Enable dynamic sync feedback?"
      default 1
      help
        Sync feedback from the buffer will be used to dynamically adjust the
        gear stepper speed to exactly match the extruder. This prevents
        under extrusion artifacts caused by filament drag.

  endif

  config PARAM_SYNC_TO_EXTRUDER
    boolint "Enable sync to extruder?" if !PARAM_FILAMENT_ALWAYS_GRIPPED
    default 1 if PARAM_FILAMENT_ALWAYS_GRIPPED
    help
      This controls whether the extruder and gear steppers are synchronized
      during printing operations.

  config PARAM_SYNC_GEAR_CURRENT
    int "Synchronized gear current        "
    default 100
    help
      % of gear_stepper current (10%-100%) to use when syncing with extruder during print

  config PARAM_SYNC_FORM_TIP
    boolint "Enable syncing while tip forming?" if !PARAM_FILAMENT_ALWAYS_GRIPPED
    default 1 if ENABLE_SYNC_TO_EXTRUDER
    help
      This controls whether the extruder and gear steppers are synchronized
      during tip forming operation.

      Set extruder current in "Software options" section

  config PARAM_SYNC_PURGE
    boolint "Enable syncing while purging?" if !PARAM_FILAMENT_ALWAYS_GRIPPED
    default 1 if ENABLE_SYNC_TO_EXTRUDER
    help
      This controls whether the extruder and gear steppers are synchronized
      during purging operation.

      Set extruder current in "Software options" section

  comment "_"

  config PARAM_TOOLHEAD_POST_LOAD_TENSION_ADJUST
    boolint "Adjust neutral tension after toolhead load?"
    default 1
    help
      If synchronizing gear and extruder and you have a sync-feedback "buffer" (switch based or
      proportional) this setting determines whether to use it to create neutral tension after loading

  config PARAM_TOOLHEAD_ENTRY_TENSION_TEST
    boolint "Test filament entry via tension after extruder move?"
    default 1
    help
      If sync-feedback compression sensor is available this test will ensure the filament passes the
      extruder entry by checking for neutral tension when moving filament with just the extruder.
      Recommended with sprung loaded sync-feedback buffers. This is ignored if toolhead sensor is available.

endmenu
```

## installer/Kconfig.name
```kconfig
# Responsible for setting:
#   UNIT_NAME (prompt only for a single unit)
#   PARAM_DISPLAY_NAME

menu "Name"
  help
    The Klipper object name identifies this MMU unit in config and saved
    state. The display name is what UIs show.

  # Renaming an installed unit needs Replace mode, like the multi-unit MMU units list
  config UNIT_NAME
    prompt "Klipper object name" if !MULTI_UNIT && "$(env-default,F_UNITS_RESTRUCTURE,n)" = "y"
    validator "[a-z][a-z0-9_-]*"
    reparse_env "UNIT_NAME MCU_NAME"
    help
      The name Klipper knows this unit by. It is used in:
        Config sections:  [mmu_unit [[B]][[VALUE:UNIT_NAME]][[/B]]], [mcu [[B]][[VALUE:UNIT_NAME]][[/B]]]
        Pins:             [[B]][[VALUE:UNIT_NAME]][[/B]]:PA1
        Saved state:      mmu_[[B]][[VALUE:UNIT_NAME]][[/B]]_* in mmu_vars.cfg
      Use lowercase letters, digits, "_" and "-", starting with a letter.
      Change it freely on a first install. Once installed, renaming needs
      the installer's [[REV]]Replace[[/REV]] mode (option 2) to migrate saved state.

  comment "Klipper object name: $(UNIT_NAME)  (set in the MMU units list)" if MULTI_UNIT
  comment "Klipper object name: $(UNIT_NAME)  (rename with './install.sh -i', REPLACE mode)" if !MULTI_UNIT && "$(env-default,F_UNITS_RESTRUCTURE,n)" != "y"

  config PARAM_DISPLAY_NAME
    string "Display name       "
    generated_default "%s-%d" "PARAM_VENDOR UNIT_INDEX" if PARAM_VENDOR != "Other"
    default UNIT_NAME
    help
      The display name identifies your MMU in various UI's.
      It is NOT the Klipper object name used in config.

      Keep it reasonably short but it may contain spaces.
endmenu
```
