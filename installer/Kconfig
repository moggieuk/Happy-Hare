## installer/Kconfig.leds
```kconfig
# LED parameter token types and defaults.
#
# Responsible for setting:
#   MMU_HAS_LEDS
#
# Led parameter tokens which must be inside if MMU_HAS_LEDS clause in cfg templates:
#   PIN_NEOPIXEL (duplicate with pins)
#   PIN_NEOPIXEL_X (per-gate MCU)
#   PARAM_ENABLED
#   PARAM_ANIMATION
#   PARAM_EXIT_EFFECT
#   PARAM_ENTRY_EFFECT
#   PARAM_STATUS_EFFECT
#   PARAM_CHAIN_COUNT
#   PARAM_COLOR_ORDER
#   PARAM_EXIT_LEDS
#   PARAM_ENTRY_LEDS
#   PARAM_EXIT_LED_COUNTS
#   PARAM_ENTRY_LED_COUNTS
#   PARAM_STATUS_LEDS
#   PARAM_LOGO_LEDS
#   PARAM_FRAME_RATE
#
# Can be disabled and forced off with:
#   select UNSELECT_MMU_HAS_LEDS

#comment "_"
comment "_Leds"

config UNSELECT_MMU_HAS_LEDS
  def_bool n

if !UNSELECT_MMU_HAS_LEDS
  config MMU_HAS_LEDS
    prompt "Has LEDs?"
    forceshow
    default n
    help
      Select if your MMU has LEDs.
endif


# -------------------------------------
# LED config
# -------------------------------------

if MMU_HAS_LEDS
  menu "LED config"
    help
      Configure the LED hardware, logical segments, startup behavior and default
      effects for this MMU unit.

    config BOOL_ENABLE_LEDS
      bool "Enable LEDs?"
      default y
      help
        Enable the LEDs when Happy Hare starts. Disable this to keep the LED
        configuration installed while leaving all LEDs off at startup. They can
        still be enabled later with MMU_LED.

    config PARAM_ENABLED
      string
      default "True" if BOOL_ENABLE_LEDS
      default "False"

    config BOOL_ENABLE_LEDS_ANIMATION
      bool "Enable animation?"
      default y
      help
        This allows you to turn off LED animations perhaps reducing the overhead
        on your main klipper CPU. Only disable if you have frequent TTC errors
        caused by overload (rarely necessary).

    config PARAM_ANIMATION
      string
      default "True" if BOOL_ENABLE_LEDS_ANIMATION
      default "False"

    choice CHOICE_EXIT_EFFECT
      prompt "Exit effect     "
      default CHOICE_EXIT_EFFECT_GATE_STATUS
      help
        off turns the segment off. gate_status shows gate availability and state.
        filament_color shows the filament color stored in the gate map.
        slicer_color shows the color assigned by the slicer.

      config CHOICE_EXIT_EFFECT_OFF
        bool "off"
        help
          Keep the exit LEDs off when no temporary or action effect is active.

      config CHOICE_EXIT_EFFECT_GATE_STATUS
        bool "gate_status"
        help
          Show the availability and status of each gate on its exit LEDs.

      config CHOICE_EXIT_EFFECT_FILAMENT_COLOR
        bool "filament_color"
        help
          Show each gate's filament color from the Happy Hare gate map.

      config CHOICE_EXIT_EFFECT_SLICER_COLOR
        bool "slicer_color"
        help
          Show the color assigned to each gate by the slicer.
    endchoice

    config PARAM_EXIT_EFFECT
      string
      default "off"            if CHOICE_EXIT_EFFECT_OFF
      default "gate_status"    if CHOICE_EXIT_EFFECT_GATE_STATUS
      default "filament_color" if CHOICE_EXIT_EFFECT_FILAMENT_COLOR
      default "slicer_color"   if CHOICE_EXIT_EFFECT_SLICER_COLOR
      default "gate_status"

    choice CHOICE_ENTRY_EFFECT
      prompt "Entry effect    "
      default CHOICE_ENTRY_EFFECT_FILAMENT_COLOR
      help
        off turns the segment off. gate_status shows gate availability and state.
        filament_color shows the filament color stored in the gate map.
        slicer_color shows the color assigned by the slicer.

      config CHOICE_ENTRY_EFFECT_OFF
        bool "off"
        help
          Keep the entry LEDs off when no temporary or action effect is active.

      config CHOICE_ENTRY_EFFECT_GATE_STATUS
        bool "gate_status"
        help
          Show the availability and status of each gate on its entry LEDs.

      config CHOICE_ENTRY_EFFECT_FILAMENT_COLOR
        bool "filament_color"
        help
          Show each gate's filament color from the Happy Hare gate map.

      config CHOICE_ENTRY_EFFECT_SLICER_COLOR
        bool "slicer_color"
        help
          Show the color assigned to each gate by the slicer.
    endchoice

    config PARAM_ENTRY_EFFECT
      string
      default "off"            if CHOICE_ENTRY_EFFECT_OFF
      default "gate_status"    if CHOICE_ENTRY_EFFECT_GATE_STATUS
      default "filament_color" if CHOICE_ENTRY_EFFECT_FILAMENT_COLOR
      default "slicer_color"   if CHOICE_ENTRY_EFFECT_SLICER_COLOR
      default "filament_color"

    choice CHOICE_STATUS_EFFECT
      prompt "Status effect   "
      default CHOICE_STATUS_EFFECT_FILAMENT_COLOR
      help
        off turns the segment off. gate_status shows gate availability and state.
        filament_color shows the selected filament color from the gate map.
        slicer_color shows the selected color assigned by the slicer.

      config CHOICE_STATUS_EFFECT_OFF
        bool "off"
        help
          Keep the status LEDs off when no temporary or action effect is active.

      config CHOICE_STATUS_EFFECT_GATE_STATUS
        bool "gate_status"
        help
          Show the status of the selected gate on the status LEDs.

      config CHOICE_STATUS_EFFECT_FILAMENT_COLOR
        bool "filament_color"
        help
          Show the selected gate's filament color from the Happy Hare gate map.

      config CHOICE_STATUS_EFFECT_SLICER_COLOR
        bool "slicer_color"
        help
          Show the selected gate's color assigned by the slicer.
    endchoice

    config PARAM_STATUS_EFFECT
      string
      default "off"            if CHOICE_STATUS_EFFECT_OFF
      default "gate_status"    if CHOICE_STATUS_EFFECT_GATE_STATUS
      default "filament_color" if CHOICE_STATUS_EFFECT_FILAMENT_COLOR
      default "slicer_color"   if CHOICE_STATUS_EFFECT_SLICER_COLOR
      default "filament_color"

    comment "_"


    config PARAM_FRAME_RATE
      int "Frame rate      "
      range 6 32
      default 24
      help
        Set the LED animation frame rate. The default is 24 frames per second.
        Reducing this to 15 can slightly reduce Klipper CPU load, although lower
        values may make some effects look less smooth.

    config PARAM_EXIT_LEDS
      string
      array_editor ";"
      default "" if CUSTOM_LED_SETUP

    config PARAM_ENTRY_LEDS
      string
      array_editor ";"
      default "" if CUSTOM_LED_SETUP

    config PARAM_EXIT_LED_COUNTS
      string
      array_editor "," PARAM_NUM_GATES
      default ""

    config PARAM_ENTRY_LED_COUNTS
      string
      array_editor "," PARAM_NUM_GATES
      default ""

    config PARAM_STATUS_LEDS
      string
      array_editor ";"
      default "" if CUSTOM_LED_SETUP

    config PARAM_LOGO_LEDS
      string
      array_editor ";"
      default "" if CUSTOM_LED_SETUP

    if !CUSTOM_LED_SETUP

      config BOOL_EMU_SLB_HACK
        bool
        default y if MMU_HAS_PER_GATE_MCU && PARAM_VENDOR = "EMU" && PARAM_BOARD_TYPE = "SLB v1"

      config PARAM_CHAIN_COUNT
        int "Chain count     "
        default 4 if BOOL_EMU_SLB_HACK
        default 1 if MMU_HAS_PER_GATE_MCU
        default PARAM_NUM_GATES
        help
          Set the number of physical LEDs in each generated Neopixel chain. The
          chain must contain every LED index referenced by the segment mappings.

      config PARAM_COLOR_ORDER
        string "Color order     "
        default "GRBW"
        help
          Set the channel order expected by the LEDs, for example RGB, GRB, RGBW
          or GRBW. This must match the physical LED type and wiring.

      config PARAM_EXIT_LEDS
        prompt "Exit leds       "
        generated_default "neopixel:_$(UNIT_NAME)_gate%i_leds (1-%d)" "PARAM_NUM_GATES" "; " 0 PARAM_NUM_GATES if MMU_HAS_PER_GATE_MCU
        generated_default "neopixel:_$(UNIT_NAME)_leds (1-%d)" "PARAM_NUM_GATES"
        help
          Assign the LEDs mounted at the filament exit for each gate. Use a
          virtual-chain specification such as "neopixel:my_leds (1-4)". Multiple
          chains can be entered in the array editor, and ranges may be reversed
          when the physical chain runs in the opposite gate order.

      config PARAM_EXIT_LED_COUNTS
        prompt "Exit led counts "
        depends on PARAM_EXIT_LEDS != ""
        help
          [[B]]Normally leave this empty.[[/B]]
          LEDs are then distributed equally among all gates. For an uneven
          split, enter one positive integer per gate. The number of entries
          MUST equal num_gates, and the sum of the counts MUST equal the number
          of LEDs specified by exit_leds. Counts consume the virtual chain in
          gate order. Example for 10 LEDs over 4 gates: "1, 1, 2, 6".

      config PARAM_ENTRY_LEDS
        prompt "Entry leds      "
        help
          Assign the LEDs mounted at the filament entry for each gate. Use a
          virtual-chain specification such as "neopixel:my_leds (5-8)". Leave
          this empty when the unit has no entry LED segment.

      config PARAM_ENTRY_LED_COUNTS
        prompt "Entry led counts"
        depends on PARAM_ENTRY_LEDS != ""
        help
          [[B]]Normally leave this empty.[[/B]]
          LEDs are then distributed equally among all gates. For an uneven
          split, enter one positive integer per gate. The number of entries
          MUST equal num_gates, and the sum of the counts MUST equal the number
          of LEDs specified by entry_leds. Counts consume the virtual chain in
          gate order. Example for 8 LEDs over 4 gates: "1, 1, 2, 4".

      config PARAM_STATUS_LEDS
        prompt "Status leds     "
        help
          Assign one or more LEDs used to show the overall MMU and selected
          filament status. Use a virtual-chain specification such as
          "neopixel:my_leds (9)". Leave this empty when no status LEDs are fitted.

      config PARAM_LOGO_LEDS
        prompt "Logo leds       "
        help
          Assign any decorative LEDs used to illuminate an MMU logo. Use a
          virtual-chain specification such as "neopixel:my_leds (10-12)". Leave
          this empty when no logo LEDs are fitted.

      config PIN_NEOPIXEL
        prompt "Neopixel pin    " if !MMU_HAS_PER_GATE_MCU
        help
          Set the MCU pin connected to the data input of the generated Neopixel
          chain for this unit.

      menu "Neopixel per-gate pins" 
        depends on MMU_HAS_PER_GATE_MCU
        help
          Set the Neopixel data pin on each gate MCU. Each configured gate gets
          its own generated LED chain.

        @repeat var=i min=0 max=11@
          config PIN_NEOPIXEL_$(i)
            string
            prompt "Neopixel gate $(i) pin" if PARAM_NUM_GATES > $(i)
            help
              Set the data pin for the Neopixel chain connected to gate $(i)'s MCU.
        @endrepeat@
      endmenu

      # Hack to special case SLB v1 board wiring with EMU
      menu "Neopixel per-gate box pins" 
        depends on BOOL_EMU_SLB_HACK
        help
          Set the additional box-side Neopixel data pin for each EMU gate using
          an SLB v1 board.

        @repeat var=i min=0 max=11@
          config PIN_NEOPIXEL_BOX_$(i)
            string
            prompt "Neopixel box gate $(i) pin" if PARAM_NUM_GATES > $(i)
            help
              Set the box-side Neopixel data pin associated with gate $(i).
        @endrepeat@

        config PARAM_CHAIN_COUNT
          int "Chain count     "
          default PARAM_NUM_GATES
          help
            Set the number of physical LEDs in the generated box-side chain.

      endmenu

    endif

  endmenu
endif
```

## installer/Kconfig.macro_overrides
```kconfig
# Callback macro overrides ([mmu_parameters] *_macro options)
#
# Responsible for setting:
#   PARAM_PAUSE_MACRO
#   PARAM_ACTION_CHANGED_MACRO
#   PARAM_PRINT_STATE_CHANGED_MACRO
#   PARAM_MMU_EVENT_MACRO
#   PARAM_POST_PRELOAD_MACRO
#   PARAM_PRE_UNLOAD_MACRO
#   PARAM_POST_FORM_TIP_MACRO
#   PARAM_POST_UNLOAD_MACRO
#   PARAM_PRE_LOAD_MACRO
#   PARAM_POST_LOAD_MACRO
#   PARAM_UNLOAD_SEQUENCE_MACRO
#   PARAM_LOAD_SEQUENCE_MACRO

menu "Macro hook overrides [[DIM]](ADVANCED)[[/DIM]]"
  help
    Names of the macros Happy Hare calls. Overriding one replaces the whole
    shipped macro, so prefer the "User macro hooks" extensions under
    Macro Variables -> Sequence macros to add behavior.

  config PARAM_PAUSE_MACRO
    string "Pause macro               "
    default "PAUSE"
    help
      What macro to call on MMU error (must put printer in paused state)

  comment "_"
  comment "_Status callbacks"

  config PARAM_ACTION_CHANGED_MACRO
    string "Action changed macro      "
    default "_MMU_ACTION_CHANGED"
    help
      Called when action (printer.mmu.action) changes

  config PARAM_PRINT_STATE_CHANGED_MACRO
    string "Print state changed macro "
    default "_MMU_PRINT_STATE_CHANGED"
    help
      Called when print state (printer.mmu.print_state) changes

  config PARAM_MMU_EVENT_MACRO
    string "MMU event macro           "
    default "_MMU_EVENT"
    help
      Called on useful MMU events

  comment "_"
  comment "_Sequence macros"

  config PARAM_POST_PRELOAD_MACRO
    string "Post preload macro        "
    default "_MMU_POST_PRELOAD"
    help
      Called after successful preload of filament

  config PARAM_PRE_UNLOAD_MACRO
    string "Pre unload macro          "
    default "_MMU_PRE_UNLOAD"
    help
      Called before starting the unload

  config PARAM_POST_FORM_TIP_MACRO
    string "Post form tip macro       "
    default "_MMU_POST_FORM_TIP"
    help
      Called immediately after tip forming

  config PARAM_POST_UNLOAD_MACRO
    string "Post unload macro         "
    default "_MMU_POST_UNLOAD"
    help
      Called after unload completes

  config PARAM_PRE_LOAD_MACRO
    string "Pre load macro            "
    default "_MMU_PRE_LOAD"
    help
      Called before starting the load

  config PARAM_POST_LOAD_MACRO
    string "Post load macro           "
    default "_MMU_POST_LOAD"
    help
      Called after the load is complete

  comment "_"
  comment "_VERY ADVANCED"

  config PARAM_UNLOAD_SEQUENCE_MACRO
    string "Unload sequence macro     "
    default "_MMU_UNLOAD_SEQUENCE"
    help
      Optionally called based on 'gcode_unload_sequence'

  config PARAM_LOAD_SEQUENCE_MACRO
    string "Load sequence macro       "
    default "_MMU_LOAD_SEQUENCE"
    help
      Optionally called based on 'gcode_load_sequence'

endmenu
```

## installer/Kconfig.mmu_additions
```kconfig
# This aggregates configuration for MMU additions
# (this overlaps with some of Kconfig.pins and Kconfig.other)

menu "MMU Features / Additions"
  help
    Enhancements to base design
    If the base MMU design lacks a particular feature, there are often
    modifications available to enhance the design. Select those modifications
    here so that Happy Hare will install the correct drivers and setup
    the best possible starter configuration.

  source "Kconfig.leds"
  source "Kconfig.fans"
  source "Kconfig.sync_feedback_buffer"
  source "Kconfig.environment_sensor"
  source "Kconfig.heater"
  source "Kconfig.nfc_reader"
  source "Kconfig.eject_buttons"
  source "Kconfig.encoder"
  source "Kconfig.espooler"
  source "Kconfig.filament_buffer"
  comment "_"
  comment "_Sensors"
  source "sensors/Kconfig"
endmenu
```
