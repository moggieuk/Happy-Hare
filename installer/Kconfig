## installer/Kconfig.fans
```kconfig
# Responsible for defining/setting fan configuration:
#   MMU_HAS_FANS
#   MMU_HAS_PER_GATE_CONFIG
#
# Managed fan parameter tokens
#   PARAM_FAN_MAX_POWER, PARAM_FAN_KICK_START_TIME, PIN_FAN, PARAM_FAN_NAME
#     (shared configuration)
#   PARAM_FAN_MAX_POWER_X, PARAM_FAN_KICK_START_TIME_X, PIN_FAN_X, PARAM_FAN_NAME_X
#     (per-gate configuration)
#
# Fan control parameter tokens
#   PARAM_DEFAULT_FAN_TEMPERATURE_SOURCE
#   PARAM_DEFAULT_FAN_ON_TEMP
#   PARAM_DEFAULT_FAN_OFF_TEMP
#   PARAM_FAN_POLLING_TIME
#   PARAM_FAN_CONTROL_ENABLED
#   PARAM_FAN_FORCED_MODE (choice: AUTO, OFF, ON)
#   PARAM_FAN_FORCED (mapped value: 0, 1, 2)
#
# Can be disabled and forced off with:
#   select UNSELECT_MMU_HAS_FANS
#
# Responsible for defining/setting controller fan configuration:
#   MMU_HAS_CONTROLLER_FAN
#
# Controller fan parameter tokens
#   PARAM_CONTROLLER_FAN_MAX_POWER, PARAM_CONTROLLER_FAN_KICK_START_TIME,
#   PARAM_CONTROLLER_FAN_SPEED, PARAM_CONTROLLER_FAN_IDLE_TIMEOUT,
#   PIN_CONTROLLER_FAN, PARAM_CONTROLLER_FAN_NAME (shared configuration)
#   PARAM_CONTROLLER_FAN_MAX_POWER_X, PARAM_CONTROLLER_FAN_KICK_START_TIME_X,
#   PARAM_CONTROLLER_FAN_SPEED_X, PARAM_CONTROLLER_FAN_IDLE_TIMEOUT_X,
#   PIN_CONTROLLER_FAN_X, PARAM_CONTROLLER_FAN_NAME_X (per-gate configuration)


if CUSTOM_FAN_SETUP
  comment "_"
  comment "_Managed Environment Fan"
  comment "$(misc_hardware_hint)"
endif

if !CUSTOM_FAN_SETUP
  comment "_"
  comment "_Managed Environment Fan"

  config UNSELECT_MMU_HAS_FANS
    def_bool n

  if !UNSELECT_MMU_HAS_FANS
    config MMU_HAS_FANS
      bool "Enable managed fan(s)?"
      depends on MMU_HAS_ENVIRONMENT_SENSOR || BOOL_CREATE_MCU_ENVIRONMENT_SENSORS
      forceshow
      default n
      help
        Configure [fan_generic] objects managed by Happy Hare for environmental
        cooling or ventilation. A configured environment or MCU temperature
        sensor is required. Heater fans are configured with their heaters and
        the electronics cooling fan with the controller fan below.
  endif
endif


# -------------------------------------
# Fan hardware config
# -------------------------------------

if MMU_HAS_FANS && !CUSTOM_FAN_SETUP
  if !MMU_HAS_PER_GATE_CONFIG
    menu "Fan h/w config"
      help
        Configure the pin and electrical behavior of the shared managed fan.

      config PARAM_FAN_MAX_POWER
        float "Fan maximum power  "
        default 1.0
        range 0.1 1.0
        help
          Maximum power setting for the fan (0.1 to 1.0).
          1.0 = 100% power

      config PARAM_FAN_KICK_START_TIME
        float "Fan kick start time"
        default 0.5
        range 0 3.0
        help
          Time in seconds to run fan at full power before resetting to target speed.

      config PIN_FAN
        string "Fan pin            "
        validator "$(pin_validator)"
        default ""
        help
          Pin for the fan shared by this MMU unit.
          Leave blank if you don't have a fan installed.
          Empty pins will be ignored in the generated configuration.

      config BOOL_HIDE_FAN
        bool "Hide in Mainsail / Fluidd"
        default y
        help
          Prefix the fan name with an underscore to hide it in the UI.
          Disable to show the fan. Automatic fan control is unchanged.

      config PARAM_FAN_NAME
        string
        default "_$(UNIT_NAME)_fan" if BOOL_HIDE_FAN
        default "$(UNIT_NAME)_fan"

    endmenu
  endif

  if MMU_HAS_PER_GATE_CONFIG
    menu "Fan h/w config"
      help
        Configure the managed fan of each gate.

      @repeat var=i min=0 max=11@
        if PARAM_NUM_GATES > $(i)
          menuconfig PARAM_FAN_GATE_$(i)
            bool "Gate $(i) fan"
            default y
            help
              Create a [fan_generic] managed by Happy Hare for this gate.

          if PARAM_FAN_GATE_$(i)
            config PARAM_FAN_MAX_POWER_$(i)
              float "Fan maximum power  "
              default 1.0
              range 0.1 1.0
              help
                Maximum power setting for this gate's fan (0.1 to 1.0).

            config PARAM_FAN_KICK_START_TIME_$(i)
              float "Fan kick start time"
              default 0.5
              range 0 3.0
              help
                Time in seconds to run this gate's fan at full power before
                resetting to its target speed.

            config PIN_FAN_$(i)
              string "Fan pin            "
              validator "$(pin_validator)"
              help
                Leave blank if this gate does not have a managed fan installed.

            config BOOL_HIDE_FAN_$(i)
              bool "Hide in Mainsail / Fluidd"
              default y
              help
                Prefix the fan name with an underscore to hide it in the UI.
                Disable to show the fan. Automatic fan control is unchanged.

            config PARAM_FAN_NAME_$(i)
              string
              default "_$(UNIT_NAME)_fan$(i)" if BOOL_HIDE_FAN_$(i)
              default "$(UNIT_NAME)_fan$(i)"
          endif
        endif
      @endrepeat@
    endmenu
  endif

  config FAN_HAS_ENVIRONMENT_TEMPERATURE
    def_bool y if MMU_HAS_ENVIRONMENT_SENSOR

  config FAN_HAS_MCU_TEMPERATURE
    def_bool y if BOOL_CREATE_MCU_ENVIRONMENT_SENSORS

  menu "Managed fan defaults"
    help
      Configure the managed fan settings applied when Happy Hare starts.
      At runtime, MMU_FAN can change enable state, mode, temperature source,
      and ON/OFF temperatures for the unit or selected per-gate fans.

    choice CHOICE_DEFAULT_FAN_TEMPERATURE_SOURCE
      prompt "Default fan temperature source"
      depends on FAN_HAS_ENVIRONMENT_TEMPERATURE || FAN_HAS_MCU_TEMPERATURE
      default CHOICE_DEFAULT_FAN_TEMPERATURE_SOURCE_ENVIRONMENT if FAN_HAS_ENVIRONMENT_TEMPERATURE
      default CHOICE_DEFAULT_FAN_TEMPERATURE_SOURCE_MCU if FAN_HAS_MCU_TEMPERATURE
      help
        Default source for every fan in the unit. Per-gate fans can be changed
        at runtime with MMU_FAN SOURCE= and GATE= or GATES=.

      config CHOICE_DEFAULT_FAN_TEMPERATURE_SOURCE_ENVIRONMENT
        bool "Environment sensor"
        depends on FAN_HAS_ENVIRONMENT_TEMPERATURE
        help
          Use the configured enclosure environment sensor. With per-gate fans,
          each fan uses the environment sensor associated with the same gate.

      config CHOICE_DEFAULT_FAN_TEMPERATURE_SOURCE_MCU
        bool "MCU temperature"
        depends on FAN_HAS_MCU_TEMPERATURE
        help
          Use the configured MMU controller CPU temperature sensor. With
          per-gate fans, each fan uses the MCU sensor associated with the same
          gate.

    endchoice

    config PARAM_DEFAULT_FAN_TEMPERATURE_SOURCE
      string
      default "environment" if CHOICE_DEFAULT_FAN_TEMPERATURE_SOURCE_ENVIRONMENT
      default "mcu" if CHOICE_DEFAULT_FAN_TEMPERATURE_SOURCE_MCU
      default ""

    config PARAM_DEFAULT_FAN_ON_TEMP
      float "Default fan ON temperature    "
      default 49.0
      range 20.0 80.0
      help
        Default temperature threshold (°C) to turn fans on. Per-gate ranges
        can be adjusted at runtime with MMU_FAN.

    config PARAM_DEFAULT_FAN_OFF_TEMP
      float "Default fan OFF temperature   "
      default 47.0
      range 20.0 80.0
      help
        Default temperature threshold (°C) to turn fans off. Per-gate ranges
        can be adjusted at runtime with MMU_FAN.

    config PARAM_FAN_POLLING_TIME
      float "Fan polling time              "
      default 5.0
      range 1.0 30.0
      help
        Time in seconds between temperature sensor polling intervals.

    config PARAM_FAN_CONTROL_ENABLED
      boolint "Enable fan temperature control"
      default y
      help
        Enable automatic fan control based on each fan's selected temperature
        source. Fans without a corresponding source remain off in AUTO mode but
        can still be controlled with MMU_FAN.

    choice PARAM_FAN_FORCED_MODE
      prompt "Default fan mode              "
      default PARAM_FAN_FORCED_MODE_AUTO
      help
        Select the fan state applied when Happy Hare starts. The mode can be
        changed later with MMU_FAN; a forced mode overrides automatic
        temperature control until the fans are returned to AUTO.

      config PARAM_FAN_FORCED_MODE_AUTO
        bool "AUTO"
        help
          Start each fan under automatic control using its selected temperature
          source and the configured ON/OFF thresholds.

      config PARAM_FAN_FORCED_MODE_OFF
        bool "All OFF"
        help
          Start all fans forced off, regardless of temperature, until their mode
          is changed with MMU_FAN.

      config PARAM_FAN_FORCED_MODE_ON
        bool "All ON"
        help
          Start all fans forced on at full speed, regardless of temperature,
          until their mode is changed with MMU_FAN.

    endchoice

    config PARAM_FAN_FORCED
      int
      default 0 if PARAM_FAN_FORCED_MODE_OFF
      default 1 if PARAM_FAN_FORCED_MODE_ON
      default 2 if PARAM_FAN_FORCED_MODE_AUTO

  endmenu
endif


# -------------------------------------
# Controller fan
# -------------------------------------

comment "_"
comment "_Controller Fan"
comment "$(misc_hardware_hint)" if CUSTOM_CONTROLLER_FAN_SETUP

config MMU_HAS_CONTROLLER_FAN
  bool "Enable controller fan?"
  depends on !CUSTOM_CONTROLLER_FAN_SETUP
  default n
  help
    Configure a Klipper [controller_fan] that cools this unit's electronics.
    It runs while any of this unit's gear or selector steppers is enabled
    and for the idle timeout after they are all disabled. It is not tied to
    the extruder heater. With per-gate configuration each gate can have its
    own fan, which follows that gate's gear stepper.

menu "Controller fan h/w config"
  visible if MMU_HAS_CONTROLLER_FAN && !CUSTOM_CONTROLLER_FAN_SETUP && !MMU_HAS_PER_GATE_CONFIG
  help
    Configure the controller fan output and operating speed.

  config PARAM_CONTROLLER_FAN_MAX_POWER
    float "Fan maximum power  "
    default 1.0
    range 0.1 1.0
    help
      Maximum power setting for the controller fan (0.1 to 1.0).
      1.0 = 100% power

  config PARAM_CONTROLLER_FAN_KICK_START_TIME
    float "Fan kick start time"
    default 0.5
    range 0 3.0
    help
      Time in seconds to run the controller fan at full power before
      resetting to target speed.

  config PARAM_CONTROLLER_FAN_SPEED
    float "Fan speed          "
    default 1.0
    range 0.0 1.0
    help
      Fan speed while any of this unit's steppers is enabled (0.0 to 1.0).

  config PARAM_CONTROLLER_FAN_IDLE_TIMEOUT
    int "Fan idle timeout   "
    default 30
    range 0 3600
    help
      Time in seconds the fan keeps running after this unit's steppers
      are all disabled.

  config PIN_CONTROLLER_FAN
    string "Controller fan pin "
    validator "$(pin_validator)"
    default ""
    help
      Pin for the fan cooling this MMU unit's electronics.
      Empty pins will be ignored in the generated configuration.

  config BOOL_HIDE_CONTROLLER_FAN
    bool "Hide in Mainsail / Fluidd"
    default y
    help
      Prefix the fan name with an underscore to hide it in the UI.
      Disable to show the fan. Automatic fan control is unchanged.

  config PARAM_CONTROLLER_FAN_NAME
    string
    default "_$(UNIT_NAME)_controller_fan" if BOOL_HIDE_CONTROLLER_FAN
    default "$(UNIT_NAME)_controller_fan"

endmenu

if MMU_HAS_CONTROLLER_FAN && !CUSTOM_CONTROLLER_FAN_SETUP && MMU_HAS_PER_GATE_CONFIG
  menu "Controller fan h/w config"
    help
      Configure the controller fan of each gate.

    @repeat var=i min=0 max=11@
      if PARAM_NUM_GATES > $(i)
        menuconfig PARAM_CONTROLLER_FAN_GATE_$(i)
          bool "Gate $(i) controller fan"
          default y
          help
            Create a [controller_fan] for this gate that runs while the
            gate's gear stepper is enabled.

        if PARAM_CONTROLLER_FAN_GATE_$(i)
          config PARAM_CONTROLLER_FAN_MAX_POWER_$(i)
            float "Fan maximum power  "
            default 1.0
            range 0.1 1.0
            help
              Maximum power setting for this gate's controller fan (0.1 to 1.0).

          config PARAM_CONTROLLER_FAN_KICK_START_TIME_$(i)
            float "Fan kick start time"
            default 0.5
            range 0 3.0
            help
              Time in seconds to run this gate's controller fan at full
              power before resetting to its target speed.

          config PARAM_CONTROLLER_FAN_SPEED_$(i)
            float "Fan speed          "
            default 1.0
            range 0.0 1.0
            help
              Fan speed while this gate's gear stepper is enabled (0.0 to 1.0).

          config PARAM_CONTROLLER_FAN_IDLE_TIMEOUT_$(i)
            int "Fan idle timeout   "
            default 30
            range 0 3600
            help
              Time in seconds the fan keeps running after this gate's
              gear stepper is disabled.

          config PIN_CONTROLLER_FAN_$(i)
            string "Controller fan pin "
            validator "$(pin_validator)"
            help
              Leave blank if this gate does not have a controller fan installed.

          config BOOL_HIDE_CONTROLLER_FAN_$(i)
            bool "Hide in Mainsail / Fluidd"
            default y
            help
              Prefix the fan name with an underscore to hide it in the UI.
              Disable to show the fan. Automatic fan control is unchanged.

          config PARAM_CONTROLLER_FAN_NAME_$(i)
            string
            default "_$(UNIT_NAME)_controller_fan$(i)" if BOOL_HIDE_CONTROLLER_FAN_$(i)
            default "$(UNIT_NAME)_controller_fan$(i)"
        endif
      endif
    @endrepeat@
  endmenu
endif
```

## installer/Kconfig.filament_buffer
```kconfig
# Responsible for setting:
#   MMU_HAS_FILAMENT_BUFFER
#
# Whether MMU has loose filament catchment buffer. No options
#
# Can be disabled and forced off with:
#   select UNSELECT_MMU_HAS_FILAMENT_BUFFER


config UNSELECT_MMU_HAS_FILAMENT_BUFFER
  def_bool n

comment "_"
comment "_Filament Catchment"

if !UNSELECT_MMU_HAS_FILAMENT_BUFFER
  config MMU_HAS_FILAMENT_BUFFER
    prompt "Has filament buffer to catch loose filament?"
    forceshow
    default n
    help
      Does the MMU have a buffer to catch the uncoiled filament on unload?
      Enabling this enables a higher bowden load/unload speed when
      Happy Hare knows the filament is in the buffer rather than on the spool.
      Note: A passive rewinder like Filamentalist is not a filament buffer
      because it rewinds filament onto the spool!
      Obviously this is not required if you have an espooler.
endif
```
