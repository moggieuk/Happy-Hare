## installer/macro_vars/Kconfig.form_tip
```kconfig
menu "Tip forming (_MMU_FORM_TIP)"
  help
    Happy Hare tip forming macro configuration variables.

  comment "Step 1 - Ramming"

  config VAR_FORM_TIP_RAMMING_VOLUME
    float "Ramming volume             "
    default 0
    help
      Ramming volume in mm^3.
      Set to 0 to disable (for example if slicer performs ramming).

  config VAR_FORM_TIP_RAMMING_VOLUME_STANDALONE
    float "Ramming volume (standalone)"
    default 0
    help
      Ramming volume in mm^3 when not printing.
      Set to 0 to disable.

  comment "Optional temperature change"

  config VAR_FORM_TIP_TOOLCHANGE_TEMP
    int "Toolchange temperature     "
    default 0
    help
      Temperature to set during tip forming.
      Set to 0 to disable temperature changes.

  config BOOL_FORM_TIP_TOOLCHANGE_FAN_ASSIST
    bool "Use fan assist for temperature changes"
    default n
    help
      Use part cooling fan to speed up temperature changes.

  config VAR_FORM_TIP_TOOLCHANGE_FAN_ASSIST
    string
    default "True" if BOOL_FORM_TIP_TOOLCHANGE_FAN_ASSIST
    default "False"

  config VAR_FORM_TIP_TOOLCHANGE_FAN_NAME
    string "Toolchange fan name"
    default ""
    help
      Fan name if not using the default [fan].
      Example: fan_generic fan0

  config VAR_FORM_TIP_TOOLCHANGE_FAN_SPEED
    int "Toolchange % fan speed     "
    default 50
    help
      Fan speed percentage when fan assist is enabled.

  comment "Step 2 - Nozzle Separation"

  config VAR_FORM_TIP_UNLOADING_SPEED_START
    float "Initial unload speed       "
    default 80
    help
      Initial fast separation speed in mm/s.

  config VAR_FORM_TIP_UNLOADING_SPEED
    float "Cooling zone unload speed  "
    default 18
    help
      Slower movement speed to the cooling zone in mm/s.

  comment "Step 3 - Cooling Moves"

  config VAR_FORM_TIP_COOLING_TUBE_POSITION
    float "Cooling tube position      "
    default 35
    help
      Distance from nozzle tip to start of cooling tube.

  config VAR_FORM_TIP_COOLING_TUBE_LENGTH
    float "Cooling tube length"
    default 10
    help
      Length of cooling tube movement.

  config VAR_FORM_TIP_INITIAL_COOLING_SPEED
    float "Initial cooling speed      "
    default 10
    help
      Initial cooling movement speed in mm/s.

  config VAR_FORM_TIP_FINAL_COOLING_SPEED
    float "Final cooling speed        "
    default 50
    help
      Final fast cooling movement speed in mm/s.

  config VAR_FORM_TIP_COOLING_MOVES
    int "Cooling moves              "
    default 4
    help
      Number of back-and-forth cooling moves.

  comment "Step 4 - Skinnydip"

  config BOOL_FORM_TIP_USE_SKINNYDIP
    bool "Enable skinnydip"
    default n
    help
      Enable the skinnydip move.

  config VAR_FORM_TIP_USE_SKINNYDIP
    string
    default "True" if BOOL_FORM_TIP_USE_SKINNYDIP
    default "False"

  config VAR_FORM_TIP_SKINNYDIP_DISTANCE
    float "Skinnydip distance         "
    default 30
    help
      Reinsertion distance into hotend after cooling.

  config VAR_FORM_TIP_DIP_INSERTION_SPEED
    float "Dip insertion speed        "
    default 30
    help
      Insertion speed in mm/s.

  config VAR_FORM_TIP_DIP_EXTRACTION_SPEED
    float "Dip extraction speed       "
    default 70
    help
      Extraction speed in mm/s.

  config VAR_FORM_TIP_MELT_ZONE_PAUSE
    int "Melt zone pause (ms)       "
    default 0
    help
      Pause time in melt zone.

  config VAR_FORM_TIP_COOLING_ZONE_PAUSE
    int "Cooling zone pause (ms)    "
    default 0
    help
      Pause time after extraction in cooling zone.

  config BOOL_FORM_TIP_USE_FAST_SKINNYDIP
    bool "Use fast skinnydip"
    default n
    help
      Skip toolhead temperature change wait during skinnydip.

  config VAR_FORM_TIP_USE_FAST_SKINNYDIP
    string
    default "True" if BOOL_FORM_TIP_USE_FAST_SKINNYDIP
    default "False"

  comment "Step 5 - Parking"

  config VAR_FORM_TIP_PARKING_DISTANCE
    float "Parking distance           "
    default 0
    help
      Position to park filament after tip forming.
      Set to 0 to leave filament where it ends up.

  config VAR_FORM_TIP_EXTRUDER_EJECT_SPEED
    float "Extruder eject speed       "
    default 25
    help
      Speed used for parking distance and final eject testing.

endmenu
```

## installer/macro_vars/Kconfig.purge
```kconfig
menu "Purge (_MMU_PURGE)"
  help
    Happy Hare reference purging macro configuration variables.

    Optional simple reference (bucket) purge configuration.

  config VAR_PURGE_EXTRUDER_PURGE_SPEED
    float "Extruder purge speed"
    default 2
    help
      Speed in mm/s for purging.

      Set as fast as possible without the extruder skipping steps.
      Extruder current can also be increased in mmu_parameters.cfg.

endmenu
```

## installer/macro_vars/Kconfig.sequence
```kconfig
menu "Sequence macros (_MMU_SEQUENCE)"
  help
    Happy Hare sequence macro configuration variables.

    Controls parking movement, toolchange behavior, retraction,
    restore position logic, and sequence macro extension hooks.

  comment "_Toolhead movement"

  config VAR_SEQUENCE_ENABLE_PARK_PRINTING
    string "Park operations while printing   "
    default "'toolchange,runout,load,unload,complete,pause,cancel'"
    help
      List of operations that should result in toolhead parking while in a print.
      Empty string disables parking.

  config VAR_SEQUENCE_ENABLE_PARK_STANDALONE
    string "Park operations when standalone  "
    default "'toolchange,load,unload,pause,cancel'"
    help
      List of operations that should result in toolhead parking when not printing.
      Empty string disables parking.

  config VAR_SEQUENCE_ENABLE_PARK_DISABLED
    string "Park operations when MMU disabled"
    default "'pause,cancel'"
    help
      List of operations that should result in toolhead parking when MMU is disabled.
      Only pause and cancel can occur in this mode.
      Empty string disables parking.

  config VAR_SEQUENCE_MIN_TOOLCHANGE_Z
    float "Minimum toolchange Z    "
    default 1.0
    help
      Absolute minimum safety floor Z-height for all parking moves.

  config VAR_SEQUENCE_PARK_TOOLCHANGE
    string "Toolchange park position"
    default "-999, -999, 1,  5, 2"
    help
      Parking movement and location for toolchange, load and unload operations.
      x, y, z-hop, z_hop_ramp, retract

      Use -999,-999 for no XY move. Use 0 for no Z-hop.

  config VAR_SEQUENCE_PARK_RUNOUT
    string "Runout park position    "
    default "-999, -999, 1,  5, 2"
    help
      Parking movement and location for runout operation.
      x, y, z-hop, z_hop_ramp, retract

      Use -999,-999 for no XY move. Use 0 for no Z-hop.

  config VAR_SEQUENCE_PARK_COMPLETE
    string "Complete park position  "
    default "50,   50,   10, 0, 5"
    help
      Parking movement and location for print complete operation.
      x, y, z-hop, z_hop_ramp, retract

      Use -999,-999 for no XY move. Use 0 for no Z-hop.

  config VAR_SEQUENCE_PARK_PAUSE
    string "Pause park position     "
    default "50,   50,   5,  0, 2"
    help
      Parking movement and location for pause operation.
      This is also the park position when an MMU error occurs.
      x, y, z-hop, z_hop_ramp, retract

      Use -999,-999 for no XY move. Use 0 for no Z-hop.

  config VAR_SEQUENCE_PARK_CANCEL
    string "Cancel park position    "
    default "-999, -999, 10, 0, 5"
    help
      Parking movement and location for print cancel operation.
      x, y, z-hop, z_hop_ramp, retract

      Use -999,-999 for no XY move. Use 0 for no Z-hop.

  comment "Fine tune"

  config VAR_SEQUENCE_PRE_UNLOAD_POSITION
    string "Pre-unload position     "
    default "-999, -999, 0"
    help
      Advanced. Fine tune toolhead position before unloading sequence starts.
      x, y, z-hop

      Use -999,-999 for no XY move. Use 0 for no Z-hop.

  config VAR_SEQUENCE_POST_FORM_TIP_POSITION
    string "Post-form-tip position  "
    default "-999, -999, 0"
    help
      Advanced. Fine tune toolhead position after form/cut tip is performed on unload
      x, y, z-hop

      Use -999,-999 for no XY move. Use 0 for no Z-hop.

  config VAR_SEQUENCE_PRE_LOAD_POSITION
    string "Pre-load position       "
    default "-999, -999, 0"
    help
      Advanced. Fine tune toolhead position before loading sequence starts.
      x, y, z-hop

      Use -999,-999 for no XY move. Use 0 for no Z-hop.

  choice CHOICE_SEQUENCE_RESTORE_XY_POS
    prompt "Restore XY position after toolchange"
    default CHOICE_SEQUENCE_RESTORE_XY_POS_LAST
    help
      Controls where the toolhead (x,y) is returned to after an operation that
      invokes a parking move:
        last - return to original position before park (frequently the default)
        next - return to next print position if possible else last logic will be applied.
               In print this reduces dwell time at the last position reducing blobbing
               and unnecessary movement. Only applied to "toolchange" operation
        none - the toolhead is left wherever it ends up after change. In a print the
               next gcode command will restore toolhead x,y position

    config CHOICE_SEQUENCE_RESTORE_XY_POS_LAST
      bool "last"
      help
        Return to original position before park (frequently the default)

    config CHOICE_SEQUENCE_RESTORE_XY_POS_NEXT
      bool "next"
      help
        Return to next print position if possible, otherwise use last logic.
        Only applied to toolchange operations.

    config CHOICE_SEQUENCE_RESTORE_XY_POS_NONE
      bool "none"
      help
        Leave the toolhead wherever it ends up after change.

  endchoice

  config VAR_SEQUENCE_RESTORE_XY_POS
    string
    default "'next" if CHOICE_SEQUENCE_RESTORE_XY_POS_NEXT
    default "'none'" if CHOICE_SEQUENCE_RESTORE_XY_POS_NONE
    default "'last'"

  comment "_"
  comment "_Movement speeds"

  config VAR_SEQUENCE_PARK_TRAVEL_SPEED
    float "Park travel speed       "
    default 200
    help
      Speed for any XY/Z travel movement in mm/s.

  config VAR_SEQUENCE_PARK_LIFT_SPEED
    float "Park lift speed         "
    default 15
    help
      Z-only travel speed in mm/s.

  config VAR_SEQUENCE_RETRACT_SPEED
    float "Retract speed           "
    default 30
    help
      Speed of the retract move in mm/s.

  config VAR_SEQUENCE_UNRETRACT_SPEED
    float "Unretract speed         "
    default 30
    help
      Speed of the unretract move in mm/s.

  comment "_"
  comment "_User macro hooks"

  config VAR_SEQUENCE_USER_MMU_ERROR_EXTENSION
    string "MMU error extension macro    "
    default ""
    help
      Executed after default logic when MMU error condition occurs.

  config VAR_SEQUENCE_USER_PRE_UNLOAD_EXTENSION
    string "Pre-unload extension macro   "
    default ""
    help
      Executed after default logic.

  config VAR_SEQUENCE_USER_POST_FORM_TIP_EXTENSION
    string "Post-form-tip extension macro"
    default ""
    help
      Executed after default logic.

  config VAR_SEQUENCE_USER_POST_UNLOAD_EXTENSION
    string "Post-unload extension macro  "
    default ""
    help
      Executed after default logic.

  config VAR_SEQUENCE_USER_PRE_LOAD_EXTENSION
    string "Pre-load extension macro     "
    default ""
    help
      Executed after default logic.

  config VAR_SEQUENCE_USER_POST_LOAD_EXTENSION
    string "Post-load extension macro    "
    default ""
    help
      Executed after default logic but before restoring toolhead position.

  comment "_"
  comment "_Misc"

  config BOOL_SEQUENCE_AUTO_HOME
    bool "Automatically home if necessary"
    default y
    help
      Automatically home if necessary.

  config VAR_SEQUENCE_AUTO_HOME
    string
    default "True" if BOOL_SEQUENCE_AUTO_HOME
    default "False"

  config BOOL_SEQUENCE_TIMELAPSE
    bool "Take timelapse frame after load"
    default n
    help
      Take frame snapshot after load.

  config VAR_SEQUENCE_TIMELAPSE
    string
    default "True" if BOOL_SEQUENCE_TIMELAPSE
    default "False"

  config VAR_SEQUENCE_USER_PARK_MOVE_MACRO
    string "User park move macro         "
    default ""
    help
      Advanced. User supplied macro that is executed instead of the default G1 XY
      move to park position.  Macro is called with X, Y, and F parameters. When
      restoring, it is also passed RESTORE=1.

      This is useful when you want to control the movement path of the toolhead
      to avoid an area rather than accept the direct line

endmenu
```

## installer/macro_vars/Kconfig.servo_cutter
```kconfig
menu "Servo cutter at MMU (_MMU_SERVO_CUTTER)"
  help
    Happy Hare servo filament cutting macro configuration variables.

    This currently supports EREC and similar cutters that operate
    at the MMU end of the bowden.

  comment "_"
  comment "_Servo movement"

  config VAR_SERVO_CUTTER_SERVO_CLOSED_ANGLE
    float "Servo closed angle        "
    default 70
    help
      Servo angle for the closed position with the bowden
      aligned to the MMU.

  config VAR_SERVO_CUTTER_SERVO_OPEN_ANGLE
    float "Servo open angle          "
    default 10
    help
      Servo angle for the open position that moves the
      bowden away from the MMU.

  config VAR_SERVO_CUTTER_SERVO_DURATION
    float "Servo pulse duration (s)  "
    default 1.5
    help
      Duration in seconds of the PWM pulse train used
      to activate the servo.

  config VAR_SERVO_CUTTER_SERVO_IDLE_TIME
    float "Servo settle time (s)     "
    default 1.8
    help
      Time in seconds to allow the servo to reach its
      target position before continuing.

  comment "_"
  comment "_Feed and cut behavior"

  config VAR_SERVO_CUTTER_FEED_LENGTH
    float "Feed length (mm)          "
    default 48
    help
      Distance in millimeters from the gate parking position to the cutter blade.
      This is important because the filament is first parked and then pushed back
      this distance before the cutter blade is applied.  EREC cutter examples:
      - ERCF v1.1: 58
      - ERCF v2  : 48

  config VAR_SERVO_CUTTER_CUT_LENGTH
    float "Cut length (mm)           "
    default 10
    help
      Amount of filament in millimeters to cut.

  config VAR_SERVO_CUTTER_CUT_ATTEMPTS
    int "Cut attempts               "
    default 1
    help
      Number of times the cutter will attempt to cut
      the filament before reporting failure.

endmenu
```
