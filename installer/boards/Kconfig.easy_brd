## installer/boards/Kconfig.skr_pico_1
```kconfig
config BOARD_TYPE_SKR_PICO_1
  bool "BTT SKR Pico v1.0"

if BOARD_TYPE_SKR_PICO_1
  config PARAM_BOARD_TYPE
    default "BTT SKR Pico v1"

  choice CHOICE_MMU_CONNECTION_TYPE
    default CHOICE_MMU_CONNECTION_TYPE_SERIAL
  endchoice
  choice CHOICE_MMU_SERIAL_CONNECTION
    default $(mmu_serial_config,1,rp2040)
  endchoice

  # MMU Type B
  config PIN_GEAR_UART 
    default "$(MCU_NAME):gpio9" 
  config PIN_GEAR_STEP
    default "$(MCU_NAME):gpio11" 
  config PIN_GEAR_DIR
    default "$(MCU_NAME):gpio10" 
  config PIN_GEAR_ENABLE
    default "!$(MCU_NAME):gpio12" 
  config PIN_GEAR_DIAG
    default "$(MCU_NAME):gpio4" 

  if VIRTUAL_SELECTOR
    config PIN_GEAR_STEP_1
      default "$(MCU_NAME):gpio6" 
    config PIN_GEAR_DIR_1
      default "$(MCU_NAME):gpio5" 
    config PIN_GEAR_ENABLE_1
      default "!$(MCU_NAME):gpio7" 
    config PIN_GEAR_DIAG_1
      default "$(MCU_NAME):gpop3" 

    config PIN_GEAR_STEP_2
      default "$(MCU_NAME):gpio19" 
    config PIN_GEAR_DIR_2
      default "$(MCU_NAME):gpio28" 
    config PIN_GEAR_ENABLE_2
      default "!$(MCU_NAME):gpio2" 
    config PIN_GEAR_DIAG_2
      default "$(MCU_NAME):gpio25"

    config PIN_GEAR_STEP_3
      default "$(MCU_NAME):gpio14" 
    config PIN_GEAR_DIR_3
      default "$(MCU_NAME):gpio13" 
    config PIN_GEAR_ENABLE_3
      default "!$(MCU_NAME):gpio15" 
    config PIN_GEAR_DIAG_3
      default "$(MCU_NAME):gpio16" 
  endif

  if !VIRTUAL_SELECTOR
    config PIN_SELECTOR_STEP
      default "$(MCU_NAME):gpio19" 
    config PIN_SELECTOR_DIR
      default "$(MCU_NAME):gpio28" 
    config PIN_SELECTOR_ENABLE
      default "!$(MCU_NAME):gpio2" 
    config PIN_SELECTOR_DIAG
      default "$(MCU_NAME):gpio25" 
    config PIN_SELECTOR_SERVO
      default "$(MCU_NAME):gpio29" 
  endif

  config PIN_NEOPIXEL
    default "$(MCU_NAME):gpio24" 
endif
```

## installer/boards/Kconfig.wgb_3
```kconfig
config BOARD_TYPE_WGB_1_0
  bool "WGB v3.0"

if BOARD_TYPE_WGB_1_0
  config PARAM_BOARD_TYPE
    default "WGB_3"

  choice CHOICE_SERIAL_DEVICE
    default $(serial_config,1,stm32)
  endchoice

  config PIN_GEAR_UART 
    default "$(MMU_MCU):PC12" 
  config PIN_GEAR_STEP
    default "$(MMU_MCU):PD4" 
  config PIN_GEAR_DIR
    default "$(MMU_MCU):PD3" 
  config PIN_GEAR_ENABLE
    default "!$(MMU_MCU):PD5" 
  config PIN_GEAR_DIAG
    default "$(MMU_MCU):PD6" 

  config PIN_GEAR_UART_1 
    default "$(MMU_MCU):PC10" 
  config PIN_GEAR_STEP_1
    default "$(MMU_MCU):PD0" 
  config PIN_GEAR_DIR_1
    default "$(MMU_MCU):PC11" 
  config PIN_GEAR_ENABLE_1
    default "!$(MMU_MCU):PD1" 
  config PIN_GEAR_DIAG_1
    default "$(MMU_MCU):PD2" 

  config PIN_GEAR_UART_2 
    default "$(MMU_MCU):PA9" 
  config PIN_GEAR_STEP_2
    default "$(MMU_MCU):PC8" 
  config PIN_GEAR_DIR_2
    default "$(MMU_MCU):PA10" 
  config PIN_GEAR_ENABLE_2
    default "!$(MMU_MCU):PC9" 
  config PIN_GEAR_DIAG_2
    default "$(MMU_MCU):PA8" 

  config PIN_GEAR_UART_3 
    default "$(MMU_MCU):PC6" 
  config PIN_GEAR_STEP_3
    default "$(MMU_MCU):PD13" 
  config PIN_GEAR_DIR_3
    default "$(MMU_MCU):PD12" 
  config PIN_GEAR_ENABLE_3
    default "!$(MMU_MCU):PD14" 
  config PIN_GEAR_DIAG_3
    default "$(MMU_MCU):PD15" 

  config PIN_PRE_GATE_0
    default "^$(MMU_MCU):PA1" 
  config PIN_PRE_GATE_1
    default "^$(MMU_MCU):PA2" 
  config PIN_PRE_GATE_2
    default "^$(MMU_MCU):PA3" 
  config PIN_PRE_GATE_3
    default "^$(MMU_MCU):PA4" 

  config PIN_GEAR_SENSOR_0
    default "^$(MMU_MCU):PA5" 
  config PIN_GEAR_SENSOR_1
    default "^$(MMU_MCU):PA6" 
  config PIN_GEAR_SENSOR_2
    default "^$(MMU_MCU):PA7" 
  config PIN_GEAR_SENSOR_3
    default "^$(MMU_MCU):PC4" 

  config PIN_ESPOOLER_EN_0
    default "$(MMU_MCU):PD11" 
  config PIN_ESPOOLER_RWD_0
    default "$(MMU_MCU):PE15" 
  config PIN_ESPOOLER_FWD_0
    default "$(MMU_MCU):PB10" 

  config PIN_ESPOOLER_EN_1
    default "$(MMU_MCU):PD10" 
  config PIN_ESPOOLER_RWD_1
    default "$(MMU_MCU):PE13" 
  config PIN_ESPOOLER_FWD_1
    default "$(MMU_MCU):PE14" 

  config PIN_ESPOOLER_EN_2
    default "$(MMU_MCU):PD9" 
  config PIN_ESPOOLER_RWD_2
    default "$(MMU_MCU):PE12" 
  config PIN_ESPOOLER_FWD_2
    default "$(MMU_MCU):PE11" 

  config PIN_ESPOOLER_EN_3
    default "$(MMU_MCU):PD8" 
  config PIN_ESPOOLER_RWD_3
    default "$(MMU_MCU):PE8" 
  config PIN_ESPOOLER_FWD_3
    default "$(MMU_MCU):PE10" 

  config PIN_NEOPIXEL
    default "$(MMU_MCU):PB15"
  config PIN_GATE_SENSOR
    default "^$(MMU_MCU):PE7"
endif
```

## installer/boards/Kconfig.wgb_3_0
```kconfig
config BOARD_TYPE_WGB_3_0
  bool "WGB v3.0 / designed for Box Turtle"

if BOARD_TYPE_WGB_3_0
  config PARAM_BOARD_TYPE
    default "WGB30"

  choice CHOICE_MMU_CONNECTION_TYPE
    default CHOICE_MMU_CONNECTION_TYPE_SERIAL
  endchoice
  choice CHOICE_MMU_SERIAL_CONNECTION
    default $(mmu_serial_config,1,stm32)
  endchoice

  config PIN_GEAR_UART 
    default "$(MCU_NAME):PC12" 
  config PIN_GEAR_STEP
    default "$(MCU_NAME):PD4" 
  config PIN_GEAR_DIR
    default "$(MCU_NAME):PD3" 
  config PIN_GEAR_ENABLE
    default "!$(MCU_NAME):PD5" 
  config PIN_GEAR_DIAG
    default "$(MCU_NAME):PD6" 

  config PIN_GEAR_UART_1 
    default "$(MCU_NAME):PC10" 
  config PIN_GEAR_STEP_1
    default "$(MCU_NAME):PD0" 
  config PIN_GEAR_DIR_1
    default "$(MCU_NAME):PC11" 
  config PIN_GEAR_ENABLE_1
    default "!$(MCU_NAME):PD1" 
  config PIN_GEAR_DIAG_1
    default "$(MCU_NAME):PD2" 

  config PIN_GEAR_UART_2 
    default "$(MCU_NAME):PA9" 
  config PIN_GEAR_STEP_2
    default "$(MCU_NAME):PC8" 
  config PIN_GEAR_DIR_2
    default "$(MCU_NAME):PA10" 
  config PIN_GEAR_ENABLE_2
    default "!$(MCU_NAME):PC9" 
  config PIN_GEAR_DIAG_2
    default "$(MCU_NAME):PA8" 

  config PIN_GEAR_UART_3 
    default "$(MCU_NAME):PC6" 
  config PIN_GEAR_STEP_3
    default "$(MCU_NAME):PD13" 
  config PIN_GEAR_DIR_3
    default "$(MCU_NAME):PD12" 
  config PIN_GEAR_ENABLE_3
    default "!$(MCU_NAME):PD14" 
  config PIN_GEAR_DIAG_3
    default "$(MCU_NAME):PD15" 

  config PIN_PRE_GATE_0
    default "^$(MCU_NAME):PA1" 
  config PIN_PRE_GATE_1
    default "^$(MCU_NAME):PA2" 
  config PIN_PRE_GATE_2
    default "^$(MCU_NAME):PA3" 
  config PIN_PRE_GATE_3
    default "^$(MCU_NAME):PA4" 

  config PIN_GEAR_SENSOR_0
    default "^$(MCU_NAME):PA5" 
  config PIN_GEAR_SENSOR_1
    default "^$(MCU_NAME):PA6" 
  config PIN_GEAR_SENSOR_2
    default "^$(MCU_NAME):PA7" 
  config PIN_GEAR_SENSOR_3
    default "^$(MCU_NAME):PC4" 

  config PIN_ESPOOLER_EN_0
    default "$(MCU_NAME):PD11" 
  config PIN_ESPOOLER_RWD_0
    default "$(MCU_NAME):PE15" 
  config PIN_ESPOOLER_FWD_0
    default "$(MCU_NAME):PB10" 

  config PIN_ESPOOLER_EN_1
    default "$(MCU_NAME):PD10" 
  config PIN_ESPOOLER_RWD_1
    default "$(MCU_NAME):PE13" 
  config PIN_ESPOOLER_FWD_1
    default "$(MCU_NAME):PE14" 

  config PIN_ESPOOLER_EN_2
    default "$(MCU_NAME):PD9" 
  config PIN_ESPOOLER_RWD_2
    default "$(MCU_NAME):PE12" 
  config PIN_ESPOOLER_FWD_2
    default "$(MCU_NAME):PE11" 

  config PIN_ESPOOLER_EN_3
    default "$(MCU_NAME):PD8" 
  config PIN_ESPOOLER_RWD_3
    default "$(MCU_NAME):PE8" 
  config PIN_ESPOOLER_FWD_3
    default "$(MCU_NAME):PE10" 

  config PIN_NEOPIXEL
    default "$(MCU_NAME):PB15"
  config PIN_GATE_SENSOR
    default "^$(MCU_NAME):PE7"
endif
```

## installer/boards/custom/Kconfig.kms
```kconfig
config BOARD_TYPE_KMS_1_0
  bool "BIQU KMS MCU"

if BOARD_TYPE_KMS_1_0
  config PARAM_BOARD_TYPE
    default "KMS10"

  choice MMU_CONNECTION_TYPE
    default CHOICE_MMU_CONNECTION_TYPE_SERIAL
  endchoice
  choice MMU_SERIAL_DEVICE
    default $(mmu_serial_config,1,stm32)
  endchoice
  choice BUFFER_CONNECTION_TYPE
    default CHOICE_BUFFER_CONNECTION_TYPE_SERIAL
  endchoice
  choice BUFFER_SERIAL_DEVICE
    default $(buffer_serial_config,1,stm32)
  endchoice

  config PIN_GEAR_UART 
    default "$(MCU_NAME):PB4"
  config PIN_GEAR_STEP
    default "$(MCU_NAME):PB5" 
  config PIN_GEAR_DIR
    default "$(MCU_NAME):PB6" 
  config PIN_GEAR_ENABLE
    default "!$(MCU_NAME):PB3" 

  config PIN_GEAR_UART_1 
    default "$(MCU_NAME):PB8" 
  config PIN_GEAR_STEP_1
    default "$(MCU_NAME):PB9" 
  config PIN_GEAR_DIR_1
    default "!$(MCU_NAME):PC10" 
  config PIN_GEAR_ENABLE_1
    default "!$(MCU_NAME):PB7" 

  config PIN_GEAR_UART_2 
    default "$(MCU_NAME):PD3" 
  config PIN_GEAR_STEP_2
    default "$(MCU_NAME):PD4" 
  config PIN_GEAR_DIR_2
    default "$(MCU_NAME):PD5" 
  config PIN_GEAR_ENABLE_2
    default "!$(MCU_NAME):PD6" 

  config PIN_GEAR_UART_3 
    default "$(MCU_NAME):PC9" 
  config PIN_GEAR_STEP_3
    default "$(MCU_NAME):PD0" 
  config PIN_GEAR_DIR_3
    default "!$(MCU_NAME):PD1" 
  config PIN_GEAR_ENABLE_3
    default "!$(MCU_NAME):PD2" 

  config PIN_PRE_GATE_0
    default "$(MCU_NAME):PA0" 
  config PIN_PRE_GATE_1
    default "$(MCU_NAME):PA1" 
  config PIN_PRE_GATE_2
    default "$(MCU_NAME):PA2" 
  config PIN_PRE_GATE_3
    default "$(MCU_NAME):PA3" 

  config PIN_GEAR_SENSOR_0
    default "$(MCU_NAME):PA5"
  config PIN_GEAR_SENSOR_1
    default "$(MCU_NAME):PA6"
  config PIN_GEAR_SENSOR_2
    default "$(MCU_NAME):PA7"
  config PIN_GEAR_SENSOR_3
    default "$(MCU_NAME):PC4"
  
  config PIN_ESPOOLER_FWD_0
    default "$(MCU_NAME):PA8"
  config PIN_ESPOOLER_RWD_0
    default "$(MCU_NAME):PB15"
  config PIN_ESPOOLER_FWD_1
    default "$(MCU_NAME):PB13"
  config PIN_ESPOOLER_RWD_1
    default "$(MCU_NAME):PB14"
  config PIN_ESPOOLER_FWD_2
    default "$(MCU_NAME):PA9"
  config PIN_ESPOOLER_RWD_2
    default "$(MCU_NAME):PC6"
  config PIN_ESPOOLER_FWD_3
    default "$(MCU_NAME):PD8"
  config PIN_ESPOOLER_RWD_3
    default "$(MCU_NAME):PC7"

  config PIN_ENCODER
    default "$(MCU_NAME):PC5"
  config PIN_NEOPIXEL
    default "$(MCU_NAME):PC13" 
  config PIN_GATE_SENSOR
    default "$(MCU_NAME):PC0"

  if OPTION_KMS_BUFFER
    config PIN_SYNC_FEEDBACK_TENSION
      default "!$(MCU_NAME)_buffer:PA1"
    config PIN_SYNC_FEEDBACK_COMPRESSION
      default "!$(MCU_NAME)_buffer:PA0"
  endif

  config PARAM_MISC_HARDWARE
    default "$(ml,\
[temperature_sensor $(UNIT_NAME)_enviroment]\n\
sensor_type: HTU21D\n\
i2c_mcu: $(MCU_NAME)\n\
htu21d_report_time: 10\n\
i2c_software_scl_pin: $(MCU_NAME):PB10\n\
i2c_software_sda_pin: $(MCU_NAME):PB11\n\
\n\
[heater_fan $(UNIT_NAME)_fan_left]\n\
pin: $(MCU_NAME):PC3\n\
shutdown_speed: 0\n\
heater: MMU_heater_kms\n\
\n\
[heater_fan $(UNIT_NAME)_fan_right]\n\
pin: $(MCU_NAME):PC1\n\
shutdown_speed: 0\n\
heater: $(UNIT_NAME)_heater\n\
\n\
[heater_generic $(UNIT_NAME)_heater]\n\
gcode_id: $(UNIT_NAME)\n\
heater_pin: $(MCU_NAME):PB1\n\
max_power:1.0\n\
sensor_type: EPCOS 100K B57560G104F\n\
pullup_resistor: 1800\n\
sensor_pin: $(MCU_NAME):PA4\n\
control: watermark\n\
min_temp: 0\n\
max_temp: 70\n\
\n\
[verify_heater MMU_heater_kms]\n\
max_error: 300\n\
check_gain_time: 600\n\
hysteresis: 10\n\
heating_gain: 1\n\
)"

endif
```
