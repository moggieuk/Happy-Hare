## installer/macro_vars/Kconfig.blobifier
```kconfig
menu "Blobifier (_BLOBIFIER)"
  help
    Blobifier purging system configuration variables.

  config VAR_BLOBIFIER_PURGE_SPD
    float "Purge speed                    "
    default 400
    help
      Speed in mm/min of the purge.

  config VAR_BLOBIFIER_PURGE_TEMP_MIN
    int "Minimum purge temperature      "
    default 200
    help
      Minimum nozzle purge temperature.

  config VAR_BLOBIFIER_TOOLHEAD_X
    float "Toolhead X offset              "
    default 70
    help
      Distance from nozzle to the left of your toolhead.

  config VAR_BLOBIFIER_TOOLHEAD_Y
    float "Toolhead Y offset              "
    default 50
    help
      Distance from nozzle to the front of your toolhead.

  config VAR_BLOBIFIER_FORCE_SAFE_DESCEND_HEIGHT_UNTIL
    float "Force safe descend height until"
    default 1.0

  config VAR_BLOBIFIER_BRUSH_TOP
    float "Brush top                      "
    default 6
    help
      Z height of brush top. Set to None for gantry mounted brush without Z move.

  config VAR_BLOBIFIER_CLEARANCE_Z
    float "Clearance Z                    "
    default 2

  config VAR_BLOBIFIER_WIPE_QTY
    int "Wipe quantity                  "
    default 2

  config VAR_BLOBIFIER_TRAVEL_SPD_XY
    float "Travel speed XY                "
    default 10000

  config VAR_BLOBIFIER_TRAVEL_SPD_Z
    float "Travel speed Z                 "
    default 1000

  config VAR_BLOBIFIER_WIPE_SPD_XY
    float "Wipe speed XY                  "
    default 10000

  config VAR_BLOBIFIER_BRUSH_ACCEL
    float "Brush acceleration             "
    default 0

  config VAR_BLOBIFIER_SKEW_CORRECTION
    float "Skew correction                "
    default 0.1

  config VAR_BLOBIFIER_Y_OFFSET
    float "Y offset                       "
    default 0

  config VAR_BLOBIFIER_BRUSH_START
    float "Brush start                    "
    default 67
    help
      Start location of the brush. Recommend:
        34 For 250mm build
        67 For 300mm build
        84 for 350mm build

  config VAR_BLOBIFIER_BRUSH_WIDTH
    float "Brush width                    "
    default 35
    help
      +               ←   brush_width   →
                       _________________
                      |                 |  ↑                Y position is acquired from your
      brush_start (x) |                 | brush_depth       stepper_y position_max. Adjust
                      |_________________|  ↓                your brush physically in Y so
                              (y)                           that the nozzle scrubs within the
                          brush_front                       brush.
      _____PRINTER _________________________FRONT____

  config VAR_BLOBIFIER_BRUSH_Y_OFFSET
    float "Brush Y offset                 "
    default 0

  config VAR_BLOBIFIER_PURGE_X
    float "Purge X                        "
    default 10

  config VAR_BLOBIFIER_TRAY_TOP
    float "Tray top                       "
    default 0.7

  config VAR_BLOBIFIER_TRAY_ANGLE_OUT
    int "Tray angle out                 "
    default 0

  config VAR_BLOBIFIER_TRAY_ANGLE_IN
    int "Tray angle in                  "
    default 180

  comment "_"
  comment "_Blob Tuning"

  config VAR_BLOBIFIER_DWELL_TIME
    int "Dwell time                     "
    default 200

  config VAR_BLOBIFIER_PURGE_START
    float "Purge start height             "
    default 0.2

  config VAR_BLOBIFIER_Z_RAISE
    float "Z raise                        "
    default 12

  config VAR_BLOBIFIER_Z_RAISE_EXP
    float "Z raise exponent               "
    default 0.85

  config VAR_BLOBIFIER_EJECT_HOP
    float "Eject hop                      "
    default 6.0

  config VAR_BLOBIFIER_PRESSURE_RELEASE_TIME
    int "Pressure release time          "
    default 1000

  config VAR_BLOBIFIER_RETRACT_BETWEEN_BLOBS
    float "Retract between blobs          "
    default 6

  config VAR_BLOBIFIER_PART_COOLING_FAN
    float "Part cooling fan speed         "
    default 0.3
    help
      Fan speed to use during purging
      (-1 is unchanged, 0 is off, 0.1-1.0 for fan speed)

  config VAR_BLOBIFIER_PART_COOLING_FAN_BLOB_DEPOSIT
    float "Fan speed during blob deposit  "
    default 1
    help
      Fan speed to use during blob depositing
      (-1 is unchanged, 0 is off, 0.1-1.0 for fan speed)

  config VAR_BLOBIFIER_FAN_NAME
    string "Fan name                       "
    default ""
    help
      Optional part fan name if using a fan other than [fan].

  comment "_"
  comment "_Purge Length Tuning"

  config VAR_BLOBIFIER_PURGE_LENGTH_MINIMUM
    float "Minimum purge length           "
    default 30

  config VAR_BLOBIFIER_PURGE_LENGTH_MAXIMUM
    float "Maximum purge length           "
    default 150

  config VAR_BLOBIFIER_PURGE_LENGTH
    float "Default purge length           "
    default 150

  config VAR_BLOBIFIER_PURGE_LENGTH_MODIFIER
    float "Purge length modifier          "
    default 1.0

  config VAR_BLOBIFIER_PURGE_LENGTH_ADDITION
    float "Purge length addition          "
    default 0

  comment "_"
  comment "_Bucket"

  config VAR_BLOBIFIER_MAX_BLOBS
    int "Maximum blobs                  "
    default 400

  config BOOL_BLOBIFIER_ENABLE_SHAKER
    bool "Enable bucket shaker"
    default y

  config VAR_BLOBIFIER_ENABLE_SHAKER
    int
    default 1 if BOOL_BLOBIFIER_ENABLE_SHAKER
    default 0

  config VAR_BLOBIFIER_SHAKER_POS_X
    float "Shaker X position offset       "
    default 0

  config VAR_BLOBIFIER_BUCKET_SHAKES
    int "Bucket shakes                  "
    default 10

  config VAR_BLOBIFIER_SHAKE_ACCEL
    float "Shake acceleration             "
    default 10000

  config VAR_BLOBIFIER_BUCKET_SHAKE_FREQUENCY
    float "Bucket shake frequency         "
    default 0.95

  config VAR_BLOBIFIER_SHAKER_ARM_Z
    float "Shaker arm Z                   "
    default 2
  comment "_"
  comment "_Stepper tray (only used when Blobifier tray actuator is Stepper)"

  config VAR_BLOBIFIER_TRAY_POS_OUT
    float "Stepper tray extended pos (mm)  "
    default 21

  config VAR_BLOBIFIER_TRAY_POS_IN
    float "Stepper tray retracted pos (mm) "
    default 0

  config VAR_BLOBIFIER_TRAY_STEPPER_SPEED
    float "Stepper tray speed (mm/s)       "
    default 110

  comment "_"
  comment "_Retraction tuning"

  config VAR_BLOBIFIER_INCLUDE_EXTRUDER_RESIDUAL
    int "Include extruder residual (0/1) "
    default 0
    help
      Whether to add extruder_filament_remaining to the purge length. Set to 0 if your
      slicer purge matrix already accounts for nozzle residual to avoid over-purging.

  config VAR_BLOBIFIER_PURGE_PULSE_SIZE
    float "Purge pulse size (mm)           "
    default 10

  config VAR_BLOBIFIER_RETRACT_STEP
    float "Retract step size (mm)          "
    default 2

  config VAR_BLOBIFIER_PULSE_RETRACT_LENGTH
    float "Pulse retract length (mm)       "
    default 4

  config VAR_BLOBIFIER_PULSE_RETRACT_SPEED
    int "Pulse retract speed (mm/min)    "
    default 2400

  config VAR_BLOBIFIER_PULSE_DERETRACT_SPEED
    int "Pulse de-retract speed (mm/min) "
    default 800

  config VAR_BLOBIFIER_PURGE_RETRACT_INTERVAL
    float "Purge retract interval (mm)     "
    default 20

endmenu
```

## installer/macro_vars/Kconfig.cut_tip
```kconfig
menu "Toolhead tip cutting (_MMU_CUT_TIP)"
  help
    Happy Hare toolhead tip cutting macro configuration variables.

  config BOOL_CUT_TIP_RESTORE_POSITION
    bool "Restore toolhead position after cut"
    default n
    help
      Return toolhead to initial position after cut is complete.
      If using parking logic it is generally better to disable this.

  config VAR_CUT_TIP_RESTORE_POSITION
    string
    default "True" if BOOL_CUT_TIP_RESTORE_POSITION
    default "False"

  config VAR_CUT_TIP_BLADE_POS
    float "Blade position               "
    default 37.5
    help
      Distance in mm from internal nozzle tip to cutting blade.

  config VAR_CUT_TIP_RETRACT_LENGTH
    float "Retract length               "
    default 32.5
    help
      Distance to retract prior to making the cut.
      Must be less than blade_pos.

      This should be tuned but 5mm less than 'blade_pos'
      is a good starting point

  config BOOL_CUT_TIP_SIMPLE_TIP_FORMING
    bool "Enable simple tip forming"
    default y
    help
      Perform simple tip forming after initial retraction.

  config VAR_CUT_TIP_SIMPLE_TIP_FORMING
    string
    default "True" if BOOL_CUT_TIP_SIMPLE_TIP_FORMING
    default "False"

  config VAR_CUT_TIP_CUT_AXIS_STEPPERS
    string "Cut axis steppers            "
    default "'stepper_x, stepper_y'"
    help
      Comma separated list of stepper names to increase current for cutting.

  config VAR_CUT_TIP_CUT_STEPPER_CURRENT
    int "Cut stepper current (%)      "
    default 100
    help
      Percentage of normal stepper current to use during cutting.
      100 disables current modification.

  choice CHOICE_CUT_TIP_CUTTING_AXIS
    prompt "Cutting axis"
    default CHOICE_CUT_TIP_CUTTING_AXIS_X
    help
      Determines cut direction and parking calculations.

    config CHOICE_CUT_TIP_CUTTING_AXIS_X
      bool "x"

    config CHOICE_CUT_TIP_CUTTING_AXIS_Y
      bool "y"

  endchoice

  config VAR_CUT_TIP_CUTTING_AXIS
    string
    default "'y'" if CHOICE_CUT_TIP_CUTTING_AXIS_Y
    default "'x'"

  config VAR_CUT_TIP_PIN_LOC_XY
    string "Pin location (X,Y)           "
    default "14, 250"
    help
      X,Y coordinates of depressor pin.

  config VAR_CUT_TIP_PIN_PARK_DIST
    float "Pin park distance            "
    default 5.0
    help
      Distance from pin location used to determine starting position
      and provide momentum before cutting.

  config VAR_CUT_TIP_PIN_LOC_COMPRESSED_XY
    string "Compressed pin location (X,Y)"
    default "0.5, 250"
    help
      X,Y coordinates of fully depressed cutter location.

  config VAR_CUT_TIP_RIP_LENGTH
    float "Rip length                   "
    default 1.0
    help
      Distance to retract after cut to aid lever decompression.

  config VAR_CUT_TIP_RIP_SPEED
    float "Rip speed                    "
    default 3
    help
      Rip movement speed in mm/s.

  config VAR_CUT_TIP_PUSHBACK_LENGTH
    float "Pushback length              "
    default 15.0
    help
      Pushback distance after cut to keep filament fragment in hotend.

  config VAR_CUT_TIP_PUSHBACK_DWELL_TIME
    int "Pushback dwell time (ms)     "
    default 0
    help
      Dwell time after pushback.

  config VAR_CUT_TIP_TRAVEL_SPEED
    float "Travel speed                 "
    default 150
    help
      Travel speed in mm/s.

  config VAR_CUT_TIP_CUT_FAST_MOVE_SPEED
    float "Fast cut move speed          "
    default 32
    help
      Speed of initial momentum-generating cut move.

  config VAR_CUT_TIP_CUT_SLOW_MOVE_SPEED
    float "Slow cut move speed          "
    default 8
    help
      Speed of actual cutting motion.

  config VAR_CUT_TIP_EVACUATE_SPEED
    float "Evacuate speed               "
    default 150
    help
      Speed used after cut operation.

  config VAR_CUT_TIP_CUT_DWELL_TIME
    int "Cut dwell time (ms)          "
    default 50
    help
      Time to dwell at cut point.

  config VAR_CUT_TIP_CUT_FAST_MOVE_FRACTION
    float "Fast move fraction           "
    default 1.0
    help
      Fraction of cut move performed at fast speed.

  config VAR_CUT_TIP_EXTRUDER_MOVE_SPEED
    float "Extruder move speed          "
    default 25
    help
      Speed for all extruder movements.

  config VAR_CUT_TIP_SAFE_MARGIN_XY
    string "Safe margin (X,Y)            "
    default "30, 30"
    help
      Safety margin used when approaching the cutter pin.

  config BOOL_CUT_TIP_GANTRY_SERVO_ENABLED
    bool "Enable gantry servo"
    default n
    help
      Enable optional gantry servo support.

  config VAR_CUT_TIP_GANTRY_SERVO_ENABLED
    string
    default "True" if BOOL_CUT_TIP_GANTRY_SERVO_ENABLED
    default "False"

  config VAR_CUT_TIP_GANTRY_SERVO_DOWN_ANGLE
    int "Gantry servo down angle      "
    default 55
    help
      Servo angle when pin is deployed.

  config VAR_CUT_TIP_GANTRY_SERVO_UP_ANGLE
    int "Gantry servo up angle        "
    default 180
    help
      Servo angle when pin is retracted.

endmenu
```
