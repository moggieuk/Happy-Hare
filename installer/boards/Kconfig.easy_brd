## installer/boards/Kconfig.easy_brd
```kconfig
config BOARD_TYPE_EASY_BRD 
  bool "Standard EASY-BRD with SAMD21"

if BOARD_TYPE_EASY_BRD
  config PARAM_BOARD_TYPE
    default "Original EASY-BRD with samd21"
  
  choice CHOICE_MMU_CONNECTION_TYPE
    default CHOICE_MMU_CONNECTION_TYPE_SERIAL
  endchoice
  choice CHOICE_MMU_SERIAL_CONNECTION
    default $(mmu_serial_config,1,samd21)
  endchoice

  config PIN_GEAR_UART
    default "$(MCU_NAME):PA8" 
  config PIN_GEAR_STEP
    default "$(MCU_NAME):PA4" 
  config PIN_GEAR_DIR
    default "$(MCU_NAME):PA10" 
  config PIN_GEAR_ENABLE
    default "!$(MCU_NAME):PA2" 

  config PIN_SELECTOR_UART
    default PIN_GEAR_UART 
  config PIN_SELECTOR_STEP
    default "$(MCU_NAME):PA9" 
  config PIN_SELECTOR_DIR
    default "$(MCU_NAME):PB8" 
  config PIN_SELECTOR_ENABLE
    default "!$(MCU_NAME):PA11" 
  config PIN_SELECTOR_DIAG
    default "$(MCU_NAME):PA7" if BOOL_ENABLE_SELECTOR_TOUCH 
  config PIN_SELECTOR_ENDSTOP
    default "^$(MCU_NAME):PB9" if !BOOL_ENABLE_SELECTOR_TOUCH
  config PIN_SELECTOR_SERVO
    default "$(MCU_NAME):PA5" 

  config PIN_ENCODER
    default "^$(MCU_NAME):PA6" if MMU_HAS_ENCODER
  config PIN_GATE_SENSOR
    default "^$(MCU_NAME):PA6" if !MMU_HAS_ENCODER
endif
```

## installer/boards/Kconfig.easy_brd_rp2040
```kconfig
config BOARD_TYPE_EASY_BRD_RP2040
  bool "EASY-BRD with RP2040"

if BOARD_TYPE_EASY_BRD_RP2040
  config PARAM_BOARD_TYPE
    default "EASY-BRD with rp2040"

  choice CHOICE_MMU_CONNECTION_TYPE
    default CHOICE_MMU_CONNECTION_TYPE_SERIAL
  endchoice
  choice CHOICE_MMU_SERIAL_CONNECTION
    default $(mmu_serial_config,1,rp2040)
  endchoice

  config PIN_GEAR_UART
    default "$(MCU_NAME):gpio6" 
  config PIN_GEAR_STEP
    default "$(MCU_NAME):gpio27" 
  config PIN_GEAR_DIR
    default "$(MCU_NAME):gpio28" 
  config PIN_GEAR_ENABLE
    default "!$(MCU_NAME):gpio26" 

  config PIN_SELECTOR_UART
    default "$(MCU_NAME):gpio6" 
  config PIN_SELECTOR_STEP
    default "$(MCU_NAME):gpio7" 
  config PIN_SELECTOR_DIR
    default "$(MCU_NAME):gpio0" 
  config PIN_SELECTOR_ENABLE
    default "!$(MCU_NAME):gpio29" 
  config PIN_SELECTOR_DIAG
    default "$(MCU_NAME):gpio2" if BOOL_ENABLE_SELECTOR_TOUCH 
  config PIN_SELECTOR_ENDSTOP
    default "^$(MCU_NAME):gpio1" if !BOOL_ENABLE_SELECTOR_TOUCH
  config PIN_SELECTOR_SERVO
    default "$(MCU_NAME):gpio4" 

  config PIN_ENCODER
    default "^$(MCU_NAME):gpio3" if MMU_HAS_ENCODER
  config PIN_GATE_SENSOR
    default "^$(MCU_NAME):gpio3" if !MMU_HAS_ENCODER 
endif
```

## installer/boards/Kconfig.erb_2
```kconfig
config BOARD_TYPE_ERB_2
  bool "Fysetc Burrows ERB v2"

if BOARD_TYPE_ERB_2
  config PARAM_BOARD_TYPE
    default "ERBv2"

  choice CHOICE_SERIAL_DEVICE
    default $(serial_config,1,rp2040)
  endchoice

  config PIN_GEAR_UART
    default "$(MMU_MCU):gpio11" 
  config PIN_GEAR_STEP
    default "$(MMU_MCU):gpio10" 
  config PIN_GEAR_DIR
    default "$(MMU_MCU):gpio9" 
  config PIN_GEAR_ENABLE
    default "!$(MMU_MCU):gpio8"
  config PIN_GEAR_DIAG
    default "$(MMU_MCU):gpio13"

  config PIN_SELECTOR_UART
    default "$(MMU_MCU):gpio17" 
  config PIN_SELECTOR_STEP
    default "$(MMU_MCU):gpio16" 
  config PIN_SELECTOR_DIR
    default "$(MMU_MCU):gpio15" 
  config PIN_SELECTOR_ENABLE
    default "!$(MMU_MCU):gpio14" 
  config PIN_SELECTOR_DIAG
    default "$(MMU_MCU):gpio19" if BOOL_ENABLE_SELECTOR_TOUCH 
  config PIN_SELECTOR_ENDSTOP
    default "^$(MMU_MCU):gpio24" if !BOOL_ENABLE_SELECTOR_TOUCH
  config PIN_SELECTOR_SERVO
    default "$(MMU_MCU):gpio23" 

  config PIN_PRE_GATE_0
    default "^$(MMU_MCU):gpio12"
  config PIN_PRE_GATE_1
    default "^$(MMU_MCU):gpio18"
  config PIN_PRE_GATE_2
    default "^$(MMU_MCU):gpio2"
  config PIN_PRE_GATE_3
    default "^$(MMU_MCU):gpio3"
  config PIN_PRE_GATE_4
    default "^$(MMU_MCU):gpio4"
  config PIN_PRE_GATE_5
    default "^$(MMU_MCU):gpio5"
  config PIN_PRE_GATE_6
    default "^$(MMU_MCU):gpio6"
  config PIN_PRE_GATE_7
    default "^$(MMU_MCU):gpio7"
  config PIN_PRE_GATE_8
    default "^$(MMU_MCU):gpio26"
  config PIN_PRE_GATE_9
    default "^$(MMU_MCU):gpio27"
  config PIN_PRE_GATE_10
    default "^$(MMU_MCU):gpio28"
  config PIN_PRE_GATE_11
    default "^$(MMU_MCU):gpio29"

  config PIN_ENCODER
    default "^$(MMU_MCU):gpio22" if MMU_HAS_ENCODER
  config PIN_GATE_SENSOR
    default "^$(MMU_MCU):gpio25" if !MMU_HAS_ENCODER
  config PIN_NEOPIXEL
    default "$(MMU_MCU):gpio21"
endif
```

## installer/boards/Kconfig.mellow_easy_brd_can_1
```kconfig
config BOARD_TYPE_MELLOW_EASY_BRD_CAN_1
  bool "Mellow EASY-BRD v1.x with CANbus"

if BOARD_TYPE_MELLOW_EASY_BRD_CAN_1
  config PARAM_BOARD_TYPE
    default "MELLOW-EASY-BRD-CAN"

  choice MCU_CONNECTION_TYPE
    default CHOICE_MCU_CONNECTION_TYPE_SERIAL
  endchoice
  choice SERIAL_DEVICE
    default $(serial_config,1,rp2040)
  endchoice

  config PIN_GEAR_UART
    default "$(MCU_NAME):gpio9" 
  config PIN_GEAR_STEP
    default "$(MCU_NAME):gpio7" 
  config PIN_GEAR_DIR
    default "$(MCU_NAME):gpio8" 
  config PIN_GEAR_ENABLE
    default "!$(MCU_NAME):gpio6"
  config PIN_GEAR_DIAG
    default "$(MCU_NAME):gpio23"

  config PIN_SELECTOR_UART
    default "$(MCU_NAME):gpio0" 
  config PIN_SELECTOR_STEP
    default "$(MCU_NAME):gpio2" 
  config PIN_SELECTOR_DIR
    default "$(MCU_NAME):gpio1" 
  config PIN_SELECTOR_ENABLE
    default "!$(MCU_NAME):gpio3" 
  config PIN_SELECTOR_DIAG
    default "$(MCU_NAME):gpio22" if BOOL_ENABLE_SELECTOR_TOUCH 
  config PIN_SELECTOR_ENDSTOP
    default "^$(MCU_NAME):gpio20" if !BOOL_ENABLE_SELECTOR_TOUCH
  config PIN_SELECTOR_SERVO
    default "$(MCU_NAME):gpio21" 

  config PIN_PRE_GATE_0
    default "^$(MCU_NAME):gpio10"
  config PIN_PRE_GATE_1
    default "^$(MCU_NAME):gpio26"
  config PIN_PRE_GATE_2
    default "^$(MCU_NAME):gpio11"
  config PIN_PRE_GATE_3
    default "^$(MCU_NAME):gpio27"
  config PIN_PRE_GATE_4
    default "^$(MCU_NAME):gpio12"
  config PIN_PRE_GATE_5
    default "^$(MCU_NAME):gpio28"
  config PIN_PRE_GATE_6
    default "^$(MCU_NAME):gpio24"
  config PIN_PRE_GATE_7
    default "^$(MCU_NAME):gpio29"
  config PIN_PRE_GATE_8
    default "^$(MCU_NAME):gpio13"
  config PIN_PRE_GATE_9
    default "^$(MCU_NAME):gpio25"

  config PIN_ENCODER
    default "^$(MCU_NAME):gpio15" if MMU_HAS_ENCODER
  config PIN_GATE_SENSOR
    default "^$(MCU_NAME):gpio15" if !MMU_HAS_ENCODER
  config PIN_NEOPIXEL
    default "$(MCU_NAME):gpio14"
endif
```

## installer/boards/Kconfig.mellow_easy_brd_can_2
```kconfig
config BOARD_TYPE_MELLOW_EASY_BRD_CAN_2
  bool "Mellow EASY-BRD v2.x (with CANbus)"

if BOARD_TYPE_MELLOW_EASY_BRD_CAN_2
  config PARAM_BOARD_TYPE
    default "MELLOW-EASY-BRD-CANv2"

  choice CHOICE_SERIAL_DEVICE
    default $(serial_config,1,rp2040)
  endchoice

  config PIN_GEAR_UART
    default "$(MMU_MCU):gpio9" 
  config PIN_GEAR_STEP
    default "$(MMU_MCU):gpio7" 
  config PIN_GEAR_DIR
    default "$(MMU_MCU):gpio8" 
  config PIN_GEAR_ENABLE
    default "!$(MMU_MCU):gpio6"

  config PIN_SELECTOR_UART
    default "$(MMU_MCU):gpio2" 
  config PIN_SELECTOR_STEP
    default "$(MMU_MCU):gpio4" 
  config PIN_SELECTOR_DIR
    default "$(MMU_MCU):gpio3" 
  config PIN_SELECTOR_ENABLE
    default "!$(MMU_MCU):gpio5" 
  config PIN_SELECTOR_DIAG
    default "$(MMU_MCU):gpio20" if BOOL_ENABLE_SELECTOR_TOUCH 
  config PIN_SELECTOR_ENDSTOP
    default "^$(MMU_MCU):gpio20" if !BOOL_ENABLE_SELECTOR_TOUCH
  config PIN_SELECTOR_SERVO
    default "$(MMU_MCU):gpio21" 

  config PIN_PRE_GATE_0
    default "^$(MMU_MCU):gpio24"
  config PIN_PRE_GATE_1
    default "^$(MMU_MCU):gpio22"
  config PIN_PRE_GATE_2
    default "^$(MMU_MCU):gpio25"
  config PIN_PRE_GATE_3
    default "^$(MMU_MCU):gpio23"
  config PIN_PRE_GATE_4
    default "^$(MMU_MCU):gpio13"
  config PIN_PRE_GATE_5
    default "^$(MMU_MCU):gpio26"
  config PIN_PRE_GATE_6
    default "^$(MMU_MCU):gpio12"
  config PIN_PRE_GATE_7
    default "^$(MMU_MCU):gpio27"
  config PIN_PRE_GATE_8
    default "^$(MMU_MCU):gpio11"
  config PIN_PRE_GATE_9
    default "^$(MMU_MCU):gpio28"
  config PIN_PRE_GATE_10
    default "^$(MMU_MCU):gpio10"
  config PIN_PRE_GATE_11
    default "^$(MMU_MCU):gpio29"

  config PIN_ENCODER
    default "^$(MMU_MCU):gpio15" if MMU_HAS_ENCODER
  config PIN_GATE_SENSOR
    default "^$(MMU_MCU):gpio15" if !MMU_HAS_ENCODER
  config PIN_NEOPIXEL
    default "$(MMU_MCU):gpio14"
endif
```

## installer/boards/Kconfig.mmb_1_0
```kconfig
config BOARD_TYPE_MMB_1_0
  bool "BTT MMB v1.0 (with CANbus)"

if BOARD_TYPE_MMB_1_0
  config PARAM_BOARD_TYPE
    default "MMB10"

  choice CHOICE_SERIAL_DEVICE
    default $(serial_config,1,stm32)
  endchoice

  config PIN_GEAR_UART 
    default "$(MMU_MCU):PA10" 
  config PIN_GEAR_STEP
    default "$(MMU_MCU):PB15" 
  config PIN_GEAR_DIR
    default "$(MMU_MCU):PB14" 
  config PIN_GEAR_ENABLE
    default "!$(MMU_MCU):PA8" 
  config PIN_GEAR_DIAG
    default "$(MMU_MCU):PA3" 

  if VIRTUAL_SELECTOR
    config PIN_GEAR_UART_1 
      default "$(MMU_MCU):PC7" 
    config PIN_GEAR_STEP_1
      default "$(MMU_MCU):PD2" 
    config PIN_GEAR_DIR_1
      default "$(MMU_MCU):PB13" 
    config PIN_GEAR_ENABLE_1
      default "!$(MMU_MCU):PD1" 
    config PIN_GEAR_DIAG_1
      default "$(MMU_MCU):PA4" 

    config PIN_GEAR_UART_2 
      default "$(MMU_MCU):PC6" 
    config PIN_GEAR_STEP_2
      default "$(MMU_MCU):PD0" 
    config PIN_GEAR_DIR_2
      default "$(MMU_MCU):PB3" 
    config PIN_GEAR_ENABLE_2
      default "!$(MMU_MCU):PA15" 
    config PIN_GEAR_DIAG_2
      default "$(MMU_MCU):PB9"

    config PIN_GEAR_UART_3 
      default "$(MMU_MCU):PA9" 
    config PIN_GEAR_STEP_3
      default "$(MMU_MCU):PB6" 
    config PIN_GEAR_DIR_3
      default "$(MMU_MCU):PB7" 
    config PIN_GEAR_ENABLE_3
      default "!$(MMU_MCU):PB5" 
    config PIN_GEAR_DIAG_3
      default "$(MMU_MCU):PB8" 

    config PIN_PRE_GATE_0
      default "$(MMU_MCU):PB11" 
    config PIN_PRE_GATE_1
      default "$(MMU_MCU):PA3" 
    config PIN_PRE_GATE_2
      default "$(MMU_MCU):PB9" 
    config PIN_PRE_GATE_3
      default "$(MMU_MCU):PB8" 

    config PIN_GEAR_SENSOR_0
      default "$(MMU_MCU):PC15"
    config PIN_GEAR_SENSOR_1
      default "$(MMU_MCU):PC13"
    config PIN_GEAR_SENSOR_2
      default "$(MMU_MCU):PC14"
    config PIN_GEAR_SENSOR_3
      default "$(MMU_MCU):PC12"
    
    config PIN_ESPOOLER_RWD_0
      default "$(MMU_MCU):PA0"
    config PIN_ESPOOLER_RWD_1
      default "$(MMU_MCU):PA1"
    config PIN_ESPOOLER_RWD_2
      default "$(MMU_MCU):PB10"
    config PIN_ESPOOLER_RWD_3
      default "$(MMU_MCU):PB2"
  endif

  if !VIRTUAL_SELECTOR
    config PIN_SELECTOR_UART
      default "$(MMU_MCU):PC7" 
    config PIN_SELECTOR_STEP
      default "$(MMU_MCU):PD2" 
    config PIN_SELECTOR_DIR
      default "$(MMU_MCU):PB13" 
    config PIN_SELECTOR_ENABLE
      default "!$(MMU_MCU):PD1" 
    config PIN_SELECTOR_DIAG
      default "$(MMU_MCU):PA4" 
    config PIN_SELECTOR_ENDSTOP
      default "^$(MMU_MCU):PB2" 
    config PIN_SELECTOR_SERVO
      default "$(MMU_MCU):PA0" 

    config PIN_PRE_GATE_0
      default "^$(MMU_MCU):PB9" 
    config PIN_PRE_GATE_1
      default "^$(MMU_MCU):PB8" 
    config PIN_PRE_GATE_2
      default "^$(MMU_MCU):PC15" 
    config PIN_PRE_GATE_3
      default "^$(MMU_MCU):PC13" 
    config PIN_PRE_GATE_4
      default "^$(MMU_MCU):PC14"
    config PIN_PRE_GATE_5
      default "^$(MMU_MCU):PB12"
    config PIN_PRE_GATE_6
      default "^$(MMU_MCU):PB11"
    config PIN_PRE_GATE_7
      default "^$(MMU_MCU):PB10"
  endif

  config PIN_ENCODER
    default "^$(MMU_MCU):PA1" if MMU_HAS_ENCODER
  config PIN_NEOPIXEL
    default "$(MMU_MCU):PA2" 
  config PIN_GATE_SENSOR
    default "^$(MMU_MCU):PA3" if !MMU_HAS_ENCODER
endif
```

## installer/boards/Kconfig.mmb_2_0
```kconfig
choice CHOICE_BOARD_TYPE
  config BOARD_TYPE_MMB_2_0
    bool "BTT MMB v2.0 (with CANbus)"
endchoice

choice CHOICE_SERIAL_DEVICE
  default $(serial_config,1,stm32)
endchoice

if BOARD_TYPE_MMB_2_0
  config PARAM_BOARD_TYPE
    default "mmu:MMB20"

  config PIN_GEAR_UART 
    default "mmu:PB5" 
  config PIN_GEAR_STEP
    default "mmu:PD4" 
  config PIN_GEAR_DIR
    default "mmu:PD3" 
  config PIN_GEAR_ENABLE
    default "!mmu:PD5" 
  config PIN_GEAR_DIAG
    default "mmu:PB9" 

  if PARAM_SELECTOR_TYPE = "VirtualSelector"
    config PIN_GEAR_UART_1 
      default "mmu:PB4" 
    config PIN_GEAR_STEP_1
      default "mmu:PC9" 
    config PIN_GEAR_DIR_1
      default "mmu:PC8" 
    config PIN_GEAR_ENABLE_1
      default "!mmu:PD2" 
    config PIN_GEAR_DIAG_1
      default "mmu:PB8" 

    config PIN_GEAR_UART_2 
      default "mmu:PB3" 
    config PIN_GEAR_STEP_2
      default "mmu:PC15" 
    config PIN_GEAR_DIR_2
      default "mmu:PC11" 
    config PIN_GEAR_ENABLE_2
      default "!mmu:PC10" 
    config PIN_GEAR_DIAG_2
      default "mmu:PB7"

    config PIN_GEAR_UART_3 
      default "mmu:PD6" 
    config PIN_GEAR_STEP_3
      default "mmu:PC13" 
    config PIN_GEAR_DIR_3
      default "mmu:PC12" 
    config PIN_GEAR_ENABLE_3
      default "!mmu:PC14" 
    config PIN_GEAR_DIAG_3
      default "mmu:PB6" 

    config PIN_PRE_GATE_0
      default "mmu:PC7" 
    config PIN_PRE_GATE_1
      default "mmu:PA9" 
    config PIN_PRE_GATE_2
      default "mmu:PB12" 
    config PIN_PRE_GATE_3
      default "mmu:PB10" 

    config PIN_GEAR_SENSOR_0
      default "mmu:PC6"
    config PIN_GEAR_SENSOR_1
      default "mmu:PA8"
    config PIN_GEAR_SENSOR_2
      default "mmu:PB11"
    config PIN_GEAR_SENSOR_3
      default "mmu:PB2"
    
    config PIN_ESPOOLER_RWD_0
      default "mmu:PB1"
    config PIN_ESPOOLER_RWD_1
      default "mmu:PC5"
    config PIN_ESPOOLER_RWD_2
      default "mmu:PB0"
    config PIN_ESPOOLER_RWD_3
      default "mmu:PC4"
  endif

  if PARAM_SELECTOR_TYPE != "VirtualSelector"
    config PIN_SELECTOR_UART
      default "mmu:PB4" 
    config PIN_SELECTOR_STEP
      default "mmu:PC9" 
    config PIN_SELECTOR_DIR
      default "mmu:PC8" 
    config PIN_SELECTOR_ENABLE
      default "!mmu:PD2" 
    config PIN_SELECTOR_DIAG
      default "mmu:PB8" 
    config PIN_SELECTOR_ENDSTOP
      default "^mmu:PA15" 
    config PIN_SELECTOR_SERVO
      default "mmu:PA1" 

    config PIN_PRE_GATE_0
      default "^mmu:PC6" 
    config PIN_PRE_GATE_1
      default "^mmu:PA8" 
    config PIN_PRE_GATE_2
      default "^mmu:PB11" 
    config PIN_PRE_GATE_3
      default "^mmu:PB2" 
    config PIN_PRE_GATE_4
      default "^mmu:PB0"
    config PIN_PRE_GATE_5
      default "^mmu:PC4"
    config PIN_PRE_GATE_6
      default "^mmu:PC5"
    config PIN_PRE_GATE_7
      default "^mmu:PB1"
  endif

  config PIN_ENCODER
    default "^mmu:PC2" if MMU_HAS_ENCODER
  config PIN_NEOPIXEL
    default "mmu:PC3" 
  config PIN_GATE_SENSOR
    default "^mmu:PA15" if !MMU_HAS_ENCODER 
endif
```
