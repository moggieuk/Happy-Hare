## installer/macro_vars/Kconfig.software
```kconfig
menu "Print start/end (_MMU_SOFTWARE)"
  help
    Happy Hare optional configuration for print start/end checks.

    These variables control the behavior of the MMU_START_SETUP,
    MMU_START_LOAD_INITIAL_TOOL, and MMU_END macros.

  comment "_Print START behavior"

  config VAR_SOFTWARE_USER_PRE_INITIALIZE_EXTENSION
    string "Pre initialize extension macro"
    default ""
    help
      Macro executed at start of MMU_START_SETUP.
      Commonly G28 to home.

  config BOOL_SOFTWARE_HOME_MMU
    bool "Home MMU before print starts"
    default n
    help
      Whether to home MMU before print starts.

  config VAR_SOFTWARE_HOME_MMU
    string
    default "True" if BOOL_SOFTWARE_HOME_MMU
    default "False"

  config BOOL_SOFTWARE_CHECK_GATES
    bool "Check gates"
    default y
    help
      Whether to check filament is loaded in all gates used.

  config VAR_SOFTWARE_CHECK_GATES
    string
    default "True" if BOOL_SOFTWARE_CHECK_GATES
    default "False"

  config BOOL_SOFTWARE_LOAD_INITIAL_TOOL
    bool "Load initial tool"
    default y
    help
      Whether to automatically load initial tool.

  config VAR_SOFTWARE_LOAD_INITIAL_TOOL
    string
    default "True" if BOOL_SOFTWARE_LOAD_INITIAL_TOOL
    default "False"

  choice CHOICE_SOFTWARE_AUTOMAP_STRATEGY
    prompt "Automap strategy"
    default CHOICE_SOFTWARE_AUTOMAP_STRATEGY_NONE
    help
      Automapping strategy to apply slicer tool map to find matching
      MMU gate. This will adjust the tool-to-gate map.

  config CHOICE_SOFTWARE_AUTOMAP_STRATEGY_NONE
    bool "none"
    help
      Don't automap; don't update tool-to-gate map.

  config CHOICE_SOFTWARE_AUTOMAP_STRATEGY_FILAMENT_NAME
    bool "filament_name"
    help
      Exactly match on case insensitive filament name.

  config CHOICE_SOFTWARE_AUTOMAP_STRATEGY_MATERIAL
    bool "material"
    help
      Exactly match on material.

  config CHOICE_SOFTWARE_AUTOMAP_STRATEGY_COLOR
    bool "color"
    help
      Exactly match on color with same material.

  config CHOICE_SOFTWARE_AUTOMAP_STRATEGY_CLOSEST_COLOR
    bool "closest_color"
    help
      Match to closest available filament color with same material.

  config CHOICE_SOFTWARE_AUTOMAP_STRATEGY_SPOOL_ID
    bool "spool_id"
    help
      Exactly match on spool_id. Future option.

  endchoice

  config VAR_SOFTWARE_AUTOMAP_STRATEGY
    string
    default "'none'" if CHOICE_SOFTWARE_AUTOMAP_STRATEGY_NONE
    default "'filament_name'" if CHOICE_SOFTWARE_AUTOMAP_STRATEGY_FILAMENT_NAME
    default "'material'" if CHOICE_SOFTWARE_AUTOMAP_STRATEGY_MATERIAL
    default "'color'" if CHOICE_SOFTWARE_AUTOMAP_STRATEGY_COLOR
    default "'closest_color'" if CHOICE_SOFTWARE_AUTOMAP_STRATEGY_CLOSEST_COLOR
    default "'spool_id'" if CHOICE_SOFTWARE_AUTOMAP_STRATEGY_SPOOL_ID

  comment "_"
  comment "_Print END behavior"

  config VAR_SOFTWARE_USER_PRINT_END_EXTENSION
    string "Print end extension macro     "
    default ""
    help
      Macro executed at start of MMU_END.
      Good place to move off print.

  config BOOL_SOFTWARE_UNLOAD_TOOL
    bool "Unload tool at end of print"
    default y
    help
      Whether to unload the tool at the end of the print.

  config VAR_SOFTWARE_UNLOAD_TOOL
    string
    default "True" if BOOL_SOFTWARE_UNLOAD_TOOL
    default "False"

  config BOOL_SOFTWARE_RESET_TTG
    bool "Reset TTG map at end of print"
    default n
    help
      Whether to reset TTG map at end of print.

  config VAR_SOFTWARE_RESET_TTG
    string
    default "True" if BOOL_SOFTWARE_RESET_TTG
    default "False"

  config BOOL_SOFTWARE_DUMP_STATS
    bool "Display print stats at end of print"
    default y
    help
      Whether to display print stats at end of print.

  config VAR_SOFTWARE_DUMP_STATS
    string
    default "True" if BOOL_SOFTWARE_DUMP_STATS
    default "False"

endmenu
```

## installer/macro_vars/Kconfig.state
```kconfig
menu "State change hooks (_MMU_STATE)"
  help
    You can extend functionality to all Happy Hare state change or event
    macros by adding a command (or call to your gcode macro).
    E.g for additional LED logic or consumption counters

  config VAR_STATE_USER_ACTION_CHANGED_EXTENSION
    string "Action changed extension macro     "
    default ""
    help
      Optional user macro that is executed after default logic when
      MMU action changes. Used to extend Happy Hare functionality.
      (passed same params as original macro)

  config VAR_STATE_USER_PRINT_STATE_CHANGED_EXTENSION
    string "Print state changed extension macro"
    default ""
    help
      Optional user macro that is executed after default logic when
      MMU print state changes. Used to extend Happy Hare functionality.
      (passed same params as original macro)

  config VAR_STATE_USER_MMU_EVENT_EXTENSION
    string "MMU event extension macro          "
    default ""
    help
      Optional user macro that is executed after default logic when
      MMU event occurs. Used to extend Happy Hare functionality.
      (passed same params as original macro)

  comment "_"
  comment "_Consumption counters"

  config VAR_STATE_SERVO_DOWN_LIMIT
    int "Servo down limit                   "
    default 5000
    help
      Maintenance warning limit for servo down counter.
      Set to -1 for no limit / disable warning.

      Applicable only if MMU has servo operated filament grip on selector

  config VAR_STATE_CUTTER_BLADE_LIMIT
    int "Cutter blade limit                 "
    default 3000
    help
      Maintenance warning limit for cutter blade counter.
      Set to -1 for no limit / disable warning.

      Applicable only if MMU has filament cutter

endmenu
```

## installer/mmu_additions/Kconfig
```kconfig
menu "MMU Additions"
  help
    Step 2 - Enhancements to base design
    If the base MMU design lacks a particular feature there are often
    modifications available to enhance the design. Select those modifications
    here so that Happy Hare will install the correct drivers and setup
    the best possible starter configuration.

  rsource "Kconfig.*"
  rsource "sensors/Kconfig"
endmenu
```

## installer/mmu_additions/Kconfig.bypass
```kconfig
config PARAM_HAS_BYPASS
  help
    Select if your MMU has a filament bypass option or you have added
    an additonal combiner/splitter bowden for non-MMU use.
  prompt "Has Filament Bypass?"
```

## installer/mmu_additions/Kconfig.eject_buttons
```kconfig
# Defines whether MMU has eject buttons
#
# Responsible for setting:
#   MMU_HAS_ENCODER

if !MMU_DISABLE_EJECT_BUTTONS_OPTION

  config MMU_HAS_EJECT_BUTTONS
    help
      Some MMU designs have dedicated eject buttons. Select this
      option to allow pin editing and inclusion in config template
    prompt "Has Eject buttons?"
    forceshow

endif
```

## installer/mmu_additions/Kconfig.encoder
```kconfig
config MMU_HAS_ENCODER
  help
    An encoder measures filament movement and can be used to validate
    movement, detect clogs, monitor flow rate and detect filament
    collision with the extruder in liue of a toolhead switch sensor.
  prompt "Has Encoder?"
  forceshow

if MMU_HAS_ENCODER
  choice CHOICE_ENCODER_TYPE
    prompt "Type"
    help
      Select the base of the encoder design.

    config CHOICE_ENCODER_TYPE_BINKY
      bool "Binky v1 based"
      help
        Select for Binky based encoders.

    config CHOICE_ENCODER_TYPE_BINKY_V2
      bool "Binky v2 (ERCF v3)"
      help
        Select for Binky based encoders.

    config CHOICE_ENCODER_TYPE_TCRT5000
      bool "TCRT 5000 based"
      help
        Select for older TCRT5000 based encoders.

    config CHOICE_ENCODER_TYPE_OTHER
      bool "Other"
      help
        Select for any other encoder and ensure you set the resolution correctly.
  endchoice

  config PARAM_ENCODER_RESOLUTION
    default "0.7059" if CHOICE_ENCODER_TYPE_TCRT5000
    default "1.0"    if CHOICE_ENCODER_TYPE_BINKY
    default "1.5"    if CHOICE_ENCODER_TYPE_BINKY_V2
    default "1.0"    if CHOICE_ENCODER_TYPE_OTHER
endif
```
