## installer/types/Kconfig.box_turtle_1
```kconfig
choice CHOICE_MMU_TYPE
  config MMU_TYPE_BOX_TURTLE_1
    bool "Box Turtle v1.0"
    select VARIABLE_ROTATION_DISTANCES
    select REQUIRE_BOWDEN_MOVE
    select FILAMENT_ALWAYS_GRIPPED
endchoice

if MMU_TYPE_BOX_TURTLE_1
  config PARAM_MMU_VENDOR
    default "BoxTurtle"
  config PARAM_MMU_VERSION
    default "1.0"

  config PARAM_GEAR_GEAR_RATIO
    default "1:1"
  config PARAM_GEAR_RUN_CURRENT
    default "0.7"
  config PARAM_GEAR_HOLD_CURRENT
    default "0.1"
  config PARAM_GATE_HOMING_MAX
    default "300"
  config PARAM_GATE_PARKING_DISTANCE
    default "100"
  config PARAM_GATE_FINAL_EJECT_DISTANCE
    default "100"

  choice CHOICE_SELECTOR_TYPE
    default SELECTOR_TYPE_VIRTUAL
  endchoice

  choice CHOICE_GATE_HOMING_ENDSTOP
    default GATE_HOMING_ENDSTOP_GATE
  endchoice
  
  choice CHOICE_EXTRUDER_HOMING_ENDSTOP
    default EXTRUDER_HOMING_ENDSTOP_NONE
  endchoice
endif 
```

## installer/types/Kconfig.ercf
```kconfig
choice CHOICE_MMU_TYPE 
  config MMU_TYPE_ERCF_1_1
    bool "ERCF v1.1"
    select MMU_HAS_ENCODER
    select MMU_HAS_SERVO
    select MMU_HAS_SELECTOR
    select VARIABLE_ROTATION_DISTANCES
    select REQUIRE_BOWDEN_MOVE

  if MMU_TYPE_ERCF_1_1 
    config EXT_SPRINGY
      bool "Springy"
    config EXT_BINKY
      bool "Binky"
    config EXT_TRIPLE_DECK
      bool "Triple Deck"
  endif  
  
  config MMU_TYPE_ERCF_2_0
    bool "ERCF v2.0"
    select MMU_HAS_ENCODER
    select MMU_HAS_SERVO
    select MMU_HAS_SELECTOR
    select VARIABLE_ROTATION_DISTANCES
    select REQUIRE_BOWDEN_MOVE
  
  if MMU_TYPE_ERCF_2_0
    config EXT_THUMPER_BLOCKS
      bool "Thumper Blocks"
  endif
endchoice

if MMU_TYPE_ERCF_1_1
  config PARAM_MMU_VENDOR
    default "ERCF"
  config PARAM_MMU_VERSION
    default "1.1sbt" if EXT_SPRINGY && EXT_BINKY && EXT_TRIPLE_DECK
    default "1.1sb" if EXT_SPRINGY && EXT_BINKY
    default "1.1st" if EXT_SPRINGY && EXT_TRIPLE_DECK
    default "1.1bt" if EXT_BINKY && EXT_TRIPLE_DECK
    default "1.1s" if EXT_SPRINGY
    default "1.1b" if EXT_BINKY
    default "1.1t" if EXT_TRIPLE_DECK
    default "1.1"
  config PARAM_NUM_GATES
    default 9

   
  config PARAM_SERVO_BUZZ_GEAR_ON_DOWN
    default 3

  config PARAM_GEAR_GEAR_RATIO
    default "80:20"
  config PARAM_GEAR_RUN_CURRENT
    default "0.5"
  config PARAM_GEAR_HOLD_CURRENT
    default "0.1"
  config PARAM_SELECTOR_RUN_CURRENT
    default "0.4"
  config PARAM_SELECTOR_HOLD_CURRENT
    default "0.2"
  config PARAM_SERVO_DURATION
    default "0.4"
  config PARAM_ENCODER_RESOLUTION
    default "0.7059"
  config PARAM_GATE_PARKING_DISTANCE
    default "23"

  choice CHOICE_GATE_HOMING_ENDSTOP
    default GATE_HOMING_ENDSTOP_ENCODER
  endchoice
  
  choice CHOICE_EXTRUDER_HOMING_ENDSTOP
    default EXTRUDER_HOMING_ENDSTOP_COLLISION
  endchoice
endif 

if MMU_TYPE_ERCF_2_0
  config PARAM_MMU_VENDOR
    default "ERCF"
  config PARAM_MMU_VERSION
    default "2.0"
  config PARAM_NUM_GATES
    default 8
  
  config PARAM_SERVO_BUZZ_GEAR_ON_DOWN
    default 3
 
  config PARAM_GEAR_GEAR_RATIO
    default "80:20"
  config PARAM_GEAR_RUN_CURRENT
    default "0.5"
  config PARAM_GEAR_HOLD_CURRENT
    default "0.1"
  config PARAM_SELECTOR_RUN_CURRENT
    default "0.4"
  config PARAM_SELECTOR_HOLD_CURRENT
    default "0.2"
  config PARAM_SERVO_DURATION
    default "0.4"
  config PARAM_ENCODER_RESOLUTION
    default "1.0"
  config PARAM_GATE_PARKING_DISTANCE
    default "11" if EXT_THUMPER_BLOCKS
    default "13"

  choice CHOICE_GATE_HOMING_ENDSTOP
    default GATE_HOMING_ENDSTOP_ENCODER
  endchoice
  
  choice CHOICE_EXTRUDER_HOMING_ENDSTOP
    default EXTRUDER_HOMING_ENDSTOP_COLLISION
  endchoice
endif 
```

## installer/types/Kconfig.night_owl
```kconfig
choice CHOICE_MMU_TYPE
  config MMU_TYPE_NIGHT_OWL_1
    bool "Night Owl (Night Turtle) v1.0"
    select VARIABLE_ROTATION_DISTANCES
    select REQUIRE_BOWDEN_MOVE
    select MMU_HAS_GEARS
    select FILAMENT_ALWAYS_GRIPPED
endchoice

if MMU_TYPE_NIGHT_OWL_1
  config PARAM_MMU_VENDOR
    default "NightOwl"
  config PARAM_MMU_VERSION
    default "1.0"

  config PARAM_GEAR_GEAR_RATIO
    default "50:10"
  config PARAM_GEAR_RUN_CURRENT
    default "0.7"
  config PARAM_GEAR_HOLD_CURRENT
    default "0.1"
  config PARAM_GATE_PARKING_DISTANCE
    default "100"
  config PARAM_GATE_FINAL_EJECT_DISTANCE
    default "100"

  choice CHOICE_GATE_HOMING_ENDSTOP
    default GATE_HOMING_ENDSTOP_GATE
  endchoice
  
  choice CHOICE_EXTRUDER_HOMING_ENDSTOP
    default EXTRUDER_HOMING_ENDSTOP_NONE
  endchoice
endif 
```

## installer/types/Kconfig.pico_mmu
```kconfig
choice CHOICE_MMU_TYPE
  config MMU_TYPE_PICO_MMU_1_0
    bool "Pico MMU"
    select MMU_HAS_SERVO
    select VARIABLE_REQUIRE_BOWDEN_MOVE
    select FILAMENT_ALWAYS_GRIPPED
    imply ENABLE_LEDS
endchoice

if MMU_TYPE_PICO_MMU_1_0
  config PARAM_MMU_VENDOR
    default "PicoMMU"
  config PARAM_MMU_VERSION
    default "1.0"  
  config PARAM_NUM_GATES
    default 4

  config PARAM_GEAR_GEAR_RATIO
    default "1.28:1"
  config PARAM_GEAR_RUN_CURRENT
    default "0.7"
  config PARAM_GEAR_HOLD_CURRENT
    default "0.1"
  config PARAM_GEAR_HOMING_SPEED
    default "80"

  config PARAM_GATE_HOMING_MAX
    default "100"
  config PARAM_GATE_PARKING_DISTANCE
    default "25"

  config PARAM_CHAIN_COUNT
    default 4   
  config PARAM_EXIT_LEDS 
    default "neopixel:mmu_leds (1-4)"

  choice CHOICE_GATE_HOMING_ENDSTOP
    default GATE_HOMING_ENDSTOP_GATE
  endchoice
  
  choice CHOICE_EXTRUDER_HOMING_ENDSTOP
    default EXTRUDER_HOMING_ENDSTOP_NONE
  endchoice
endif 
```

## installer/types/Kconfig.quattro_box
```kconfig
choice CHOICE_MMU_TYPE
  config MMU_TYPE_QUATTRO_BOX_1_0
    bool "QuattroBox v1.0"
    select MMU_HAS_ENCODER
    select VARIABLE_ROTATION_DISTANCES
    select VARIABLE_BOWDEN_LENGTHS
    select FILAMENT_ALWAYS_GRIPPED
    select ADDDN_EJECT_BUTTONS
    select REQUIRE_BOWDEN_MOVE
    imply ENABLE_LEDS

  config MMU_TYPE_QUATTRO_BOX_1_1
    bool "QuattroBox v1.1"
    select MMU_HAS_ENCODER
    select VARIABLE_ROTATION_DISTANCES
    select VARIABLE_BOWDEN_LENGTHS
    select FILAMENT_ALWAYS_GRIPPED
    select ADDDN_EJECT_BUTTONS
    select REQUIRE_BOWDEN_MOVE
    imply ENABLE_LEDS

endchoice

if MMU_TYPE_QUATTRO_BOX_1_0
  config PARAM_MMU_VENDOR
    default "QuattroBox"
  config PARAM_MMU_VERSION
    default "1.0"  
  config PARAM_NUM_GATES
    default 4

  config PARAM_GEAR_GEAR_RATIO
    default "50:17"
  config PARAM_GEAR_RUN_CURRENT
    default "1.27"
  config PARAM_GEAR_HOLD_CURRENT
    default "0.2"
  config PARAM_GEAR_HOMING_SPEED
    default "80"
  
  config PARAM_GATE_HOMING_MAX
    default "200"
  config PARAM_GATE_PRELOAD_HOMING_MAX
    default "200"
  config PARAM_GATE_PARKING_DISTANCE
    default "30"
  config PARAM_GATE_ENDSTOP_TO_ENCODER
    default "18"
  config PARAM_GATE_FINAL_EJECT_DISTANCE
    default "200"

  config PARAM_CHAIN_COUNT
    default 32   
  config PARAM_COLOR_ORDER
    default "GRBW,GRBW,GRBW,GRBW,GRB,GRB,GRB,GRB,GRB,GRB,GRB,GRB,GRB,GRB,GRB,GRB,GRB,GRB,GRB,GRB,GRB,GRB,GRB,GRB,GRB,GRB,GRB,GRB,GRB,GRB,GRB,GRB"
  config PARAM_EXIT_LEDS 
    default "neopixel:mmu_leds (1-4)"
  config PARAM_STATUS_LEDS
    default "neopixel:mmu_leds (5-14)"
  config PARAM_LOGO_LEDS
    default "neopixel:mmu_leds (15-32)"

  choice CHOICE_GATE_HOMING_ENDSTOP
    default GATE_HOMING_ENDSTOP_GATE
  endchoice
  
  choice CHOICE_EXTRUDER_HOMING_ENDSTOP
    default EXTRUDER_HOMING_ENDSTOP_COLLISION
  endchoice
endif 

if MMU_TYPE_QUATTRO_BOX_1_1
  config PARAM_MMU_VENDOR
    default "QuattroBox"
  config PARAM_MMU_VERSION
    default "1.1"  
  config PARAM_NUM_GATES
    default 4

  config PARAM_GEAR_GEAR_RATIO
    default "50:17"
  config PARAM_GEAR_RUN_CURRENT
    default "1.27"
  config PARAM_GEAR_HOLD_CURRENT
    default "0.2"
  config PARAM_GEAR_HOMING_SPEED
    default "80"
  
  config PARAM_GATE_HOMING_MAX
    default "200"
  config PARAM_GATE_PRELOAD_HOMING_MAX
    default "200"
  config PARAM_GATE_PARKING_DISTANCE
    default "30"
  config PARAM_GATE_ENDSTOP_TO_ENCODER
    default "18"
  config PARAM_GATE_FINAL_EJECT_DISTANCE
    default "200"

  config PARAM_CHAIN_COUNT
    default 36   
  config PARAM_COLOR_ORDER
    default "GRBW,GRBW,GRBW,GRBW,GRBW,GRBW,GRBW,GRBW,GRB,GRB,GRB,GRB,GRB,GRB,GRB,GRB,GRB,GRB,GRB,GRB,GRB,GRB,GRB,GRB,GRB,GRB,GRB,GRB,GRB,GRB,GRB,GRB,GRB,GRB,GRB,GRB"
  config PARAM_EXIT_LEDS 
    default "neopixel:mmu_leds (2,4,6,8)"
  config PARAM_STATUS_LEDS
    default "neopixel:mmu_leds (1,3,5,7)"
  config PARAM_LOGO_LEDS
    default "neopixel:mmu_leds (9-36)"

  choice CHOICE_GATE_HOMING_ENDSTOP
    default GATE_HOMING_ENDSTOP_GATE
  endchoice
  
  choice CHOICE_EXTRUDER_HOMING_ENDSTOP
    default EXTRUDER_HOMING_ENDSTOP_COLLISION
  endchoice
endif 
```

## installer/types/Kconfig.tradrack
```kconfig
choice CHOICE_MMU_TYPE
  config MMU_TYPE_TRADRACK_1_0
    bool "Tradrack v1.0"
    select REQUIRE_BOWDEN_MOVE
    select MMU_HAS_SERVO
    select MMU_HAS_SELECTOR
    imply SERVO_ALWAYS_ACTIVE
    
  config EXT_BINKY
    bool "Binky" 
    select MMU_HAS_ENCODER
    depends on MMU_TYPE_TRADRACK_1_0
endchoice

if MMU_TYPE_TRADRACK_1_0
  config PARAM_MMU_VENDOR
    default "Tradrack"
  config PARAM_MMU_VERSION
    default "1.0e" if EXT_BINKY
    default "1.0"
  config PARAM_NUM_GATES
    default 8

  config PARAM_SERVO_BUZZ_GEAR_ON_DOWN
    default 0

  config PARAM_GEAR_GEAR_RATIO
    default "50:17"
  config PARAM_GEAR_RUN_CURRENT
    default "1.27"
  config PARAM_GEAR_HOLD_CURRENT
    default "0.2"
  config PARAM_SELECTOR_RUN_CURRENT
    default "0.63"
  config PARAM_SELECTOR_HOLD_CURRENT
    default "0.2"
  config PARAM_SERVO_DURATION
    default "0.4"
  config PARAM_SERVO_BUZZ_GEAR_ON_DOWN
    default 0
  config PARAM_ENCODER_RESOLUTION
    default "1.0" if EXT_BINKY

  config PARAM_GATE_PARKING_DISTANCE
    default "48" if EXT_BINKY 
    default "17.5"
  config PARAM_GATE_ENDSTOP_TO_ENCODER
    default "31" if EXT_BINKY

  choice CHOICE_GATE_HOMING_ENDSTOP
    default GATE_HOMING_ENDSTOP_ENCODER if EXT_BINKY
    default GATE_HOMING_ENDSTOP_GATE
  endchoice
  
  choice CHOICE_EXTRUDER_HOMING_ENDSTOP
    default EXTRUDER_HOMING_ENDSTOP_COLLISION if EXT_BINKY
    default EXTRUDER_HOMING_ENDSTOP_NONE
  endchoice
endif 
```

## installer/types/Kconfig.vvd
```kconfig
choice CHOICE_MMU_TYPE 
  config MMU_TYPE_VVD_1_0
    bool "BTT ViViD"
    select MMU_HAS_SELECTOR
    select REQUIRE_BOWDEN_MOVE
endchoice

if MMU_TYPE_VVD_1_0
  config PARAM_MMU_VENDOR
    default "VVD"
  config PARAM_MMU_VERSION
    default "1.0" 

  config PARAM_NUM_GATES
    default 4

  config PARAM_GEAR_GEAR_RATIO
    default "1:1"
  config PARAM_GEAR_RUN_CURRENT
    default "0.7"
  config PARAM_GEAR_HOLD_CURRENT
    default "0.1"
  config PARAM_SELECTOR_RUN_CURRENT
    default "0.8"
  config PARAM_SELECTOR_HOLD_CURRENT
    default "0.4"
  config PARAM_GEAR_HOMING_SPEED
    default "80"
  config PARAM_GEAR_ROTATION_DISTANCE
    default "7.8"

  config PARAM_GATE_PARKING_DISTANCE
    default "-10"
  config PARAM_GATE_HOMING_MAX
    default "500"
  
  choice CHOICE_GATE_HOMING_ENDSTOP
    default GATE_HOMING_ENDSTOP_GEAR
  endchoice
  choice CHOICE_EXTRUDER_HOMING_ENDSTOP
    default EXTRUDER_HOMING_ENDSTOP_NONE
  endchoice
endif 
```

## installer/types/starters/Kconfig.type_a
```kconfig
choice CHOICE_MMU_CUSTOM_TYPE
  config MMU_CUSTOM_TYPE_A
    bool "Type A (Selector)"
    imply REQUIRE_BOWDEN_MOVE
  
  if MMU_CUSTOM_TYPE_A 
    config MMU_HAS_ENCODER
      bool "With encoder?"
  endif 
endchoice

if MMU_CUSTOM_TYPE_A
  config PARAM_MMU_VENDOR
    default "Other"
  config MMU_BASE_VERSION
    default "1.0"

  config PARAM_GEAR_GEAR_RATIO
    default "1:1"
  config PARAM_GEAR_RUN_CURRENT
    default "0.7"
  config PARAM_GEAR_HOLD_CURRENT
    default "0.1"

  config PARAM_SELECTOR_RUN_CURRENT
    default "0.5"
  config PARAM_SELECTOR_HOLD_CURRENT
    default "0.1"

  choice CHOICE_SELECTOR_TYPE
    default SELECTOR_TYPE_LINEAR
  endchoice

  choice CHOICE_GATE_HOMING_ENDSTOP
    default GATE_HOMING_ENDSTOP_ENCODER if MMU_HAS_ENCODER
    default GATE_HOMING_ENDSTOP_GATE if !MMU_HAS_ENCODER
  endchoice

  choice CHOICE_EXTRUDER_HOMING_ENDSTOP
    default EXTRUDER_HOMING_ENDSTOP_COLLISION if MMU_HAS_ENCODER
    default EXTRUDER_HOMING_ENDSTOP_NONE if !MMU_HAS_ENCODER
  endchoice
endif 
```

## installer/types/starters/Kconfig.type_b
```kconfig
choice CHOICE_MMU_CUSTOM_TYPE
  config MMU_CUSTOM_TYPE_B
    bool "Type B (Multiple filament drivers)"
    imply REQUIRE_BOWDEN_MOVE
    imply VARIABLE_BOWDEN_LENGTHS
    imply VARIABLE_ROTATION_DISTANCES
    imply FILAMENT_ALWAYS_GRIPPED

  if MMU_CUSTOM_TYPE_B
    config MMU_HAS_ENCODER
      bool "With encoder?"
    config MMU_WITH_SHARED_GATE # There seems to be no difference in setup between shared gate and not?
      bool "With shared Gate?"
    config MMU_WITH_GEAR_SENSORS
      bool "With individual post-gear sensors?"
  endif
endchoice

if MMU_CUSTOM_TYPE_B
  config PARAM_MMU_VENDOR
    default "Other"
  config MMU_BASE_VERSION
    default "1.0"

  config PARAM_GEAR_GEAR_RATIO
    default "1:1"
  config PARAM_GEAR_RUN_CURRENT
    default "0.7"
  config PARAM_GEAR_HOLD_CURRENT
    default "0.1"

  choice CHOICE_SELECTOR_TYPE
    default SELECTOR_TYPE_VIRTUAL
  endchoice

  choice CHOICE_GATE_HOMING_ENDSTOP
    default GATE_HOMING_ENDSTOP_GATE if !MMU_WITH_GEAR_SENSORS
    default GATE_HOMING_ENDSTOP_GEAR if MMU_WITH_GEAR_SENSORS
  endchoice

  choice CHOICE_EXTRUDER_HOMING_ENDSTOP
    default EXTRUDER_HOMING_ENDSTOP_NONE
  endchoice
endif 
```

## scripts/Kconfig
```kconfig
happy_hare_version = 3.00
formatted_version = $(shell, echo "$(happy_hare_version)" | sed 's/\([0-9]\+\)\.\([0-9]\)\([0-9]\)/\1.\2.\3/')

mainmenu "Happy Hare $(formatted_version) Configuration"

### Helper functions
# Used to convert a shell command result to a y/n value
to_bool = $(shell, $(1) && echo y || echo n)

# Used to get the serial device paths
serial=$(shell, ls /dev/serial/by-id/* 2>/dev/null | grep 'Klipper_$(2)' | tail -n +$(1) | head -n 1)
serial_exists=$(to_bool, [ -e '$(serial,$(1),$(2))' ])
serial_config=$(shell, basename '$(serial,$(1),$(2))' | awk '{print "PARAM_SERIAL_" toupper($0)}')

### Start of configuration
config PARAM_HAPPY_HARE_VERSION
  string	
  default "$(happy_hare_version)"

config F_VERSION
  string
  default "$(formatted_version)"

comment '					'
comment '(\\_/)					'
comment '( *,*)					'
comment '(")_(") Happy Hare version $(formatted_version) 	'	
comment '					'

config IS_MIPS
  bool
  default $(to_bool, uname -m | grep -q 'mips')

rsource "types/Kconfig"

config MMU_HAS_ENCODER
  bool

rsource "boards/Kconfig"
rsource "Kconfig.serial"

config PARAM_NUM_GATES
  int "Number of gates"
  default 12

rsource "servos/Kconfig"

menu "Options"
  rsource "Kconfig.options"
endmenu

menu "Addons"
  rsource "addons/Kconfig.*"
endmenu

menu "Advanced settings"
  menu "Paths & Services"
    rsource "Kconfig.paths_services"
  endmenu

  menu "Pins"
    rsource "Kconfig.pins"
  endmenu

  menu "Motors"
    rsource "Kconfig.motors"
  endmenu

  menu "Endstops"
    rsource "Kconfig.endstops"
  endmenu

  menu "Parameters"
    visible if MMU_TYPE_CUSTOM
    rsource "Kconfig.params"
  endmenu

  config REPETIER
    bool "Enable Repetier support?" if SHOW_ADVANCED_SETTINGS

  config REPETIER_NAME
    string "Repetier name"
    depends on REPETIER

  config OCTOPRINT
    bool "Enable Octoprint support?" if SHOW_ADVANCED_SETTINGS
    depends on !IS_MIPS
endmenu
```
