## scripts/Kconfig.endstops
```kconfig
choice CHOICE_GATE_HOMING_ENDSTOP 
  prompt "Gate homing endstop" 
  default PARAM_GATE_HOMING_ENDSTOP_NONE

  config PARAM_GATE_HOMING_ENDSTOP_ENCODER
    bool "Encoder homing endstop"
  config PARAM_GATE_HOMING_ENDSTOP_GATE
    bool "Gate homing endstop"
  config PARAM_GATE_HOMING_ENDSTOP_GEAR
    bool "Gear homing endstop"
  config PARAM_GATE_HOMING_ENDSTOP_NONE
    bool "No homing endstop"
endchoice

config PARAM_GATE_HOMING_ENDSTOP
  string 
  default "encoder" if PARAM_GATE_HOMING_ENDSTOP_ENCODER
  default "mmu_gate" if PARAM_GATE_HOMING_ENDSTOP_GATE
  default "mmu_gear" if PARAM_GATE_HOMING_ENDSTOP_GEAR
  default "none" if PARAM_GATE_HOMING_ENDSTOP_NONE

choice CHOICE_EXTRUDER_HOMING_ENDSTOP
  prompt "Extruder homing endstop" 
  default PARAM_EXTRUDER_HOMING_ENDSTOP_NONE

  config PARAM_EXTRUDER_HOMING_ENDSTOP_COLLISION
    bool "Collision homing endstop"
  config PARAM_EXTRUDER_HOMING_ENDSTOP_EXTRUDER
    bool "Extruder homing endstop"
  config PARAM_EXTRUDER_HOMING_ENDSTOP_ENCODER
    bool "Encoder homing endstop"
  config PARAM_EXTRUDER_HOMING_ENDSTOP_NONE
    bool "No homing endstop"
endchoice

config PARAM_EXTRUDER_HOMING_ENDSTOP
  string 
  default "collision" if PARAM_EXTRUDER_HOMING_ENDSTOP_COLLISION
  default "extruder" if PARAM_EXTRUDER_HOMING_ENDSTOP_EXTRUDER
  default "encoder" if PARAM_EXTRUDER_HOMING_ENDSTOP_ENCODER
  default "none" if PARAM_EXTRUDER_HOMING_ENDSTOP_NONE
```

## scripts/Kconfig.mmu_types
```kconfig
config HW_MMU_VENDOR
  string
  default "ERCF" if HW_MMU_TYPE_ERCF_V1_1 || HW_MMU_TYPE_ERCF_V2
  default "Tradrack" if HW_MMU_TYPE_TRADRACK_V1
  default "AngryBeaver" if HW_MMU_TYPE_ANGRY_BEAVER_V1
  default "BoxTurtle" if HW_MMU_TYPE_BOX_TURTLE_V1
  default "NightOwl" if HW_MMU_TYPE_NIGHT_OWL_V1
  default "3MS" if HW_MMU_TYPE_3MS_V1
  default "Other"

config HW_MMU_BASE_VERSION
  string
  default "1.1" if HW_MMU_TYPE_ERCF_V1_1
  default "2.0" if HW_MMU_TYPE_ERCF_V2
  default "1.0" if HW_MMU_TYPE_TRADRACK_V1 || HW_MMU_TYPE_3MS_V1 || HW_MMU_TYPE_NIGHT_OWL_V1 || HW_MMU_TYPE_BOX_TURTLE_V1
  default "1.0" 

choice 
  prompt "Type"
  config HW_MMU_TYPE_ERCF_V1_1
    bool "ERCF v1.1"
    select MMU_HAS_ENCODER
    select MMU_HAS_SELECTOR
    select HW_VARIABLE_ROTATION_DISTANCES
    select HW_REQUIRE_BOWDEN_MOVE

  if HW_MMU_TYPE_ERCF_V1_1
    config HW_EXT_SPRINGY
      bool "Springy"
    config HW_EXT_BINKY
      bool "Binky"
    config HW_EXT_TRIPLE_DECK
      bool "Triple Deck"
  endif

  config HW_MMU_TYPE_ERCF_V2
    bool "ERCF v2.0"
    select MMU_HAS_ENCODER
    select MMU_HAS_SELECTOR
    select HW_VARIABLE_ROTATION_DISTANCES
    select HW_REQUIRE_BOWDEN_MOVE

  config HW_MMU_TYPE_TRADRACK_V1
    bool "Tradrack v1.0"
    select MMU_HAS_SELECTOR
    select HW_REQUIRE_BOWDEN_MOVE

  if HW_MMU_TYPE_TRADRACK_V1
    config HW_EXT_BINKY
      bool "Binky" 
      select MMU_HAS_ENCODER
  endif

  config HW_MMU_TYPE_ANGRY_BEAVER_V1
    bool "Angry Beaver v1.0"
    select HW_VARIABLE_ROTATION_DISTANCES
    select HW_FILAMENT_ALWAYS_GRIPPED

  config HW_MMU_TYPE_BOX_TURTLE_V1
    bool "Box Turtle v1.0"
    select HW_VARIABLE_BOWDEN_LENGTHS
    select HW_VARIABLE_ROTATION_DISTANCES
    select HW_REQUIRE_BOWDEN_MOVE
    select HW_FILAMENT_ALWAYS_GRIPPED

  config HW_MMU_TYPE_NIGHT_OWL_V1
    bool "Night Owl (Night Turtle) v1.0"
    select HW_VARIABLE_BOWDEN_LENGTHS
    select HW_VARIABLE_ROTATION_DISTANCES
    select HW_REQUIRE_BOWDEN_MOVE
    select HW_FILAMENT_ALWAYS_GRIPPED

  config HW_MMU_TYPE_3MS_V1
    bool "Box Turtle v1.0"
    select HW_VARIABLE_ROTATION_DISTANCES
    select HW_FILAMENT_ALWAYS_GRIPPED

  config HW_MMU_TYPE_CUSTOM
    bool "Custom"
    imply HW_REQUIRE_BOWDEN_MOVE

  if HW_MMU_TYPE_CUSTOM
    choice 
      prompt "Custom starter config"
      config MMU_CUSTOM_TYPE_A_NO_ENCODER
        bool "Type A (Selector)"
        imply MMU_HAS_SELECTOR
      config MMU_CUSTOM_TYPE_A_ENCODER
        bool "Type A (Selector) with Encoder"
        imply MMU_HAS_SELECTOR
        imply MMU_HAS_ENCODER
      config MMU_CUSTOM_TYPE_B_ENCODER
        bool "Type B (Multiple filament driver steppers) with Encoder"
        imply MMU_HAS_ENCODER
      config MMU_CUSTOM_TYPE_B_SHARED_GATE
        bool "Type B (Multiple filament driver steppers) with Shared gate sensor"
      config MMU_CUSTOM_TYPE_B_SHARED_GATE_ENCODER
        bool "Type B (Multiple filament driver steppers) with Shared gate sensor, Encoder"
        imply MMU_HAS_ENCODER
      config MMU_CUSTOM_TYPE_B_INDIVIDUAL_GATE
        bool "Type B (Multiple filament driver steppers) with Individual post-gate sensor"
      config MMU_CUSTOM_TYPE_B_INDIVIDUAL_GATE_ENCODER
        bool "Type B (Multiple filament driver steppers) with Individual post-gate sensor, Encoder"
        imply MMU_HAS_ENCODER
    endchoice
  endif
endchoice
```

## scripts/Kconfig.motors
```kconfig
config HW_GEAR_GEAR_RATIO
  string "Gear ratio"
config HW_GEAR_RUN_CURRENT
  string "Gear run current"
config HW_GEAR_HOLD_CURRENT
  string "Gear hold current"

if MMU_HAS_SELECTOR
  config HW_SERVO_MAX_ANGLE
    int "Servo maximum angle"
    range 0 360
    default 180
  config HW_SERVO_MIN_PULSE_WIDTH
    string "Servo minimum pulse width"
  config HW_SERVO_MAX_PULSE_WIDTH
    string "Servo maximum pulse width"
  config HW_SERVO_UP_ANGLE
    int "Servo up angle"
  config HW_SERVO_MOVE_ANGLE
    int "Servo move angle"
  config HW_SERVO_DOWN_ANGLE
    int "Servo down angle"
  config HW_SERVO_BUZZ_GEAR_ON_DOWN
    int "How often to buzz servo on down angle"
    default 1 
  config HW_SERVO_ALWAYS_ACTIVE
    bool "Servo always active?"
  config HW_SELECTOR_RUN_CURRENT
    string "Selector run current"
    default "0.5"
  config HW_SELECTOR_HOLD_CURRENT
    string "Selector hold current"
    default "0.2"
endif 
```

## scripts/Kconfig.options
```kconfig
config ENABLE_LEDS
  bool "Enable neopixel LEDs support?"

config ENABLE_SELECTOR_TOUCH
  bool "Enable touch selector operation using TMC Stallguard?"
  help
    This allows for additional selector recovery steps but is difficult to tune.
    Not recommended if you are new to MMU/Happy-Hare.
    The MCU must have DIAG output for steppers. Possible to configure later.

if BOARD_TYPE_EASY_BRD
  comment " !!! IMPORTANT: Set the J6 jumper pins to 2-3 and 4-5, i.e. .[..][..]  MAKE A NOTE NOW !!! "
    depends on SELECTOR_TOUCH
  comment " !!! IMPORTANT: Set the J6 jumper pins to 1-2 and 4-5, i.e. [..].[..]  MAKE A NOTE NOW !!! "
    depends on !SELECTOR_TOUCH
endif

config ENABLE_CLOG_DETECT
  bool "Enable clog detection?"
  depends on MMU_HAS_ENCODER
  imply ENABLE_CLOG
config ENABLE_AUTO_CLOG_DETECT
  bool "Enable automatic clog detection length?"
  depends on ENABLE_CLOG_DETECT
  default y

config PARAM_ENABLE_CLOG_DETECTION
  int 
  default 2 if ENABLE_AUTO_CLOG_DETECT
  default 1 if ENABLE_CLOG_DETECT

config ENABLE_ENDLESS_SPOOL
  bool "Enable EndlessSpool?"
  help
    This uses filament runout detection to automate switching to a new spool without interruption.

config PARAM_ENABLE_ENDLESS_SPOOL
  int
  default 1 if ENABLE_ENDLESS_SPOOL

choice CHOICE_SPOOLMAN_SUPPORT
  prompt "Select spool manager support"
  default SPOOLMAN_OFF
  help
    Select the spool manager support you want to use.

  config SPOOLMAN_OFF
    bool "Off"
  config SPOOLMAN_RO
    bool "Read-only"
  config SPOOLMAN_PUSH
    bool "Push"
  config SPOOLMAN_PULL
    bool "Pull"
endchoice

config PARAM_SPOOLMAN_SUPPORT
  string
  default "off" if SPOOLMAN_OFF
  default "readonly" if SPOOLMAN_RO
  default "push" if SPOOLMAN_PUSH
  default "pull" if SPOOLMAN_PULL

config INSTALL_12864_MENU
  bool "Install Mini 12864 menu configuration?"
config INSTALL_CLIENT_MACROS
  bool "Install default pause/resume macros supplied with Happy Hare? (recommended)"
  default y
```

## scripts/Kconfig.params
```kconfig
choice CHOICE_SELECTOR_TYPE
  prompt "Selector type"
  config SELECTOR_TYPE_LINEAR
    bool "Linear selector"
  config SELECTOR_TYPE_VIRTUAL
    bool "Virtual selector"
endchoice

# config PARAM_SELECTOR_TYPE
#   string
#   default "LinearSelector" if SELECTOR_TYPE_LINEAR
#   default "VirtualSelector" if SELECTOR_TYPE_VIRTUAL

config VARIABLE_BOWDEN_LENGTHS
  bool "Variable bowden lengths?" 

config PARAM_VARIABLE_BOWDEN_LENGTHS
  int
  default 1 if VARIABLE_BOWDEN_LENGTHS

config VARIABLE_ROTATION_DISTANCES
  bool "Variable rotation distances?"

config PARAM_VARIABLE_ROTATION_DISTANCES
  int
  default 1 if VARIABLE_ROTATION_DISTANCES

config REQUIRE_BOWDEN_MOVE
  bool "Require bowden move?"

config PARAM_REQUIRE_BOWDEN_MOVE
  int
  default 1 if REQUIRE_BOWDEN_MOVE

config FILAMENT_ALWAYS_GRIPPED
  bool "Filament always gripped?"

config PARAM_FILAMENT_ALWAYS_GRIPPED
  int 
  default 1 if FILAMENT_ALWAYS_GRIPPED

config PARAM_ENCODER_RESOLUTION
  string "Encoder resolution"
  depends on MMU_HAS_ENCODER
  default "1.0"

config PARAM_GATE_PARKING_DISTANCE
  string "Gate parking distance (mm)"
  default "23"

config PARAM_GATE_ENDSTOP_TO_ENCODER
  string "Gate endstop to encoder distance (mm)"
  default "10"

config PARAM_GATE_HOMING_MAX
  string "Maximum homing distance to the gate (mm)"
  default "70"

config PARAM_GATE_FINAL_EJECT_DISTANCE
  string "Distance to eject filament on eject rather than unload (mm)"
  default "0"

config PARAM_GEAR_HOMING_SPEED
  string "Gear homing speed (mm/s)"
  default "50"

config HAS_BYPASS
  bool "Has bypass?"

config PARAM_HAS_BYPASS
  int
  default 1 if HAS_BYPASS
```

## scripts/Kconfig.paths_services
```kconfig
    config KLIPPER_HOME
      string "Klipper directory"
      # will be bootstrapped by Makefile. (default ~/klipper or /usr/share/klipper, depending on architecture)
      # Or can be overridden on first call with 'CONFIG_KLIPPER_HOME=/klipper/path make menuconfig'
      default "$(CONFIG_KLIPPER_HOME)"
    config PRINTER_CONFIG_FILE
      string "Printer config file"
      depends on !REPETIER
      default "printer.cfg"
    config KLIPPER_CONFIG_HOME
      string "Klipper config directory"
      default "/usr/data/printer_data/config" if IS_MIPS
      default "~" if OCTOPRINT
      default "~/printer_data/config"
    config MOONRAKER_CONFIG_FILE
      string "Moonraker config file"
      default "moonraker.conf"
    config MOONRAKER_HOME
      string "Moonraker directory"
      depends on !OCTOPRINT
      default "/usr/data/moonraker" if IS_MIPS
      default "~/moonraker"
    config HAPPY_HARE_HOME
      string "Happy Hare directory"
      default "/usr/data/Happy-Hare" if IS_MIPS
      default "$(shell,	pwd)"
    config GCODES_PATH
      string "Gcodes directory"
      default "~/printer_data/gcodes"
    config SERVICE_KLIPPER
      string "Klipper service name"
      depends on !REPETIER
      default "klipper_service" if IS_MIPS
      default "klipper.service"
    config SERVICE_MOONRAKER
      string "Moonraker service name"
      depends on !OCTOPRINT
      default "moonraker_service" if IS_MIPS
      default "moonraker.service"
    config SERVICE_OCTOPRINT
      string "Octoprint service name"
      depends on OCTOPRINT
      default "octoprint.service"
```

## scripts/Kconfig.pins
```kconfig
# This just defines the pins menu layout. To change the actual defaults create a Kconfig.board_type under the boards directory.

menu "Gear pins"
  config PIN_GEAR_UART 
    string "Gear UART pin"
  config PIN_GEAR_STEP
    string "Gear step pin"
  config PIN_GEAR_DIR
    string "Gear dir pin"
  config PIN_GEAR_ENABLE
    string "Gear enable pin"
  config PIN_GEAR_DIAG
    string "Gear diag pin"

  if PARAM_SELECTOR_TYPE = "VirtualSelector"
    if PARAM_NUM_GATES > 1 
      config PIN_GEAR_1_UART 
        string "Gear 1 UART pin"
      config PIN_GEAR_1_STEP
        string "Gear 1 step pin"
      config PIN_GEAR_1_DIR
        string "Gear 1 dir pin"
      config PIN_GEAR_1_ENABLE
        string "Gear 1 enable pin"
      config PIN_GEAR_1_DIAG
        string "Gear 1 diag pin"
    endif 

    if PARAM_NUM_GATES > 2
      config PIN_GEAR_2_UART 
        string "Gear 2 UART pin"
      config PIN_GEAR_2_STEP
        string "Gear 2 step pin"
      config PIN_GEAR_2_DIR
        string "Gear 2 dir pin"
      config PIN_GEAR_2_ENABLE
        string "Gear 2 enable pin"
      config PIN_GEAR_2_DIAG
        string "Gear 2 diag pin"
    endif

    if PARAM_NUM_GATES > 3
      config PIN_GEAR_3_UART 
        string "Gear 3 UART pin"
      config PIN_GEAR_3_STEP
        string "Gear 3 step pin"
      config PIN_GEAR_3_DIR
        string "Gear 3 dir pin"
      config PIN_GEAR_3_ENABLE
        string "Gear 3 enable pin"
      config PIN_GEAR_3_DIAG
        string "Gear 3 diag pin"
    endif
  endif
endmenu

if PARAM_SELECTOR_TYPE = "LinearSelector"
  menu "Selector pins"
    config PIN_SELECTOR_UART
      string "Selector UART pin"
    config PIN_SELECTOR_STEP
      string "Selector step pin"
    config PIN_SELECTOR_DIR
      string "Selector dir pin"
    config PIN_SELECTOR_ENABLE
      string "Selector enable pin"
    config PIN_SELECTOR_DIAG
      string "Selector diag pin"
    config PIN_SELECTOR_ENDSTOP
      string "Selector endstop pin"
    config PIN_SELECTOR_SERVO
      string "Servo pin"
  endmenu
endif

menu "Pre-gate pins"
  config PIN_PRE_GATE_0
    string "Pre-gate 0 pin"
    depends on PARAM_NUM_GATES > 0
  config PIN_PRE_GATE_1
    string "Pre-gate 1 pin"
    depends on PARAM_NUM_GATES > 1
  config PIN_PRE_GATE_2
    string "Pre-gate 2 pin"
    depends on PARAM_NUM_GATES > 2
  config PIN_PRE_GATE_3
    string "Pre-gate 3 pin"
    depends on PARAM_NUM_GATES > 3
  config PIN_PRE_GATE_4
    string "Pre-gate 4 pin"
    depends on PARAM_NUM_GATES > 4
  config PIN_PRE_GATE_5
    string "Pre-gate 5 pin"
    depends on PARAM_NUM_GATES > 5
  config PIN_PRE_GATE_6
    string "Pre-gate 6 pin"
    depends on PARAM_NUM_GATES > 6
  config PIN_PRE_GATE_7
    string "Pre-gate 7 pin"
    depends on PARAM_NUM_GATES > 7
  config PIN_PRE_GATE_8
    string "Pre-gate 8 pin"
    depends on PARAM_NUM_GATES > 8
  config PIN_PRE_GATE_9	
    string "Pre-gate 9 pin"
    depends on PARAM_NUM_GATES > 9
  config PIN_PRE_GATE_10
    string "Pre-gate 10 pin"
    depends on PARAM_NUM_GATES > 10
  config PIN_PRE_GATE_11
    string "Pre-gate 11 pin"
    depends on PARAM_NUM_GATES > 11
endmenu

menu "Gear sensor pins"
  config PIN_GEAR_SENSOR_0
    string "Gear sensor 0 pin"
    depends on PARAM_NUM_GATES > 0
  config PIN_GEAR_SENSOR_1
    string "Gear sensor 1 pin"
    depends on PARAM_NUM_GATES > 1
  config PIN_GEAR_SENSOR_2
    string "Gear sensor 2 pin"
    depends on PARAM_NUM_GATES > 2
  config PIN_GEAR_SENSOR_3
    string "Gear sensor 3 pin"
    depends on PARAM_NUM_GATES > 3
  config PIN_GEAR_SENSOR_4
    string "Gear sensor 4 pin"
    depends on PARAM_NUM_GATES > 4
  config PIN_GEAR_SENSOR_5
    string "Gear sensor 5 pin"
    depends on PARAM_NUM_GATES > 5
  config PIN_GEAR_SENSOR_6
    string "Gear sensor 6 pin"
    depends on PARAM_NUM_GATES > 6
  config PIN_GEAR_SENSOR_7
    string "Gear sensor 7 pin"
    depends on PARAM_NUM_GATES > 7
  config PIN_GEAR_SENSOR_8
    string "Gear sensor 8 pin"
    depends on PARAM_NUM_GATES > 8
  config PIN_GEAR_SENSOR_9	
    string "Gear sensor 9 pin"
    depends on PARAM_NUM_GATES > 9
  config PIN_GEAR_SENSOR_10
    string "Gear sensor 10 pin"
    depends on PARAM_NUM_GATES > 10
  config PIN_GEAR_SENSOR_11
    string "Gear sensor 11 pin"
    depends on PARAM_NUM_GATES > 11
endmenu

config PIN_ENCODER
  string "Encoder pin"
  depends on MMU_HAS_ENCODER

config PIN_NEOPIXEL
  string "Neopixel pin"

config PIN_GATE_SENSOR
  string "Gate sensor pin"
  depends on !MMU_HAS_ENCODER

config PIN_EXTRUDER_SENSOR
  string "Extruder sensor pin"

config PIN_TOOLHEAD_SENSOR
  string "Toolhead sensor pin"

config PIN_SYNC_FEEDBACK_TENSION
  string "Sync feedback tension pin"

config PIN_SYNC_FEEDBACK_COMPRESSION
  string "Sync feedback compression pin"

config PIN_GANTRY_SERVO
  string "Gantry servo pin"
```
