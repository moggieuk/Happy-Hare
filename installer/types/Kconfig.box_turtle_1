## scripts/addons/Kconfig.blobifier
```kconfig
config ADDON_BLOBIFIER
  bool "Enable Blobifier support?"

if ADDON_BLOBIFIER
  config INSTALL_BLOBIFIER
    bool "Install Blobifier include in printer.cfg?"

  menu "Blobifier pins"
    config PIN_BLOBIFIER_SERVO
      string "Blobifier servo pin"
      default "PG14"
    config PIN_BLOBIFIER_BUCKET_SWITCH
      string "Blobifier bucket switch pin, mind the pull-up!"
      default "^PG15"
  endmenu
endif
```

## scripts/addons/Kconfig.dc_espooler
```kconfig
config ADDON_DC_ESPOOLER
  bool "Enable eSpooler support?"

config PARAM_DC_ESPOOLER_START_MACRO
  string
  default "MMU_ESPOOLER_START" if ENABLE_DC_ESPOOLER_MACROS
  default ""
config PARAM_DC_ESPOOLER_STOP_MACRO
  string
  default "MMU_ESPOOLER_STOP" if ENABLE_DC_ESPOOLER_MACROS
  default ""

if ADDON_DC_ESPOOLER
  config INSTALL_DC_ESPOOLER
    bool "Install eSpooler include in printer.cfg?"
    default y

  config ENABLE_DC_ESPOOLER_MACROS
    bool "Configure eSpooler start and stop macros?"
    depends on INSTALL_DC_ESPOOLER
    default y

  config USE_ENABLE_PINS
    bool "Does your setup use enable pins for the motor drivers?"
  
  menu "eSpooler pins"
    if PARAM_NUM_GATES > 0
      config PIN_DC_ESPOOLER_0_EN
        string "eSpooler enable 0 pin"
        depends on USE_ENABLE_PINS
      config PIN_DC_ESPOOLER_0_A
        string "eSpooler rewind 0 pin"
      config PIN_DC_ESPOOLER_0_B
        string "eSpooler forward 0 pin"
    endif
  
    if PARAM_NUM_GATES > 1
      config PIN_DC_ESPOOLER_1_EN
        string "eSpooler enable 1 pin"
        depends on USE_ENABLE_PINS
      config PIN_DC_ESPOOLER_1_A
        string "eSpooler rewind 1 pin"
      config PIN_DC_ESPOOLER_1_B
        string "eSpooler forward 1 pin"
    endif
  
    if PARAM_NUM_GATES > 2
      config PIN_DC_ESPOOLER_2_EN
        string "eSpooler enable 2 pin"
        depends on USE_ENABLE_PINS
      config PIN_DC_ESPOOLER_2_A
        string "eSpooler rewind 2 pin"
      config PIN_DC_ESPOOLER_2_B
        string "eSpooler forward 2 pin"
    endif
  
    if PARAM_NUM_GATES > 3
      config PIN_DC_ESPOOLER_3_EN
        string "eSpooler enable 3 pin"
        depends on USE_ENABLE_PINS
      config PIN_DC_ESPOOLER_3_A
        string "eSpooler rewind 3 pin"
      config PIN_DC_ESPOOLER_3_B
        string "eSpooler forward 3 pin"
    endif
  endmenu
endif
```

## scripts/addons/Kconfig.erec_cutter
```kconfig
config ADDON_EREC_CUTTER
  bool "Enable EREC filament cutter support?"

if ADDON_EREC_CUTTER
  config INSTALL_EREC_CUTTER
    bool "Install EREC filament cutter include in printer.cfg?"

  menu "EREC filament cutter pins"
    config PIN_EREC_CUTTER_SERVO
      string "EREC filament cutter servo pin"
      default "mmu:PA7"
  endmenu
endif
```

## scripts/boards/Kconfig
```kconfig
rsource "Kconfig.*"

choice CHOICE_BOARD_TYPE
  prompt "Board type"
  help 
    Select the type of board you are using. This will configure the default pin layout for your setup.

  config HW_BOARD_TYPE_OTHER
    bool "Not listed / Other"
endchoice
```

## scripts/boards/Kconfig.afc_lite_1
```kconfig
choice CHOICE_BOARD_TYPE
  config BOARD_TYPE_AFC_LITE_1
    bool "AFC Lite v1.0"
endchoice

choice CHOICE_SERIAL_DEVICE
  default $(serial_config,1,stm32)
endchoice

if BOARD_TYPE_AFC_LITE_1
  config PIN_GEAR_UART 
    default "PD5" 
  config PIN_GEAR_STEP
    default "PD4" 
  config PIN_GEAR_DIR
    default "PD3" 
  config PIN_GEAR_ENABLE
    default "PD6" 
  config PIN_GEAR_DIAG
    default "PD2" 

  config PIN_GEAR_1_UART 
    default "PD0" 
  config PIN_GEAR_1_STEP
    default "PC12" 
  config PIN_GEAR_1_DIR
    default "PC11" 
  config PIN_GEAR_1_ENABLE
    default "PD1" 
  config PIN_GEAR_1_DIAG
    default "PC10" 

  config PIN_GEAR_2_UART 
    default "PE1" 
  config PIN_GEAR_2_STEP
    default "PE2" 
  config PIN_GEAR_2_DIR
    default "PE3" 
  config PIN_GEAR_2_ENABLE
    default "PE0" 
  config PIN_GEAR_2_DIAG
    default "PE4" 

  config PIN_GEAR_3_UART 
    default "PC6" 
  config PIN_GEAR_3_STEP
    default "PD15" 
  config PIN_GEAR_3_DIR
    default "PD14" 
  config PIN_GEAR_3_ENABLE
    default "PC7" 
  config PIN_GEAR_3_DIAG
    default "PC8" 

  config PIN_PRE_GATE_0
    default "PC5" 
  config PIN_PRE_GATE_1
    default "PB0" 
  config PIN_PRE_GATE_2
    default "PB1" 
  config PIN_PRE_GATE_3
    default "PB2" 

  config PIN_GEAR_SENSOR_0
    default "PE8" 
  config PIN_GEAR_SENSOR_1
    default "PE9" 
  config PIN_GEAR_SENSOR_2
    default "PE10" 
  config PIN_GEAR_SENSOR_3
    default "PE11" 

  config PIN_DC_ESPOOLER_EN_0
    default "PA2" 
  config PIN_DC_ESPOOLER_RWD_0
    default "PA0" 
  config PIN_DC_ESPOOLER_FWD_0
    default "PA1" 

  config PIN_DC_ESPOOLER_EN_1
    default "PA5" 
  config PIN_DC_ESPOOLER_RWD_1
    default "PA6" 
  config PIN_DC_ESPOOLER_FWD_1
    default "PA7" 

  config PIN_DC_ESPOOLER_EN_2
    default "PB13" 
  config PIN_DC_ESPOOLER_RWD_2
    default "PB14" 
  config PIN_DC_ESPOOLER_FWD_2
    default "PB15" 

  config PIN_DC_ESPOOLER_EN_3
    default "PD11" 
  config PIN_DC_ESPOOLER_RWD_3
    default "PD12" 
  config PIN_DC_ESPOOLER_FWD_3
    default "PD13" 

  config PIN_NEOPIXEL
    default "PE14"
  config PIN_GATE_SENSOR
    default "PC4"
endif
```

## scripts/boards/Kconfig.easy_brd_rp2040
```kconfig
choice CHOICE_BOARD_TYPE
  config BOARD_TYPE_EASY_BRD_RP2040
    bool "EASY-BRD with RP2040"
endchoice

choice CHOICE_SERIAL_DEVICE
  default $(serial_config,1,rp2040)
endchoice

if BOARD_TYPE_EASY_BRD_RP2040
  config PIN_GEAR_UART
    default "gpio6" 
  config PIN_GEAR_STEP
    default "gpio27" 
  config PIN_GEAR_DIR
    default "gpio28" 
  config PIN_GEAR_ENABLE
    default "gpio26" 

  config PIN_SELECTOR_UART
    default "gpio6" 
  config PIN_SELECTOR_STEP
    default "gpio7" 
  config PIN_SELECTOR_DIR
    default "gpio0" 
  config PIN_SELECTOR_ENABLE
    default "gpio29" 
  config PIN_SELECTOR_DIAG
    default "gpio2" if MMU_SELECTOR_TOUCH 
  config PIN_SELECTOR_ENDSTOP
    default "gpio1" if !MMU_SELECTOR_TOUCH
  config PIN_SELECTOR_SERVO
    default "gpio4" 

  config PIN_ENCODER
    default "gpio3" if MMU_HAS_ENCODER
  config PIN_GATE_SENSOR
    default "gpio3"  
endif
```

## scripts/boards/Kconfig.erb_1
```kconfig
choice CHOICE_BOARD_TYPE
  config BOARD_TYPE_ERB_1
    bool "Fysetc Burrows ERB v1"
endchoice

choice CHOICE_SERIAL_DEVICE
  default $(serial_config,1,rp2040)
endchoice

if BOARD_TYPE_ERB_1
  config PIN_GEAR_UART
    default "gpio20" 
  config PIN_GEAR_STEP
    default "gpio10" 
  config PIN_GEAR_DIR
    default "gpio9" 
  config PIN_GEAR_ENABLE
    default "gpio8"
  config PIN_GEAR_DIAG
    default "gpio13"

  config PIN_SELECTOR_UART
    default "gpio17" 
  config PIN_SELECTOR_STEP
    default "gpio16" 
  config PIN_SELECTOR_DIR
    default "gpio15" 
  config PIN_SELECTOR_ENABLE
    default "gpio14" 
  config PIN_SELECTOR_DIAG
    default "gpio19" if MMU_SELECTOR_TOUCH 
  config PIN_SELECTOR_ENDSTOP
    default "gpio24" if !MMU_SELECTOR_TOUCH
  config PIN_SELECTOR_SERVO
    default "gpio23" 

  config PIN_PRE_GATE_0
    default "gpio0"
  config PIN_PRE_GATE_1
    default "gpio1"
  config PIN_PRE_GATE_2
    default "gpio2"
  config PIN_PRE_GATE_3
    default "gpio3"
  config PIN_PRE_GATE_4
    default "gpio4"
  config PIN_PRE_GATE_5
    default "gpio5"
  config PIN_PRE_GATE_6
    default "gpio6"
  config PIN_PRE_GATE_7
    default "gpio7"
  config PIN_PRE_GATE_8
    default "gpio26"
  config PIN_PRE_GATE_9
    default "gpio27"
  config PIN_PRE_GATE_10
    default "gpio28"
  config PIN_PRE_GATE_11
    default "gpio29"

  config PIN_ENCODER
    default "gpio22" if MMU_HAS_ENCODER
  config PIN_GATE_SENSOR
    default "gpio22" if !MMU_HAS_ENCODER
  config PIN_NEOPIXEL
    default "gpio21"
endif
```

## scripts/boards/Kconfig.mellow_easy_brd_can_2
```kconfig
choice CHOICE_BOARD_TYPE
  config BOARD_TYPE_MELLOW_EASY_BRD_CAN_2
    bool "Mellow EASY-BRD v2.x (with CANbus)"
endchoice

choice CHOICE_SERIAL_DEVICE
  default $(serial_config,1,rp2040)
endchoice

if BOARD_TYPE_MELLOW_EASY_BRD_CAN_2
  config PARAM_BOARD_TYPE
    default "MELLOW-EASY-BRD-CANv2"

  config PIN_GEAR_UART
    default "gpio9" 
  config PIN_GEAR_STEP
    default "gpio7" 
  config PIN_GEAR_DIR
    default "gpio8" 
  config PIN_GEAR_ENABLE
    default "gpio6"

  config PIN_SELECTOR_UART
    default "gpio2" 
  config PIN_SELECTOR_STEP
    default "gpio4" 
  config PIN_SELECTOR_DIR
    default "gpio3" 
  config PIN_SELECTOR_ENABLE
    default "gpio5" 
  config PIN_SELECTOR_DIAG
    default "gpio20" if MMU_SELECTOR_TOUCH 
  config PIN_SELECTOR_ENDSTOP
    default "gpio20" if !MMU_SELECTOR_TOUCH
  config PIN_SELECTOR_SERVO
    default "gpio21" 

  config PIN_PRE_GATE_0
    default "gpio24"
  config PIN_PRE_GATE_1
    default "gpio22"
  config PIN_PRE_GATE_2
    default "gpio25"
  config PIN_PRE_GATE_3
    default "gpio23"
  config PIN_PRE_GATE_4
    default "gpio13"
  config PIN_PRE_GATE_5
    default "gpio26"
  config PIN_PRE_GATE_6
    default "gpio12"
  config PIN_PRE_GATE_7
    default "gpio27"
  config PIN_PRE_GATE_8
    default "gpio11"
  config PIN_PRE_GATE_9
    default "gpio28"
  config PIN_PRE_GATE_10
    default "gpio10"
  config PIN_PRE_GATE_11
    default "gpio29"

  config PIN_ENCODER
    default "gpio15" if MMU_HAS_ENCODER
  config PIN_GATE_SENSOR
    default "gpio15" if !MMU_HAS_ENCODER
  config PIN_NEOPIXEL
    default "gpio14"
endif
```
