## installer/sensors/Kconfig.extruder
```kconfig
config MMU_HAS_SENSOR_EXTRUDER
  bool "Has extruder (entry) sensor?"
  help
    Select if you have a filament sensor at or just prior to
    the extruder entry. This is normally connected to a pin on your main
    printer MCU so specify it here.
  
config PIN_EXTRUDER_SENSOR
  prompt "Extruder sensor pin" if MMU_HAS_SENSOR_EXTRUDER
  help
    Can also be set under \"Pins\" section
```

## installer/sensors/Kconfig.gear_touch
```kconfig
config MMU_HAS_SENSOR_GEAR_TOUCH
  bool "Configure gear \"touch\" sensor?"
  help
    Select if you have a TMC driver with DIAG pin available and
    wish to configure gear "touch" homing. This can be used to
    detect filament collisions with the extruder.

    CAUTION: this requires careful stallguard tuning and not
    recommended for first time setups.
```

## installer/sensors/Kconfig.shared_exit
```kconfig
config MMU_HAS_SENSOR_SHARED_EXIT
  bool "Gate sensor (aka hub sensor)"
  help
    Select if you have a sensor that is shared by all gates
    at the start of the bowden near the MMU. This is often called
    a hub sensor for type-B designs.
```

## installer/sensors/Kconfig.sync_feedback
```kconfig
# Responsible for setting:
#   MMU_HAS_SENSOR_SYNC_FEEDBACK_COMPRESSION
#   MMU_HAS_SENSOR_SYNC_FEEDBACK_TENSION

if MMU_HAS_SYNC_FEEDBACK_BUFFER
  config MMU_HAS_SENSOR_SYNC_FEEDBACK_COMPRESSION
    bool "Sync-Feedback Compression sensor (aka buffer out)?"
    default y
    help
      A sync-feedback sensor (often referred to as a "buffer") is
      a sensor that can detect filament compression and/or tension.
      Select this option if your sensor can detect filament being
      COMPRESSED in the bowden tube.

      This sensor allows the MMU gear stepper to be synchronized with
      the extruder and can be used to detect collision of the filament
      with the extruder.

  config MMU_HAS_SENSOR_SYNC_FEEDBACK_TENSION
    bool "Sync-Feedback Tension sensor (aka buffer in)?"
    default y
    help
      A sync-feedback sensor (often referred to as a "buffer") is
      a sensor that can detect filament compression and/or tension.
      Select this option if your sensor can detect filament being
      UNDER TENSION in the bowden tube.

      This sensor allows the MMU gear stepper to be synchronized with
      the extruder.
endif
```

## installer/sensors/Kconfig.toolhead
```kconfig
config MMU_HAS_SENSOR_TOOLHEAD
  bool "Has toolhead sensor?"
  help
    Select if you have a filament sensor inside of your toolhead after
    the extruder drive. This is normally connected to a pin on your main
    printer MCU so specify it here.

config PIN_TOOLHEAD_SENSOR
  prompt "Extruder sensor pin" if MMU_HAS_SENSOR_TOOLHEAD
  help
    Can also be set under \"Pins\" section
```

## installer/servos/Kconfig.ds041mg
```kconfig
# Savox GDW_DS041MG servo
# Used by ERCF v1.1, v2.0

choice CHOICE_SERVO_TYPE 
  if PARAM_MMU_VENDOR = "ERCF"
    config SERVO_TYPE_GDW_DS041MG
      bool "GDW DS041MG"
  endif
endchoice

if SERVO_TYPE_GDW_DS041MG
  config PARAM_SERVO_MIN_PULSE_WIDTH
    default "0.00050"

  config PARAM_SERVO_MAX_PULSE_WIDTH
    default "0.00250" 

  config PARAM_SERVO_MAX_ANGLE
    default 180

  config PARAM_SERVO_UP_ANGLE
    default 30 

  config PARAM_SERVO_MOVE_ANGLE
    default 50 if MMU_TYPE_ERCF_2_0
    default PARAM_SERVO_UP_ANGLE 

  config PARAM_SERVO_DOWN_ANGLE
    default 100 

  config PARAM_SERVO_ALWAYS_ACTIVE
    default 1
endif
```

## installer/servos/Kconfig.es3004
```kconfig
# Emax ES3004 Servo
# Used by PicoMMU

if PARAM_MMU_VENDOR = "PicoMMU"
  config SERVO_TYPE_EMAX_ES3004
    bool "Emax ES3004"

  if SERVO_TYPE_EMAX_ES3004
    config PARAM_SERVO_MIN_PULSE_WIDTH
      default "0.00070"

    config PARAM_SERVO_MAX_PULSE_WIDTH
      default "0.00230" 

    config PARAM_SERVO_MAX_ANGLE
      default 140

    config PARAM_SERVO_ALWAYS_ACTIVE
      default 0

    config PARAM_SERVO_DURATION
      default "0.6"

    config PARAM_SERVO_DWELL
      default "1.2"
  endif
endif
```

## installer/servos/Kconfig.ft1117m
```kconfig
# Feetech FT1117M servo
# Used by Tradrack v1.0

if PARAM_MMU_VENDOR = "Tradrack"
  config SERVO_TYPE_FEETECH_FT1117M
    bool "Feetech FT1117M"

  if SERVO_TYPE_FEETECH_FT1117M
    config PARAM_SERVO_MIN_PULSE_WIDTH
      default "0.00070"

    config PARAM_SERVO_MAX_PULSE_WIDTH
      default "0.00220" 

    config PARAM_SERVO_MAX_ANGLE
      default 131

    config PARAM_SERVO_UP_ANGLE
      default 145 

    config PARAM_SERVO_DOWN_ANGLE
      default 1 
  endif
endif
```

## installer/servos/Kconfig.mg90s
```kconfig
# Savox MG-90S servo
# Used by ERCF v1.1, v2.0

choice CHOICE_SERVO_TYPE 
  if PARAM_MMU_VENDOR = "ERCF"
    config SERVO_TYPE_MG_90S
      bool "MG-90S"
  endif
endchoice

if SERVO_TYPE_MG_90S 
  config PARAM_SERVO_MIN_PULSE_WIDTH
    default "0.00085"

  config PARAM_SERVO_MAX_PULSE_WIDTH
    default "0.00240"

  config PARAM_SERVO_MAX_ANGLE
    default 180

  config PARAM_SERVO_UP_ANGLE
    default 60 if MMU_TYPE_ERCF_2_0 && MOD_THUMPER_BLOCKS
    default 30 

  config PARAM_SERVO_MOVE_ANGLE
    default 30 if MMU_TYPE_ERCF_2_0 && MOD_THUMPER_BLOCKS
    default 61 if MMU_TYPE_ERCF_2_0
    default PARAM_SERVO_UP_ANGLE 

  config PARAM_SERVO_DOWN_ANGLE
    default 145 if MMU_TYPE_ERCF_2_0 && MOD_THUMPER_BLOCKS
    default 140 
endif
```

## installer/servos/Kconfig.mg996r
```kconfig
# MG-996R servo
# Used by PicoMMU and MMX as RotarySelector

if PARAM_VENDOR = "MMX" || PARAM_VENDOR = "PicoMMU"
  config SERVO_TYPE_MG_996R
    bool "MG-996R"

  if SERVO_TYPE_MG_996R
    config PARAM_SERVO_MIN_PULSE_WIDTH
      default "0.00070"

    config PARAM_SERVO_MAX_PULSE_WIDTH
      default "0.00230"

    config PARAM_SERVO_MAX_ANGLE
      default 180

    config PARAM_SERVO_DURATION
      default "0.6"

    config PARAM_SERVO_DWELL
      default "1.0"

    if PARAM_VENDOR = "MMX"
      config PARAM_SELECTOR_GATE_ANGLES
        string
        default "45, 90, 135, 180"
    endif
  endif
endif
```

## installer/servos/Kconfig.ps1171mg
```kconfig
# JX PS-1171MG servo
# Used by Tradrack v1.0

if PARAM_MMU_VENDOR = "Tradrack"
  config SERVO_TYPE_JX_PS1171MG
    bool "JX PS-1171MG"

  if SERVO_TYPE_JX_PS1171MG
    config PARAM_SERVO_MIN_PULSE_WIDTH
      default "0.00070"

    config PARAM_SERVO_MAX_PULSE_WIDTH
      default "0.00220" 

    config PARAM_SERVO_MAX_ANGLE
      default 131

    config PARAM_SERVO_UP_ANGLE
      default 145 

    config PARAM_SERVO_DOWN_ANGLE
      default 1 
  endif
endif
```

## installer/servos/Kconfig.sh0225mg
```kconfig
# Savox SH-0255MG servo
# Used by ERCF v1.0, v2.0, v3.0

if PARAM_VENDOR = "ERCF"
  config SERVO_TYPE_SAVOX_SH0255MG
    bool "Savox SH-0255MG"

  if SERVO_TYPE_SAVOX_SH0255MG 
    config PARAM_SERVO_MIN_PULSE_WIDTH
      default "0.00085"

    config PARAM_SERVO_MAX_PULSE_WIDTH
      default "0.00240" 

    config PARAM_SERVO_MAX_ANGLE
      default 180

    config PARAM_SERVO_UP_ANGLE
      default 120 if MMU_TYPE_ERCF_2_0 && MOD_THUMPER_BLOCKS
      default 140 

    config PARAM_SERVO_MOVE_ANGLE
      default 135 if MMU_TYPE_ERCF_2_0 && MOD_THUMPER_BLOCKS
      default 109 if MMU_TYPE_ERCF_2_0 || MMU_TYPE_ERCF_3_0
      default PARAM_SERVO_UP_ANGLE

    config PARAM_SERVO_DOWN_ANGLE
      default 50 if MMU_TYPE_ERCF_2_0 && MOD_THUMPER_BLOCKS
      default 30 
  endif
endif
```

## installer/servos/Kconfig.tradrack
```kconfig
if PARAM_MMU_VENDOR = "Tradrack"
  choice CHOICE_SERVO_TYPE 
    config SERVO_TYPE_TRADRACK
      bool "PS-1171MG or FT1117M (Tradrack)"
  endchoice
endif

if SERVO_TYPE_TRADRACK
  config PARAM_SERVO_MIN_PULSE_WIDTH
    default "0.00070"
  config PARAM_SERVO_MAX_PULSE_WIDTH
    default "0.00220" 
  config PARAM_SERVO_MAX_ANGLE
    default 131
  config PARAM_SERVO_UP_ANGLE
    default 145 
  config PARAM_SERVO_MOVE_ANGLE
    default PARAM_SERVO_UP_ANGLE
  config PARAM_SERVO_DOWN_ANGLE
    default 1 
endif
```

## installer/toolheads/Kconfig
```kconfig
# This module's purpose is to set the toolhead type and defaults for
# associated dimensional parameters:
#
#   MMU_SHARED_TOOLHEAD - Currently not dynamically set (see gen-kconfig-options idea in build.py)
#
#   PARAM_TOOLHEAD_TYPE
#   PARAM_TOOLHEAD
#   PARAM_TOOLHEAD_EXTRUDER_TO_NOZZLE
#   PARAM_TOOLHEAD_SENSOR_TO_NOZZLE
#   PARAM_TOOLHEAD_ENTRY_TO_EXTRUDER
#   PARAM_TOOLHEAD_RESIDUAL_FILAMENT
#

config PARAM_TOOLHEAD_TYPE
  string

config PARAM_TOOLHEAD
  string
  default "default"

config MMU_SHARED_TOOLHEAD
  bool
  default n

choice TOOLHEAD_TYPE
  prompt "Toolhead"
  default CHOICE_TOOLHEAD_TYPE_OTHER
  help 
    Toolhead type (extruder and hotend combo)
    If your toolhead appears in this list you are lucky and can benefit from tuned values
    from others. It is still recommended you learn how to measure and calibrate your own
    because of the number of modifications and versions of hardware. If you are unsure,
    just select the default and perform calibration as described in the wiki

  rsource "Kconfig.*"

  config CHOICE_TOOLHEAD_TYPE_OTHER
    bool "Other/Unknown requiring calibration"

  if CHOICE_TOOLHEAD_TYPE_OTHER
    config PARAM_TOOLHEAD_TYPE
      default "Other/Unknown"
    config PARAM_TOOLHEAD_EXTRUDER_TO_NOZZLE
      default "72"
    config PARAM_TOOLHEAD_SENSOR_TO_NOZZLE
      default "62"
    config PARAM_TOOLHEAD_ENTRY_TO_EXTRUDER
      default "8"
    config PARAM_TOOLHEAD_RESIDUAL_FILAMENT
      default "2"
  endif
endchoice
```

## installer/toolheads/Kconfig.a4t_wristwatch_bmg_rapido2_plus_hf
```kconfig
config TOOLHEAD_TYPE_A4T_WRISTWATCH_BMG_RAPIDO2_PLUS_HF
  bool "A4T Wristwatch BMG Rapido2 Plus HF"

if TOOLHEAD_TYPE_A4T_WRISTWATCH_BMG_RAPIDO2_PLUS_HF
  config PARAM_TOOLHEAD_TYPE
    default "A4T Wristwatch BMG Rapido2 Plus HF"
  config PARAM_TOOLHEAD_EXTRUDER_TO_NOZZLE
    default "88.5"
  config PARAM_TOOLHEAD_SENSOR_TO_NOZZLE
    default "77"
  config PARAM_TOOLHEAD_ENTRY_TO_EXTRUDER
    default "9.7"
  config PARAM_TOOLHEAD_RESIDUAL_FILAMENT
    default "20.0"
endif
```

## installer/toolheads/Kconfig.a4t_wwbmg_bambu_tz3
```kconfig
config TOOLHEAD_TYPE_A4T_WWBMG_BAMBU_TZ3
  bool "A4T WWBMG Bambu TZ3"

if TOOLHEAD_TYPE_A4T_WWBMG_BAMBU_TZ3
  config PARAM_TOOLHEAD_TYPE
    default "A4T WWBMG Bambu TZ3"
  config PARAM_TOOLHEAD_EXTRUDER_TO_NOZZLE
    default 79.3
  config PARAM_TOOLHEAD_SENSOR_TO_NOZZLE
    default 68
  config PARAM_TOOLHEAD_ENTRY_TO_EXTRUDER
    default 9
  config PARAM_TOOLHEAD_RESIDUAL_FILAMENT
    default 0
endif
```

## installer/toolheads/Kconfig.a4t_wwbmg_dragon_ace_volcano_mze
```kconfig
config TOOLHEAD_TYPE_A4T_WWBMG_DRAGON_ACE_VOLCANO_MZE
  bool "A4T WWBMG Dragon Ace Volcano MZE"

if TOOLHEAD_TYPE_A4T_WWBMG_DRAGON_ACE_VOLCANO_MZE
  config PARAM_TOOLHEAD_TYPE
    default "A4T WWBMG Dragon Ace Volcano MZE"
  config PARAM_TOOLHEAD_EXTRUDER_TO_NOZZLE
    default "89.5"
  config PARAM_TOOLHEAD_SENSOR_TO_NOZZLE
    default "76.5"
  config PARAM_TOOLHEAD_ENTRY_TO_EXTRUDER
    default "9"
  config PARAM_TOOLHEAD_RESIDUAL_FILAMENT
    default "44.9"
endif
```

## installer/toolheads/Kconfig.a4t_wwbmg_dragon_hf_mze
```kconfig
config TOOLHEAD_TYPE_A4T_WWBMG_DRAGON_HF_MZE
  bool "A4T WWBMG Dragon HF MZE"

if TOOLHEAD_TYPE_A4T_WWBMG_DRAGON_HF_MZE
  config PARAM_TOOLHEAD_TYPE
    default "A4T WWBMG Dragon HF MZE"
  config PARAM_TOOLHEAD_EXTRUDER_TO_NOZZLE
    default 66.4
  config PARAM_TOOLHEAD_SENSOR_TO_NOZZLE
    default 54.1
  config PARAM_TOOLHEAD_ENTRY_TO_EXTRUDER
    default 9.3
  config PARAM_TOOLHEAD_RESIDUAL_FILAMENT
    default 28.0
endif
```

## installer/toolheads/Kconfig.a4t_wwbmg_for_a4t_dragon_ace
```kconfig
config TOOLHEAD_TYPE_A4T_WWBMG_FOR_A4T_DRAGON_ACE
  bool "A4T WWBMG for A4T Dragon Ace"

if TOOLHEAD_TYPE_A4T_WWBMG_FOR_A4T_DRAGON_ACE
  config PARAM_TOOLHEAD_TYPE
    default "A4T WWBMG for A4T Dragon Ace"
  config PARAM_TOOLHEAD_EXTRUDER_TO_NOZZLE
    default "88"
  config PARAM_TOOLHEAD_SENSOR_TO_NOZZLE
    default "76.5"
  config PARAM_TOOLHEAD_ENTRY_TO_EXTRUDER
    default "9.5"
  config PARAM_TOOLHEAD_RESIDUAL_FILAMENT
    default "2"
endif
```

## installer/toolheads/Kconfig.a4t_wwbmg_rapido2_plus_hf
```kconfig
config TOOLHEAD_TYPE_A4T_WWBMG_RAPIDO2_PLUS_HF
  bool "A4T WWBMG Rapido2 Plus HF"

if TOOLHEAD_TYPE_A4T_WWBMG_RAPIDO2_PLUS_HF
  config PARAM_TOOLHEAD_TYPE
    default "A4T WWBMG Rapido2 Plus HF"
  config PARAM_TOOLHEAD_EXTRUDER_TO_NOZZLE
    default 88.5
  config PARAM_TOOLHEAD_SENSOR_TO_NOZZLE
    default 77
  config PARAM_TOOLHEAD_ENTRY_TO_EXTRUDER
    default 9.7
  config PARAM_TOOLHEAD_RESIDUAL_FILAMENT
    default 20.0
endif
```

## installer/toolheads/Kconfig.a4t_wwbmg_revo_voron
```kconfig
config TOOLHEAD_TYPE_A4T_WWBMG_REVO_VORON
  bool "A4T WWBMG Revo Voron"

if TOOLHEAD_TYPE_A4T_WWBMG_REVO_VORON
  config PARAM_TOOLHEAD_TYPE
    default "A4T WWBMG Revo Voron"
  config PARAM_TOOLHEAD_EXTRUDER_TO_NOZZLE
    default "82.6"
  config PARAM_TOOLHEAD_SENSOR_TO_NOZZLE
    default "69.5"
  config PARAM_TOOLHEAD_ENTRY_TO_EXTRUDER
    default "9.7"
  config PARAM_TOOLHEAD_RESIDUAL_FILAMENT
    default "9.0"
endif
```

## installer/toolheads/Kconfig.a4t_wwg2_dragon_hf_mze
```kconfig
config TOOLHEAD_TYPE_A4T_WWG2_DRAGON_HF_MZE
  bool "A4T WWG2 Dragon HF MZE"

if TOOLHEAD_TYPE_A4T_WWG2_DRAGON_HF_MZE
  config PARAM_TOOLHEAD_TYPE
    default "A4T WWG2 Dragon HF MZE"
  config PARAM_TOOLHEAD_EXTRUDER_TO_NOZZLE
    default "96.1"
  config PARAM_TOOLHEAD_SENSOR_TO_NOZZLE
    default "77.6"
  config PARAM_TOOLHEAD_ENTRY_TO_EXTRUDER
    default "13.2"
  config PARAM_TOOLHEAD_RESIDUAL_FILAMENT
    default "34.7"
endif
```

## installer/toolheads/Kconfig.ab_clockwork_dragon_hf
```kconfig
config TOOLHEAD_TYPE_AFTERBURNER_CLOCKWORK_DRAGON_HF
  bool "Afterburner Clockwork Dragon HF"


if TOOLHEAD_TYPE_AFTERBURNER_CLOCKWORK_DRAGON_HF

  config PARAM_TOOLHEAD_TYPE
    default "Afterburner Clockwork Dragon HF"

  config PARAM_TOOLHEAD_EXTRUDER_TO_NOZZLE
    default "98.7"

  config PARAM_TOOLHEAD_SENSOR_TO_NOZZLE
    default "83.7"

  config PARAM_TOOLHEAD_ENTRY_TO_EXTRUDER
    default "6.7"

  config PARAM_TOOLHEAD_RESIDUAL_FILAMENT
    default "5"
  
endif
```

## installer/toolheads/Kconfig.ab_clockwork_revo
```kconfig
config TOOLHEAD_TYPE_AFTERBURNER_CLOCKWORK_REVO
  bool "Afterburner Clockwork Revo"


if TOOLHEAD_TYPE_AFTERBURNER_CLOCKWORK_REVO

  config PARAM_TOOLHEAD_TYPE
    default "Afterburner Clockwork Revo"

  config PARAM_TOOLHEAD_EXTRUDER_TO_NOZZLE
    default "72"

  config PARAM_TOOLHEAD_SENSOR_TO_NOZZLE
    default "62"

  config PARAM_TOOLHEAD_ENTRY_TO_EXTRUDER
    default "8"

  config PARAM_TOOLHEAD_RESIDUAL_FILAMENT
    default "4"
  
endif
```

## installer/toolheads/Kconfig.afterburner_clockwork_dragon_hf
```kconfig
config TOOLHEAD_TYPE_AFTERBURNER_CLOCKWORK_DRAGON_HF
  bool "Afterburner Clockwork Dragon HF"

if TOOLHEAD_TYPE_AFTERBURNER_CLOCKWORK_DRAGON_HF
  config PARAM_TOOLHEAD_TYPE
    default "Afterburner Clockwork Dragon HF"
  config PARAM_TOOLHEAD_EXTRUDER_TO_NOZZLE
    default "76.8"
  config PARAM_TOOLHEAD_SENSOR_TO_NOZZLE
    default "67.7"
  config PARAM_TOOLHEAD_ENTRY_TO_EXTRUDER
    default "8"
  config PARAM_TOOLHEAD_RESIDUAL_FILAMENT
    default "22.3"
endif
```
