## installer/toolheads/Kconfig.anthead_wwbmg_rapido2_hf
```kconfig
config TOOLHEAD_TYPE_ANTHEAD_WWBMG_RAPIDO2_HF
  bool "Anthead WWBMG Rapido 2 HF"


if TOOLHEAD_TYPE_ANTHEAD_WWBMG_RAPIDO2_HF

  config PARAM_TOOLHEAD_TYPE
    default "Anthead WWBMG Rapido 2 HF"

  config PARAM_TOOLHEAD_EXTRUDER_TO_NOZZLE
    default "98.7"

  config PARAM_TOOLHEAD_SENSOR_TO_NOZZLE
    default "83.7"

  config PARAM_TOOLHEAD_ENTRY_TO_EXTRUDER
    default "6.7"

  config PARAM_TOOLHEAD_RESIDUAL_FILAMENT
    default "5"

endif
```

## installer/toolheads/Kconfig.anthead_wwbmg_rapido_2_hf
```kconfig
config TOOLHEAD_TYPE_ANTHEAD_WWBMG_RAPIDO_2_HF
  bool "AntHead WWBMG Rapido 2 HF"
if TOOLHEAD_TYPE_ANTHEAD_WWBMG_RAPIDO_2_HF
  config PARAM_TOOLHEAD_TYPE
    default "AntHead WWBMG Rapido 2 HF"
  config PARAM_TOOLHEAD_EXTRUDER_TO_NOZZLE
    default "98.672"
  config PARAM_TOOLHEAD_SENSOR_TO_NOZZLE
    default "83.860"
  config PARAM_TOOLHEAD_ENTRY_TO_EXTRUDER
    default "6.716"
endif
```

## installer/toolheads/Kconfig.anthead_wwg2_revo_voron
```kconfig
config TOOLHEAD_TYPE_ANTHEAD_WWG2_REVO_VORON
  bool "AntHead WWG2 Revo Voron"

if TOOLHEAD_TYPE_ANTHEAD_WWG2_REVO_VORON
  config PARAM_TOOLHEAD_TYPE
    default "AntHead WWG2 Revo Voron"
  config PARAM_TOOLHEAD_EXTRUDER_TO_NOZZLE
    default "91"
  config PARAM_TOOLHEAD_SENSOR_TO_NOZZLE
    default "75"
  config PARAM_TOOLHEAD_ENTRY_TO_EXTRUDER
    default "13.6"
  config PARAM_TOOLHEAD_RESIDUAL_FILAMENT
    default "9"
endif
```

## installer/toolheads/Kconfig.anthead_wwg2_tzv6
```kconfig
config TOOLHEAD_TYPE_ANTHEAD_WWG2_TZV6
  bool "AntHead WWG2 TZv6"

if TOOLHEAD_TYPE_ANTHEAD_WWG2_TZV6
  config PARAM_TOOLHEAD_TYPE
    default "AntHead WWG2 TZv6"
  config PARAM_TOOLHEAD_EXTRUDER_TO_NOZZLE
    default "68.6"
  config PARAM_TOOLHEAD_SENSOR_TO_NOZZLE
    default "50.9"
  config PARAM_TOOLHEAD_ENTRY_TO_EXTRUDER
    default "13"
  config PARAM_TOOLHEAD_RESIDUAL_FILAMENT
    default "1.2"
endif
```

## installer/toolheads/Kconfig.diploduct_bmg_ender_3_v2
```kconfig
config TOOLHEAD_TYPE_DIPLODUCT_BMG_ENDER_3_V2
  bool "Diploduct BMG Ender 3 V2"

if TOOLHEAD_TYPE_DIPLODUCT_BMG_ENDER_3_V2
  config PARAM_TOOLHEAD_TYPE
    default "Diploduct BMG Ender 3 V2"
  config PARAM_TOOLHEAD_EXTRUDER_TO_NOZZLE
    default "106.82"
  config PARAM_TOOLHEAD_SENSOR_TO_NOZZLE
    default "62"
  config PARAM_TOOLHEAD_ENTRY_TO_EXTRUDER
    default "8"
  config PARAM_TOOLHEAD_RESIDUAL_FILAMENT
    default "2"
endif
```

## installer/toolheads/Kconfig.e34m1_sherpa_mini_alps_v6
```kconfig
config TOOLHEAD_TYPE_E34M1_SHERPA_MINI_ALPS_V6
  bool "E34M1 Sherpa Mini Alps v6"

if TOOLHEAD_TYPE_E34M1_SHERPA_MINI_ALPS_V6
  config PARAM_TOOLHEAD_TYPE
    default "E34M1 Sherpa Mini Alps v6"
  config PARAM_TOOLHEAD_EXTRUDER_TO_NOZZLE
    default "72"
  config PARAM_TOOLHEAD_SENSOR_TO_NOZZLE
    default "62"
  config PARAM_TOOLHEAD_ENTRY_TO_EXTRUDER
    default "8"
  config PARAM_TOOLHEAD_RESIDUAL_FILAMENT
    default "0"
endif
```

## installer/toolheads/Kconfig.ender3_v3_ke
```kconfig
config TOOLHEAD_TYPE_ENDER3_V3_KE
  bool "Ender3 V3 KE"

if TOOLHEAD_TYPE_ENDER3_V3_KE
  config PARAM_TOOLHEAD_TYPE
    default "Ender3 V3 KE"
  config PARAM_TOOLHEAD_EXTRUDER_TO_NOZZLE
    default "90"
  config PARAM_TOOLHEAD_SENSOR_TO_NOZZLE
    default "62"
  config PARAM_TOOLHEAD_ENTRY_TO_EXTRUDER
    default "29"
  config PARAM_TOOLHEAD_RESIDUAL_FILAMENT
    default "2"
endif
```

## installer/toolheads/Kconfig.jabberwocky
```kconfig
config TOOLHEAD_TYPE_JABBERWOCKY
  bool "Jabberwocky"

if TOOLHEAD_TYPE_JABBERWOCKY
  config PARAM_TOOLHEAD_TYPE
    default "Jabberwocky"
  config PARAM_TOOLHEAD_EXTRUDER_TO_NOZZLE
    default "86"
  config PARAM_TOOLHEAD_SENSOR_TO_NOZZLE
    default "74.3"
  config PARAM_TOOLHEAD_ENTRY_TO_EXTRUDER
    default "8.9"
  config PARAM_TOOLHEAD_RESIDUAL_FILAMENT
    default "22.5"
endif
```

## installer/toolheads/Kconfig.other
```kconfig
config TOOLHEAD_TYPE_OTHER
  bool "Other/Unknown requiring calibration"


if TOOLHEAD_TYPE_OTHER

  config PARAM_TOOLHEAD_TYPE
    default "Other/Unknown"

  config PARAM_TOOLHEAD_EXTRUDER_TO_NOZZLE
    default "72"

  config PARAM_TOOLHEAD_SENSOR_TO_NOZZLE
    default "62"

  config PARAM_TOOLHEAD_ENTRY_TO_EXTRUDER
    default "8"

  config PARAM_TOOLHEAD_RESIDUAL_FILAMENT
    default "0"
  
endif
```

## installer/toolheads/Kconfig.qidi_q1_pro
```kconfig
config TOOLHEAD_TYPE_QIDI_Q1_PRO
  bool "QIDI Q1 Pro"

if TOOLHEAD_TYPE_QIDI_Q1_PRO
  config PARAM_TOOLHEAD_TYPE
    default "QIDI Q1 Pro"
  config PARAM_TOOLHEAD_EXTRUDER_TO_NOZZLE
    default "75"
  config PARAM_TOOLHEAD_SENSOR_TO_NOZZLE
    default "78"
  config PARAM_TOOLHEAD_ENTRY_TO_EXTRUDER
    default "24"
  config PARAM_TOOLHEAD_RESIDUAL_FILAMENT
    default "2"
endif
```

## installer/toolheads/Kconfig.sb_cw2_revo
```kconfig
config TOOLHEAD_TYPE_STEALTHBURNER_CW2_REVO
  bool "Stealthburner CW2 Revo"


if TOOLHEAD_TYPE_STEALTHBURNER_CW2_REVO

  config PARAM_TOOLHEAD_TYPE
    default "Stealthburner CW2 Revo"

  config PARAM_TOOLHEAD_EXTRUDER_TO_NOZZLE
    default "72"

  config PARAM_TOOLHEAD_SENSOR_TO_NOZZLE
    default "62"

  config PARAM_TOOLHEAD_ENTRY_TO_EXTRUDER
    default "8"

  config PARAM_TOOLHEAD_RESIDUAL_FILAMENT
    default "4"
  
endif
```

## installer/toolheads/Kconfig.stealthburner_clockwork2_dragon_hf
```kconfig
config TOOLHEAD_TYPE_STEALTHBURNER_CLOCKWORK2_DRAGON_HF
  bool "Stealthburner Clockwork2 Dragon HF"

if TOOLHEAD_TYPE_STEALTHBURNER_CLOCKWORK2_DRAGON_HF
  config PARAM_TOOLHEAD_TYPE
    default "Stealthburner Clockwork2 Dragon HF"
  config PARAM_TOOLHEAD_EXTRUDER_TO_NOZZLE
    default "70.3"
  config PARAM_TOOLHEAD_SENSOR_TO_NOZZLE
    default "62.2"
  config PARAM_TOOLHEAD_ENTRY_TO_EXTRUDER
    default "12.4"
  config PARAM_TOOLHEAD_RESIDUAL_FILAMENT
    default "30.6"
endif
```

## installer/toolheads/Kconfig.stealthburner_clockwork2_rapido
```kconfig
config CHOICE_TOOLHEAD_TYPE_STEALTHBURNER_CLOCKWORK2_RAPIDO
  bool "Stealthburner Clockwork2 Rapido"

if CHOICE_TOOLHEAD_TYPE_STEALTHBURNER_CLOCKWORK2_RAPIDO
  config PARAM_TOOLHEAD_TYPE
    default "Stealthburner Clockwork2 Rapido"
  config PARAM_TOOLHEAD_EXTRUDER_TO_NOZZLE
    default "84.82"
  config PARAM_TOOLHEAD_SENSOR_TO_NOZZLE
    default "74.84"
  config PARAM_TOOLHEAD_ENTRY_TO_EXTRUDER
    default "13"
  config PARAM_TOOLHEAD_RESIDUAL_FILAMENT
    default "5"
endif
```

## installer/toolheads/Kconfig.stealthburner_clockwork2_rapido_hf
```kconfig
config TOOLHEAD_TYPE_STEALTHBURNER_CLOCKWORK2_RAPIDO_HF
  bool "Stealthburner Clockwork2 Rapido HF"

if TOOLHEAD_TYPE_STEALTHBURNER_CLOCKWORK2_RAPIDO_HF
  config PARAM_TOOLHEAD_TYPE
    default "Stealthburner Clockwork2 Rapido HF"
  config PARAM_TOOLHEAD_EXTRUDER_TO_NOZZLE
    default "84.82"
  config PARAM_TOOLHEAD_SENSOR_TO_NOZZLE
    default "74.84"
  config PARAM_TOOLHEAD_ENTRY_TO_EXTRUDER
    default "13"
  config PARAM_TOOLHEAD_RESIDUAL_FILAMENT
    default "5"
endif
```

## installer/toolheads/Kconfig.stealthburner_clockwork2_revo
```kconfig
config CHOICE_TOOLHEAD_TYPE_STEALTHBURNER_CLOCKWORK2_REVO
  bool "Stealthburner Clockwork2 Revo"

if CHOICE_TOOLHEAD_TYPE_STEALTHBURNER_CLOCKWORK2_REVO
  config PARAM_TOOLHEAD_TYPE
    default "Stealthburner Clockwork2 Revo"
  config PARAM_TOOLHEAD_EXTRUDER_TO_NOZZLE
    default "72.2"
  config PARAM_TOOLHEAD_SENSOR_TO_NOZZLE
    default "63.1"
  config PARAM_TOOLHEAD_ENTRY_TO_EXTRUDER
    default "13"
  config PARAM_TOOLHEAD_RESIDUAL_FILAMENT
    default "2.6"
endif
```

## installer/toolheads/Kconfig.stealthburner_clockwork2_revo_voron
```kconfig
config TOOLHEAD_TYPE_STEALTHBURNER_CLOCKWORK2_REVO_VORON
  bool "Stealthburner Clockwork2 Revo Voron"

if TOOLHEAD_TYPE_STEALTHBURNER_CLOCKWORK2_REVO_VORON
  config PARAM_TOOLHEAD_TYPE
    default "Stealthburner Clockwork2 Revo Voron"
  config PARAM_TOOLHEAD_EXTRUDER_TO_NOZZLE
    default "85.1"
  config PARAM_TOOLHEAD_SENSOR_TO_NOZZLE
    default "75.8"
  config PARAM_TOOLHEAD_ENTRY_TO_EXTRUDER
    default "16.6"
  config PARAM_TOOLHEAD_RESIDUAL_FILAMENT
    default "2"
endif
```

## installer/toolheads/Kconfig.stealthburner_g2e_dragon_hf
```kconfig
config TOOLHEAD_TYPE_STEALTHBURNER_G2E_DRAGON_HF
  bool "Stealthburner G2E Dragon HF"
if TOOLHEAD_TYPE_STEALTHBURNER_G2E_DRAGON_HF
  config PARAM_TOOLHEAD_TYPE
    default "Stealthburner G2E Dragon HF"
  config PARAM_TOOLHEAD_EXTRUDER_TO_NOZZLE
    default "99.5"
  config PARAM_TOOLHEAD_SENSOR_TO_NOZZLE
    default "79"
  config PARAM_TOOLHEAD_ENTRY_TO_EXTRUDER
    default "13.29"
endif
```

## installer/toolheads/Kconfig.stealthburner_g2e_rapido
```kconfig
config TOOLHEAD_TYPE_STEALTHBURNER_G2E_RAPIDO
  bool "Stealthburner G2E Rapido"
if TOOLHEAD_TYPE_STEALTHBURNER_G2E_RAPIDO
  config PARAM_TOOLHEAD_TYPE
    default "Stealthburner G2E Rapido"
  config PARAM_TOOLHEAD_EXTRUDER_TO_NOZZLE
    default "99.38"
  config PARAM_TOOLHEAD_SENSOR_TO_NOZZLE
    default "79.78"
  config PARAM_TOOLHEAD_ENTRY_TO_EXTRUDER
    default "13.29"
endif
```

## installer/toolheads/Kconfig.stealthburner_g2e_rapido_hf
```kconfig
config TOOLHEAD_TYPE_STEALTHBURNER_G2E_RAPIDO_HF
  bool "Stealthburner G2E Rapido HF"

if TOOLHEAD_TYPE_STEALTHBURNER_G2E_RAPIDO_HF
  config PARAM_TOOLHEAD_TYPE
    default "Stealthburner G2E Rapido HF"
  config PARAM_TOOLHEAD_EXTRUDER_TO_NOZZLE
    default "99.38"
  config PARAM_TOOLHEAD_SENSOR_TO_NOZZLE
    default "79.78"
  config PARAM_TOOLHEAD_ENTRY_TO_EXTRUDER
    default "13.29"
  config PARAM_TOOLHEAD_RESIDUAL_FILAMENT
    default "5"
endif
```

## installer/toolheads/Kconfig.stealthburner_g2e_revo
```kconfig
config TOOLHEAD_TYPE_STEALTHBURNER_G2E_REVO
  bool "Stealthburner G2E Revo"

if TOOLHEAD_TYPE_STEALTHBURNER_G2E_REVO
  config PARAM_TOOLHEAD_TYPE
    default "Stealthburner G2E Revo"
  config PARAM_TOOLHEAD_EXTRUDER_TO_NOZZLE
    default "99.18"
  config PARAM_TOOLHEAD_SENSOR_TO_NOZZLE
    default "79.58"
  config PARAM_TOOLHEAD_ENTRY_TO_EXTRUDER
    default "13.29"
  config PARAM_TOOLHEAD_RESIDUAL_FILAMENT
    default "2"
endif
```

## installer/toolheads/Kconfig.xol_metrix_sherpa_mini_cnc_rapido_1_uhf
```kconfig
config TOOLHEAD_TYPE_XOL_METRIX_SHERPA_MINI_CNC_RAPIDO_1_UHF
  bool "XOL Metrix Sherpa Mini CNC Rapido 1 UHF"

if TOOLHEAD_TYPE_XOL_METRIX_SHERPA_MINI_CNC_RAPIDO_1_UHF
  config PARAM_TOOLHEAD_TYPE
    default "XOL Metrix Sherpa Mini CNC Rapido 1 UHF"
  config PARAM_TOOLHEAD_EXTRUDER_TO_NOZZLE
    default "102"
  config PARAM_TOOLHEAD_SENSOR_TO_NOZZLE
    default "82"
  config PARAM_TOOLHEAD_ENTRY_TO_EXTRUDER
    default "38"
  config PARAM_TOOLHEAD_RESIDUAL_FILAMENT
    default "40"
endif
```

## installer/types/Kconfig
```kconfig
rsource "Kconfig.*"

config PARAM_MMU_VENDOR
  string
  default "Other"

config PARAM_MMU_VERSION
  string
  default "1.0" 

choice CHOICE_MMU_TYPE 
  prompt "MMU Type"
  help 
    Select the type of MMU you are using. 
    This will configure the default settings for your setup.

  config MMU_TYPE_CUSTOM
    bool "Custom"
    imply REQUIRE_BOWDEN_MOVE

  if MMU_TYPE_CUSTOM
    rsource "starters/Kconfig.*"

    choice CHOICE_MMU_CUSTOM_TYPE
      prompt "Pick a starter config"
      help 
        Select a custom starter config to start from. 
        This will configure a good starting point for your custom MMU setup.
    endchoice
  endif
endchoice
```

## installer/types/Kconfig.3d_chameleon
```kconfig
choice CHOICE_MMU_TYPE 
  config MMU_TYPE_3D_CHAMELEON_1_0
    bool "3D Chameleon"
    select MMU_HAS_SELECTOR
    select REQUIRE_BOWDEN_MOVE
endchoice

if MMU_TYPE_3D_CHAMELEON_1_0
  config PARAM_MMU_VENDOR
    default "3DChameleon"
  config PARAM_MMU_VERSION
    default "1.0" 

  config PARAM_NUM_GATES
    default 4

  config PARAM_GEAR_GEAR_RATIO
    default "1:1"
  config PARAM_GEAR_RUN_CURRENT
    default "0.7"
  config PARAM_GEAR_HOLD_CURRENT
    default "0.1"
  config PARAM_SELECTOR_RUN_CURRENT
    default "0.63"
  config PARAM_SELECTOR_HOLD_CURRENT
    default "0.2"
  config PARAM_GEAR_HOMING_SPEED
    default "80"

  config PARAM_GATE_PARKING_DISTANCE
    default "250"
  config PARAM_GATE_HOMING_MAX
    default "500"

  choice CHOICE_GATE_HOMING_ENDSTOP
    default GATE_HOMING_ENDSTOP_GATE
  endchoice
  
  choice CHOICE_EXTRUDER_HOMING_ENDSTOP
    default EXTRUDER_HOMING_ENDSTOP_NONE
  endchoice
endif 
```

## installer/types/Kconfig.angry_beaver
```kconfig
choice CHOICE_MMU_TYPE
  config MMU_TYPE_ANGRY_BEAVER_1_0
    bool "Angry Beaver v1.0"
    select VARIABLE_ROTATION_DISTANCES
    select FILAMENT_ALWAYS_GRIPPED
endchoice

if MMU_TYPE_ANGRY_BEAVER_1_0
  config PARAM_MMU_VENDOR
    default "AngryBeaver"
  config PARAM_MMU_VERSION
    default "1.0" 
  config PARAM_NUM_GATES
    default 4

  config PARAM_GEAR_GEAR_RATIO
    default "1:1"
  config PARAM_GEAR_RUN_CURRENT
    default "0.7"
  config PARAM_GEAR_HOLD_CURRENT
    default "0.1"
  config PARAM_GEAR_HOMING_SPEED
    default "80"
    
  config PARAM_GATE_HOMING_MAX
    default "500"
  config PARAM_GATE_PARKING_DISTANCE
    default "50"

  choice CHOICE_GATE_HOMING_ENDSTOP
    default GATE_HOMING_ENDSTOP_EXTRUDER
  endchoice
  
  choice CHOICE_EXTRUDER_HOMING_ENDSTOP
    default EXTRUDER_HOMING_ENDSTOP_EXTRUDER
  endchoice
endif 
```

## installer/types/Kconfig.box_turtle
```kconfig
choice CHOICE_MMU_TYPE
  config MMU_TYPE_BOX_TURTLE_1_0
    bool "Box Turtle v1.0"
    select MMU_HAS_ESPOOLER
    select VARIABLE_ROTATION_DISTANCES
    select REQUIRE_BOWDEN_MOVE
    select FILAMENT_ALWAYS_GRIPPED
endchoice

if MMU_TYPE_BOX_TURTLE_1_0
  config PARAM_MMU_VENDOR
    default "BoxTurtle"
  config PARAM_MMU_VERSION
    default "1.0"  
  config PARAM_NUM_GATES
    default 4

  config PARAM_GEAR_GEAR_RATIO
    default "50:10"
  config PARAM_GEAR_RUN_CURRENT
    default "0.7"
  config PARAM_GEAR_HOLD_CURRENT
    default "0.1"
  config PARAM_GATE_HOMING_MAX
    default "300"
  config PARAM_GATE_PARKING_DISTANCE
    default "100"
  config PARAM_GATE_FINAL_EJECT_DISTANCE
    default "100"

  choice CHOICE_GATE_HOMING_ENDSTOP
    default GATE_HOMING_ENDSTOP_GATE
  endchoice
  
  choice CHOICE_EXTRUDER_HOMING_ENDSTOP
    default EXTRUDER_HOMING_ENDSTOP_NONE
  endchoice
endif 
```
