## installer/mmu_additions/Kconfig.environment_sensor
```kconfig
# Defines whether MMU has environment sensor
#
# Responsible for setting:
#   MMU_HAS_ENVIRONMENT_SENSOR

config MMU_HAS_ENVIRONMENT_SENSOR
  help
    Select if the MMU has a humidity/temperature sensor in the filament storate enclosure
  prompt "Environment sensor?"
  forceshow
```

## installer/mmu_additions/Kconfig.espooler
```kconfig
if !MMU_DISABLE_ESPOOLER_OPTION

  config MMU_HAS_ESPOOLER
    help
      An eSpooler is primarily used to rewind filament to prevent
      it tangling but can also be driven to assist loading and even
      assist in print. Select if you have added a DC motor controlled
      eSpooler.
    prompt "Has eSpooler?"
    forceshow

endif
```

## installer/mmu_additions/Kconfig.filament_buffer
```kconfig
if !MMU_DISABLE_FILAMENT_BUFFER_OPTION

  config MMU_HAS_FILAMENT_BUFFER
    bool "Has filament buffer to catch loose filament?"
    forceshow
    help
      Does MMU have a buffer to catch the uncoiled filament on unload. Note
      that a passive rewinder like Filamentalist is not a filament buffer
      because it alleviates the need for one!

endif
```

## installer/mmu_additions/Kconfig.heater
```kconfig
# Defines whether MMU has a filament enclosure heater
#
# Responsible for setting:
#   MMU_HAS_HEATER

config MMU_HAS_HEATER
  help
    Select if the MMU has a heater in the filament storate enclosure
  prompt "Enclosure heater?"
  forceshow
```

## installer/mmu_additions/Kconfig.leds
```kconfig
# Defines whether MMU is equipped with (passive) filament buffer
# i.e. space for filament to uncoil to
#
# Responsible for setting:
#   MMU_HAS_LEDS
#   BOOL_ENABLE_LEDS
#   BOOL_ENABLE_LEDS_ANIMATION

config MMU_HAS_LEDS
  help
    Select if your MMU has LEDs. This will install the LED driver but
    will still need to finialize configuration in the generated klipper
    config files or you can edit parameters in "Advanced" section.
  prompt "Has Leds?"
  forceshow

# Duplicated options with raw/advanced section
if MMU_HAS_LEDS
  menu "Led Options"
    help
      Select default led options

    config BOOL_ENABLE_LEDS
      bool "Enable LEDs?"
      help
        This allows you to install but turn off LED on startup.

    config BOOL_ENABLE_LEDS_ANIMATION
      bool "Enable animation?"
      help
        This allows you to turn off LED animations perhaps reducing the overhead
        on your main klipper CPU. Only disable if you have frequent TTC errors
        caused by overload (rarely necessary).

  endmenu
endif
```

## installer/mmu_additions/Kconfig.sync_feedback_buffer
```kconfig
# Defines whether MMU is equipped with sync-feedback "buffer" in bowden path
#
# Responsible for setting:
#   MMU_HAS_SYNC_FEEDBACK_BUFFER
#   MMU_SHARED_SYNC_FEEDBACK_BUFFER
#   (MMU_HAS_SENSOR_SYNC_FEEDBACK_COMPRESSION)
#   (MMU_HAS_SENSOR_SYNC_FEEDBACK_TENSION)

config MMU_HAS_SYNC_FEEDBACK_BUFFER
  prompt "Has sync-feedback buffer?"
  forceshow
  help
    A sync-feedback sensor (often referred to as a "buffer") is
    a sensor connected in the bowden path that can detect filament
    compression and/or tension.

if MMU_HAS_SYNC_FEEDBACK_BUFFER

  config MMU_SHARED_SYNC_FEEDBACK_BUFFER
    depends on MULTI_UNIT
    bool "Shared"
    default n

  if MMU_SHARED_SYNC_FEEDBACK_BUFFER
    config PARAM_SYNC_FEEDBACK_BUFFER_NAME
      prompt "Sync feedback buffer name"
      default "" # Encourage entering of name
      help
        PAUL TODO add help explaining sharing here
  endif

  if !MMU_SHARED_SYNC_FEEDBACK_BUFFER
    menu "Options"
      help
        Select sync-feedback buffer options

      source "sensors/Kconfig.sync_feedback"
    endmenu
  endif
endif
```

## installer/mmu_additions/sensors/Kconfig
```kconfig
menu "Filament Sensors"
  help
    Specify any additional filament sensors you have incorporated here.
    This also allows for the installation of TMC stallguard based filament
    detection and homing option.

  # Force a logical order from mmu to extruder
  rsource "Kconfig.entry"
  rsource "Kconfig.exit"
  rsource "Kconfig.shared_exit"
  rsource "Kconfig.sync_feedback"

# PAUL
#if !MULTI_UNIT # Exclude (part of MULTI_UNIT_ENTRY_POINT config)
#  rsource "Kconfig.extruder"
#  rsource "Kconfig.toolhead"
#endif

  rsource "Kconfig.gear_touch"
endmenu
```

## installer/mmu_additions/sensors/Kconfig.extruder
```kconfig
config MMU_HAS_SENSOR_EXTRUDER
  help
    Select if you have a filament sensor at or just prior to
    the extruder entry. This is normally connected to a pin on your main
    printer MCU so specify it here.
  bool "Extruder (entry) sensor?"
  
if MMU_HAS_SENSOR_EXTRUDER
  config PIN_EXTRUDER_SENSOR
    string "Extruder sensor pin"
    default "pinX"
endif
```

## installer/mmu_additions/sensors/Kconfig.sync_feedback
```kconfig
config MMU_HAS_SENSOR_SYNC_FEEDBACK_COMPRESSION
  help
    A sync-feedback sensor (often referred to as a "buffer") is
    a sensor that can detect filament compression and/or tension.
    Select this option if your sensor can detect filament being
    COMPRESSED in the bowden tube.

    This sensor allows the MMU gear stepper to be synchronized with
    the extruder and can be used to detect collision of the filament
    with the extruder.
  bool "Sync-Feedback Compression sensor (aka buffer out)?"

config MMU_HAS_SENSOR_SYNC_FEEDBACK_TENSION
  help
    A sync-feedback sensor (often referred to as a "buffer") is
    a sensor that can detect filament compression and/or tension.
    Select this option if your sensor can detect filament being
    UNDER TENSION in the bowden tube.

    This sensor allows the MMU gear stepper to be synchronized with
    the extruder.
  bool "Sync-Feedback Tension sensor (aka buffer in)?"
```

## installer/mmu_types/Kconfig
```kconfig
config PARAM_VENDOR
  string

config PARAM_VERSION
  string

choice 
  prompt "MMU Type"
  help 
    MMU type and hardware
    MMU Type (plus options and popular mods)
    Setting the MMU/AFC type and fitted options or popular mods should
    be done first and will default many software options to those
    recommended by the MMU designer or Happy Hare author.

  rsource "Kconfig.*"
  rsource "starters/Kconfig.*"
endchoice
```

## installer/mmu_types/Kconfig.3d_chameleon
```kconfig
config MMU_TYPE_3D_CHAMELEON_1_0
  bool "3D Chameleon"
  help
    3D Chameleon is a 4 gate MMU using innovative "opposing gate"
    filament selection mechanism.
  select ROTARY_SELECTOR
  select MMU_HAS_SELECTOR_STEPPER
  imply  PARAM_REQUIRE_BOWDEN_MOVE
  select PARAM_VARIABLE_ROTATION_DISTANCES
  select UNSELECT_VARIABLE_BOWDEN_LENGTHS
  select UNSELECT_HAS_BYPASS
  select UNSELECT_CAN_CROSSLOAD

####################
##### Defaults #####
####################

if MMU_TYPE_3D_CHAMELEON_1_0

  if SHOW_MMU_ADDITIONS_WITH_TYPE
    source "mmu_additions/Kconfig"
  endif

  # Identity
  config PARAM_VENDOR
    default "3DChameleon"
  config PARAM_VERSION
    default "1.0" 

  config PARAM_NUM_GATES
    default 4

  # Gear stepper
  config PARAM_GEAR_GEAR_RATIO
    default "1:1"
  config PARAM_GEAR_RUN_CURRENT
    default "0.7"
  config PARAM_GEAR_HOLD_CURRENT
    default "0.1"

  # Selector stepper
  config PARAM_SELECTOR_GEAR_RATIO
    default "1:1"
  config PARAM_SELECTOR_RUN_CURRENT
    default "0.63"
  config PARAM_SELECTOR_HOLD_CURRENT
    default "0.2"

  config PARAM_SELECTOR_GATE_DIRECTIONS
    default "[1, 1, 0, 0]"
  config PARAM_SELECTOR_RELEASE_GATES
    default "[2, 3, 0, 1]"

  # Speeds overrides
  config PARAM_GEAR_HOMING_SPEED
    default "80"

  # Distances
  config PARAM_GATE_PARKING_DISTANCE
    default "250"
  config PARAM_GATE_HOMING_MAX
    default "500"

endif 
```

## installer/mmu_types/Kconfig.3ms
```kconfig
config MMU_TYPE_3MS_1_0
  bool "3MS  - Modular Multi Material System"
  help
    3MS is a popular simple and reliable type-B MMU design. It is an open
    framed minimalist design and easy to build with any number of gates.
  select VIRTUAL_SELECTOR
  select BOOL_VARIABLE_ROTATION_DISTANCES
  select BOOL_FILAMENT_ALWAYS_GRIPPED

if MMU_TYPE_3MS_1_0

  if SHOW_MMU_ADDITIONS_WITH_TYPE
    source "Kconfig.mmu_additions"
  endif

  source "Kconfig.capabilities"

  ####################
  ##### Defaults #####
  ####################

  config PARAM_VENDOR
    default "3MS"
  config PARAM_VERSION
    default "1.0" 
  config PARAM_NUM_GATES
    default 4

  config PARAM_GEAR_GEAR_RATIO
    default "1:1"
  config PARAM_GEAR_RUN_CURRENT
    default 0.7
  config PARAM_GEAR_HOLD_CURRENT
    default 0.1

  config PARAM_GEAR_HOMING_SPEED
    default 80

  config PARAM_GATE_HOMING_MAX
    default 500
  config PARAM_GATE_PARKING_DISTANCE
    default -250

endif 
```

## installer/mmu_types/Kconfig.angry_beaver
```kconfig
config MMU_TYPE_ANGRY_BEAVER_1_0
  bool "Angry Beaver v1.0"
  help
    Angry Beaver is a very simple type-B MMU design that emphasizes
    reliability. A unique feature is the 4-filament bowden that parks
    filament near the toolhead for fast tool swaps. Exploiting this
    feature does limit the MMU to 4 gates/lanes.
  select VIRTUAL_SELECTOR
  select MMU_HAS_LEDS
  select PARAM_VARIABLE_ROTATION_DISTANCES
  select PARAM_FILAMENT_ALWAYS_GRIPPED
  select BOOL_ENABLE_SYNC_TO_EXTRUDER
  select BOOL_ENABLE_SYNC_FORM_TIP
  select BOOL_ENABLE_SYNC_PURGE

if MMU_TYPE_ANGRY_BEAVER_1_0
  if SHOW_MMU_ADDITIONS_WITH_TYPE
    source "mmu_additions/Kconfig"
  endif

  ####################
  ##### Defaults #####
  ####################

  config PARAM_MMU_VENDOR
    default "AngryBeaver"
  config PARAM_MMU_VERSION
    default "1.0" 
  config PARAM_NUM_GATES
    default 4
  choice CHOICE_BOARD_TYPE
    default BOARD_TYPE_MMB_2_0
  endchoice

  config PARAM_GEAR_GEAR_RATIO
    default "1:1"
  config PARAM_GEAR_RUN_CURRENT
    default "0.7"
  config PARAM_GEAR_HOLD_CURRENT
    default "0.1"

  config PARAM_GEAR_HOMING_SPEED
    default "80"
    
  config PARAM_GATE_HOMING_MAX
    default "500"
  config PARAM_GATE_PARKING_DISTANCE
    default "50"

# PAUL
#  choice CHOICE_GATE_HOMING_ENDSTOP
#    default CHOICE_GATE_HOMING_ENDSTOP_EXTRUDER
#  endchoice
#  choice CHOICE_EXTRUDER_HOMING_ENDSTOP
#    default CHOICE_EXTRUDER_HOMING_ENDSTOP_EXTRUDER
#  endchoice
endif 
```
