## installer/mmu_types/Kconfig.ercf
```kconfig
config MMU_FAMILY_ERCF
  bool "ERCF - Enraged Rabbit Carrot Feeder"
  help
    The Enraged Rabbit Carrot Feeder (ERCF) is the original DIY MMU design
    with a large community and many popular mods. It is available in two
    main versions, the original v1.1 and the upgraded v2.0.
  select LINEAR_SERVO_SELECTOR
  select MMU_HAS_ENCODER
  select PARAM_VARIABLE_ROTATION_DISTANCES
  select UNSELECT_VARIABLE_BOWDEN_LENGTHS
  imply  PARAM_REQUIRE_BOWDEN_MOVE
  select UNSELECT_CAN_CROSSLOAD

if MMU_FAMILY_ERCF

  choice
    prompt "Version"
    default MMU_TYPE_ERCF_3_0

    config MMU_TYPE_ERCF_1_1
      bool "ERCF v1.1"
      help
        ERCF v1.1 is the original DIY MMU for klipper.
        Originally fitted with a TCRT5000 based encoder.
      imply MMU_HAS_FILAMENT_BUFFER
      imply PREFERS_CHOICE_GATE_HOMING_ENDSTOP_ENCODER

    config MMU_TYPE_ERCF_2_0
      bool "ERCF v2.0"
      help
        ERCF v2.0 is a community upgraded version incorporating
        popular mods and filler with custom Binky based encoder.
      imply MMU_HAS_LEDS
      imply PARAM_HAS_BYPASS
      imply MMU_HAS_FILAMENT_BUFFER
      imply PREFERS_CHOICE_GATE_HOMING_ENDSTOP_ENCODER

    config MMU_TYPE_ERCF_3_0
      bool "ERCF v3.0"
      help
        ERCF v3.0 is the 3rd generation ERCF with faster filament
        loading/unloading, improved Binky based encoder and many
        ease of use features with hinged gates.
      imply MMU_HAS_LEDS
      imply PARAM_HAS_BYPASS
      imply PREFERS_CHOICE_GATE_HOMING_ENDSTOP_ENCODER
  endchoice

  source "Kconfig.num_gates"
  source "servos/Kconfig"

  if MMU_TYPE_ERCF_1_1
    menu "Project Options"
      help
        The ERCF project has a few popular modifications that were later
        incorporated into the v2 design. If you have any upgrades then
        you can specify them here.

      config MOD_BINKY
        bool "Binky encoder"
        help
          Select if building with the upgraded Binky based encoder

      config MOD_SPRINGY
        bool "Springy"
        help
          Springy is a mod for sprung selector servo removing need for top-hat tuning.

     config MOD_TRIPLE_DECKY
       bool "Triple Decky"
       help
         Alternative filament block removing need for magnetic gate opening.

      config MMU_HAS_FILAMENT_BUFFER
        prompt "Has ERCP filament buffer?"
        help
          Does MMU have the Enraged Rabbit Carrot Patch (ERCP) filament buffer
          to catch the uncoiled filament on unload.

      source "Kconfig.bypass"
    endmenu
  endif

  if MMU_TYPE_ERCF_2_0
    menu "Project Options"
      help
        The ERCF project has a few popular modifications. If you have any
        upgrades or non-default options you can specify them here.

      config MOD_THUMPER_BLOCKS
        bool "Thumper Blocks"
        help
          Alternative filament block with slightly different geometry.

      config MMU_HAS_FILAMENT_BUFFER
        bool "Has Cotton Tail filament buffer?"
        help
          Does MMU have the Cotton Tail filament buffer to catch the uncoiled
          filament on unload. NOTE unselect if you are using Filamentalist.
    endmenu
  endif

  if MMU_TYPE_ERCF_3_0
    menu "Project Options"
      help
        The ERCF project has a few popular modifications. If you have any
        upgrades or non-default options you can specify them here.

      config MMU_HAS_FILAMENT_BUFFER
        bool "Has Cotton Tail filament buffer?"
        help
          Does MMU have the Cotton Tail filament buffer to catch the uncoiled
          filament on unload. NOTE unselect if you are using Filamentalist.
    endmenu
  endif

  if SHOW_MMU_ADDITIONS_WITH_TYPE
    source "mmu_additions/Kconfig"
  endif

  ####################
  ##### Defaults #####
  ####################

  # Shared identity
  config PARAM_VENDOR
    default "ERCF"

  # Shared selector servo
  config PARAM_SERVO_BUZZ_GEAR_ON_DOWN
    default 3
  config PARAM_SERVO_DURATION
    default "0.4"

  if MMU_TYPE_ERCF_1_1
    config PARAM_VERSION
      default "1.1sbt" if MOD_SPRINGY && MOD_BINKY && MOD_TRIPLE_DECKY
      default "1.1sb"  if MOD_SPRINGY && MOD_BINKY
      default "1.1st"  if MOD_SPRINGY && MOD_TRIPLE_DECKY
      default "1.1bt"  if MOD_BINKY && MOD_TRIPLE_DECKY
      default "1.1s"   if MOD_SPRINGY
      default "1.1b"   if MOD_BINKY
      default "1.1t"   if MOD_TRIPLE_DECKY
      default "1.1"

    config PARAM_NUM_GATES
      default 9

    choice BOARD_TYPE
      default BOARD_TYPE_EASY_BRD_RP2040
    endchoice

    # Gear stepper
    config PARAM_GEAR_GEAR_RATIO
      default "80:20"
    config PARAM_GEAR_RUN_CURRENT
      default "0.5"
    config PARAM_GEAR_HOLD_CURRENT
      default "0.1"

    # Selector stepper
    config PARAM_SELECTOR_GEAR_RATIO
      default "1:1"
    config PARAM_SELECTOR_RUN_CURRENT
      default "0.4"
    config PARAM_SELECTOR_HOLD_CURRENT
      default "0.2"

    # Speeds

    # Distances
    config PARAM_GATE_PARKING_DISTANCE
      default "23"
      default "13" if MOD_THUMPER_BLOCKS

    # Modifications
    choice CHOICE_ENCODER_TYPE
      default CHOICE_ENCODER_TYPE_BINKY    if MOD_BINKY
      default CHOICE_ENCODER_TYPE_TCRT5000 if !MOD_BINKY
    endchoice
  endif

  if MMU_TYPE_ERCF_2_0
    config PARAM_VERSION
      default "2.0"

    config PARAM_NUM_GATES
      default 8

    choice BOARD_TYPE
      default BOARD_TYPE_MMB_2_0
    endchoice

    # Gear stepper
    config PARAM_GEAR_GEAR_RATIO
      default "80:20"
    config PARAM_GEAR_RUN_CURRENT
      default "0.5"
    config PARAM_GEAR_HOLD_CURRENT
      default "0.1"

    # Selector stepper
    config PARAM_SELECTOR_GEAR_RATIO
      default "1:1"
    config PARAM_SELECTOR_RUN_CURRENT
      default "0.4"
    config PARAM_SELECTOR_HOLD_CURRENT
      default "0.2"

    # Speed overrides

    # Distances
    config PARAM_GATE_PARKING_DISTANCE
      default "13"
      default "11" if MOD_THUMPER_BLOCKS

    choice CHOICE_ENCODER_TYPE
      default CHOICE_ENCODER_TYPE_BINKY
    endchoice
  endif

  if MMU_TYPE_ERCF_3_0
    config PARAM_VERSION
      default "3.0"

    config PARAM_NUM_GATES
      default 8

    choice BOARD_TYPE
      default BOARD_TYPE_MMB_2_0
    endchoice

    # Gear stepper
    config PARAM_GEAR_GEAR_RATIO
      default "1:1"
    config PARAM_GEAR_RUN_CURRENT
      default "0.8"
    config PARAM_GEAR_HOLD_CURRENT
      default "0.2"

    # Selector stepper
    config PARAM_SELECTOR_GEAR_RATIO
      default "1:1"
    config PARAM_SELECTOR_RUN_CURRENT
      default "0.7"
    config PARAM_SELECTOR_HOLD_CURRENT
      default "0.2"

    # Speeds

    # Distances
    config PARAM_GATE_PARKING_DISTANCE
      default "16"

    choice CHOICE_ENCODER_TYPE
      default CHOICE_ENCODER_TYPE_BINKY_V2
    endchoice
  endif
endif
```

## installer/mmu_types/Kconfig.kms
```kconfig
config MMU_TYPE_KMS_1_0
  bool "KMS v1.0"
  help
    KMS is a type-B MMU with kits from BIQU. It had many features (including
    integrated encoder) in a sealed enclosure utilizing a passive respooler
    system based on Filamentalist.
  select VIRTUAL_SELECTOR
  select MMU_HAS_ENCODER
  select MMU_HAS_ESPOOLER
  select MMU_HAS_ENVIRONMENT_SENSOR
  select MMU_HAS_LEDS
  select MMU_HAS_SENSOR_PRE_GATE
  select PARAM_VARIABLE_ROTATION_DISTANCES
  select PARAM_REQUIRE_BOWDEN_MOVE
  select PARAM_FILAMENT_ALWAYS_GRIPPED
  select BOOL_ENABLE_SYNC_TO_EXTRUDER
  select BOOL_ENABLE_SYNC_FORM_TIP
  select BOOL_ENABLE_SYNC_PURGE
  select MMU_DISABLE_FILAMENT_BUFFER_OPTION
  imply OPTION_KMS_BUFFER

if MMU_TYPE_KMS_1_0
  config OPTION_KMS_BUFFER
    bool "KMS buffer"
    help
      Select if using the KMS brand buffer connected to the bowden tube using its
      integrated mcu. Don't select if using a different buffer system (instead add
      under MMU additions)
    select MMU_HAS_BUFFER_MCU
    select MMU_HAS_SENSOR_POST_GEAR
    select MMU_HAS_SYNC_FEEDBACK_BUFFER
    select MMU_HAS_SENSOR_SYNC_FEEDBACK_COMPRESSION
    select MMU_HAS_SENSOR_SYNC_FEEDBACK_TENSION
endif

if MMU_TYPE_KMS_1_0

  if SHOW_MMU_ADDITIONS_WITH_TYPE
    source "mmu_additions/Kconfig"
  endif

  ####################
  ##### Defaults #####
  ####################

  config PARAM_VENDOR
    default "KMS"
  config PARAM_VERSION
    default "1.0"  
  config PARAM_NUM_GATES
    default 4
  choice BOARD_TYPE
    default BOARD_TYPE_KMS_1_0
  endchoice

  config PARAM_GEAR_GEAR_RATIO
    default "50:17"
  config PARAM_GEAR_RUN_CURRENT
    default "0.7"
  config PARAM_GEAR_HOLD_CURRENT
    default "0.1"

  # "Leds" config
  config PARAM_CHAIN_COUNT
    default 4
  config PARAM_COLOR_ORDER
    default "GRBW"
  config PARAM_EXIT_LEDS 
    default "neopixel:$(UNIT_NAME)_leds (1-4)"

  # "Gates" config
  config PARAM_GATE_HOMING_MAX
    default "300"
  config PARAM_GATE_PRELOAD_HOMING_MAX
    default "300"
  config PARAM_GATE_PRELOAD_PARKING_DISTANCE
    default "-10"
  config PARAM_GATE_PARKING_DISTANCE
    default "20"
  config PARAM_GATE_ENDSTOP_TO_ENCODER
    default "14"
  config PARAM_GATE_FINAL_EJECT_DISTANCE
    default "300"

  # "Motor sync" config
  config PARAM_SYNC_FEEDBACK_BUFFER_RANGE
    default "8"
  config PARAM_SYNC_FEEDBACK_BUFFER_MAXRANGE
    default "12"

  # Calibration and Autotuning
  config BOOL_AUTOCAL_BOWDEN_LENGTH
    default y
  config BOOL_AUTOTUNE_BOWDEN_LENGTH
    default n
  config BOOL_SKIP_CAL_ROTATION_DISTANCE
    default y
  if MMU_HAS_SYNC_FEEDBACK_BUFFER
    config BOOL_AUTOTUNE_ROTATION_DISTANCE
      default y
  endif
  config BOOL_SKIP_CAL_ENCODER
    default n
  config BOOL_AUTOTUNE_ENCODER
    default n

  config PARAM_ENVIRONMENT_SENSOR
    default "temperature_sensor $(UNIT_NAME)_enviroment"

  config PARAM_MISC_HARDWARE
    default "$(ml,\
[temperature_sensor $(UNIT_NAME)_enviroment]\n\
sensor_type: HTU21D\n\
i2c_mcu: $(MCU_NAME)\n\
htu21d_report_time: 10\n\
i2c_software_scl_pin: $(MCU_NAME):PB10\n\
i2c_software_sda_pin: $(MCU_NAME):PB11\n\
\n\
[heater_fan $(UNIT_NAME)_fan_left]\n\
pin: $(MCU_NAME):PC3\n\
shutdown_speed: 0\n\
heater: MMU_heater_kms\n\
\n\
[heater_fan $(UNIT_NAME)_fan_right]\n\
pin: $(MCU_NAME):PC1\n\
shutdown_speed: 0\n\
heater: $(UNIT_NAME)_heater\n\
\n\
[heater_generic $(UNIT_NAME)_heater]\n\
gcode_id: $(UNIT_NAME)\n\
heater_pin: $(MCU_NAME):PB1\n\
max_power:1.0\n\
sensor_type: EPCOS 100K B57560G104F\n\
pullup_resistor: 2200\n\
sensor_pin: $(MCU_NAME):PA4\n\
control: watermark\n\
min_temp: 0\n\
max_temp: 70\n\
)" if BOARD_TYPE_KMS_1_0

endif 
```

## installer/mmu_types/Kconfig.mmx
```kconfig
config MMU_TYPE_MMX_1_0
  bool "MMX 1.0"
  help
    MMX is a 4 gate type-A MMU initially based on Pico MMU. It
    uses a servo and cam mechanism to select filament gate.
  select SERVO_SELECTOR
  select MMU_HAS_LEDS
  select PARAM_REQUIRE_BOWDEN_MOVE
  select PARAM_FILAMENT_ALWAYS_GRIPPED
  

if MMU_TYPE_MMX_1_0

  source "servos/Kconfig"

  if SHOW_MMU_ADDITIONS_WITH_TYPE
    source "mmu_additions/Kconfig"
  endif

  ####################
  ##### Defaults #####
  ####################

  config PARAM_VENDOR
    default "MMX"
  config PARAM_VERSION
    default "1.0"
  config PARAM_NUM_GATES
    default 4

  config PARAM_GEAR_GEAR_RATIO
    default "80:20"
  config PARAM_GEAR_RUN_CURRENT
    default "0.7"
  config PARAM_GEAR_HOLD_CURRENT
    default "0.1"

  config PARAM_GATE_PARKING_DISTANCE
    default "25"
  config PARAM_GATE_HOMING_MAX
    default "1000"

  config PARAM_SELECTOR_GATE_ANGLES
    default "60,0,180,120"

endif 
```

## installer/mmu_types/Kconfig.mmx6
```kconfig
config MMU_TYPE_MMX6_1_0
  bool "MMX6"
  help
    MMX is a 6 gate type-A MMU with rotary cam based selection
    mechanism controlled by stepper
  select ROTARY_SELECTOR
  select MMU_HAS_LEDS
  imply  BOOL_REQUIRE_BOWDEN_MOVE
  select BOOL_FILAMENT_ALWAYS_GRIPPED
  select BOOL_VARIABLE_ROTATION_DISTANCES
  select DISABLE_NUM_GATES_OPTION

####################
##### Defaults #####
####################

if MMU_TYPE_MMX6_1_0

  if SHOW_MMU_ADDITIONS_WITH_TYPE
    source "Kconfig.mmu_additions"
  endif

  source "Kconfig.capabilities"

  config PARAM_VENDOR
    default "MMX6"
  config PARAM_VERSION
    default "1.0"
  config PARAM_NUM_GATES
    default 6

  config PARAM_GEAR_GEAR_RATIO
    default "80:20"
  config PARAM_GEAR_RUN_CURRENT
    default 0.7
  config PARAM_GEAR_HOLD_CURRENT
    default 0.1

  config PARAM_GATE_PARKING_DISTANCE
    default -25
  config PARAM_GATE_HOMING_MAX
    default 1000

endif 
```

## installer/mmu_types/Kconfig.test
```kconfig
config MMU_FAM_TEST
 bool "Test MMU Family"

if MMU_FAM_TEST
 choice CHOICE_TEST_1
  prompt "Test MMU Type"
  config TEST_ 
			bool "Test MMU Type v1"
			help
					Test MMU Type v1
					Test MMU Type v1
					Setting the Test MMU Type v1 and fitted options or popular mods should
					be done first and will default many software options to those
					recommended by the MMU designer or Happy Hare author.
config TEST_2
bool "testestes"
  endchoice
 endif
```

## installer/mmu_types/Kconfig.tradrack
```kconfig
config MMU_TYPE_TRADRACK_1_0
  bool "Tradrack v1.0"
 help
   Tradrack is a type-A MMU designed by the Annex Engineering team.
   It differed from ERCF in that it is easier to add additional gates/lanes
   but also uses the same BMG gear to drive all filaments. It has a shared
   gate sensor but a Binky based encoder is a popular option.
  select LINEAR_SERVO_SELECTOR
  select MMU_HAS_SENSOR_GATE
  select PARAM_VARIABLE_ROTATION_DISTANCES
  select UNSELECT_VARIABLE_BOWDEN_LENGTHS
  imply  PARAM_REQUIRE_BOWDEN_MOVE
  select UNSELECT_CAN_CROSSLOAD

if MMU_TYPE_TRADRACK_1_0
  source "Kconfig.num_gates"
  source "servos/Kconfig"

  menu "Project Options"
    help
      If you have any project upgrades then you can specify them here.

    config MOD_BINKY
      bool "Binky encoder"
      help
        Select if building with a Binky based encoder.
      imply MMU_HAS_ENCODER
  endmenu

  if SHOW_MMU_ADDITIONS_WITH_TYPE
    source "mmu_additions/Kconfig"
  endif

  ####################
  ##### Defaults #####
  ####################

  # Identify
  config PARAM_VENDOR
    default "Tradrack"
  config PARAM_VERSION
    default "1.0"

  config PARAM_NUM_GATES
    default 10

  choice BOARD_TYPE
    default BOARD_TYPE_MMB_2_0
  endchoice

  # Gear stepper
  config PARAM_GEAR_GEAR_RATIO
    default "50:17"
  config PARAM_GEAR_RUN_CURRENT
    default "1.27"
  config PARAM_GEAR_HOLD_CURRENT
    default "0.2"

  # Selector stepper
  config PARAM_SELECTOR_GEAR_RATIO
    default "1:1"
  config PARAM_SELECTOR_RUN_CURRENT
    default "0.63"
  config PARAM_SELECTOR_HOLD_CURRENT
    default "0.2"
  config PARAM_SELECTOR_GATE_DIRECTIONS
    default "[1, 1, 0, 0]"
  config PARAM_SELECTOR_RELEASE_GATES
    default "[2, 3, 0, 1]"

  # Selector servo
  config PARAM_SERVO_BUZZ_GEAR_ON_DOWN
    default 0
  config PARAM_SERVO_DURATION
    default "0.4"

  # Speeds overrides

  # Distances
  config PARAM_GATE_PARKING_DISTANCE
    default "48" if MOD_BINKY
    default "17.5"
  config PARAM_GATE_ENDSTOP_TO_ENCODER
    default "31" if MOD_BINKY

  choice CHOICE_ENCODER_TYPE
    default CHOICE_ENCODER_TYPE_BINKY if MOD_BINKY
  endchoice
endif
```

## installer/mmu_types/starters/Kconfig.custom
```kconfig
config MMU_CUSTOM
  help 
    Select this custom config when your MMU isn't listed.
    Ensure you choose the correct selector type.
    After selection by sure to add options under "MMU Additions".
    Then fine tune in Advanced/Raw Settings
  bool "Custom Design"
  
if MMU_CUSTOM

  source "Kconfig.num_gates"

  if SHOW_MMU_ADDITIONS_WITH_TYPE
    source "Kconfig.mmu_additions"
  endif

  source "Kconfig.capabilities"

  ####################
  ##### Defaults #####
  ####################

  config PARAM_VENDOR
    default "Other"
  config PARAM_VERSION
    default "1.0"
  config PARAM_NUM_GATES
    default 4

endif 
```
