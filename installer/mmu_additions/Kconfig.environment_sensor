## installer/mmu_types/starters/Kconfig.type_a
```kconfig
config MMU_CUSTOM_TYPE_A
  help 
    Select this custom starter config when you MMU has a filament
    selector mechanism (stepper and/or servo). After selection
    by sure to add options under "MMU Additions".
    You can fine tune the klipper configuration as necessary.
  bool "Custom type A - with selector"
  imply MMU_HAS_SELECTOR
  imply MMU_HAS_SERVO
  imply REQUIRE_BOWDEN_MOVE
  imply VARIABLE_ROTATION_DISTANCES
  
if MMU_CUSTOM_TYPE_A 
  rsource "../../Kconfig.num_gates"

  config MMU_HAS_SELECTOR
    help
      Select if the filament selection mechanism uses a stepper motor.
    bool "Has selector stepper motor?"

  config MMU_HAS_SERVO
    help
      Select if the filament selection or gripping mechanism uses a servo.
    bool "Has selector servo?"

  config VARIABLE_ROTATION_DISTANCES
    help
      Select if each gate has a different BMG gear and thus can have different
      rotation distances. Unselect if a single drive gear moved to the selected
      gate.
    bool "Different drive gear (rotation distance) per gate?"

  if SHOW_MMU_ADDITIONS_WITH_TYPE
    rsource "../../mmu_additions/Kconfig"
  endif
endif

if MMU_CUSTOM_TYPE_A
  config PARAM_MMU_VENDOR
    default "Other"
  config PARAM_MMU_VERSION
    default "1.0"
  config PARAM_NUM_GATES
    default 8

  config PARAM_GEAR_GEAR_RATIO
    default "1:1"
  config PARAM_GEAR_RUN_CURRENT
    default "0.7"
  config PARAM_GEAR_HOLD_CURRENT
    default "0.1"

  config PARAM_SELECTOR_RUN_CURRENT
    default "0.5"
  config PARAM_SELECTOR_HOLD_CURRENT
    default "0.1"

  choice CHOICE_GATE_HOMING_ENDSTOP
    default GATE_HOMING_ENDSTOP_GATE
  endchoice
  choice CHOICE_EXTRUDER_HOMING_ENDSTOP
    default EXTRUDER_HOMING_ENDSTOP_NONE
  endchoice
endif 
```

## installer/mmu_types/starters/Kconfig.type_b
```kconfig
config MMU_CUSTOM_TYPE_B
  bool "Custom type B - with multiple filament drivers"
  help 
    Select this custom starter config when you MMU has separate
    stepper motors for each gate/lane. After selection be sure to
    add options under "MMU Additions".
    You can fine tune the klipper configuration as necessary.
  select VIRTUAL_SELECTOR
  select PARAM_VARIABLE_ROTATION_DISTANCES
  select PARAM_FILAMENT_ALWAYS_GRIPPED
  imply PARAM_VARIABLE_BOWDEN_LENGTHS
  imply PARAM_REQUIRE_BOWDEN_MOVE

if MMU_CUSTOM_TYPE_B
  config PARAM_REQUIRE_BOWDEN_MOVE
    help
      If you have a single long bowden tube connecting you toolhead
      you should select this option. Unselect if you have a
      combiner/splitter and will pack filaments close to the toolhead.
    bool "Require fast bowden move?"

  if SHOW_MMU_ADDITIONS_WITH_TYPE
    source "mmu_additions/Kconfig"
  endif
endif

if MMU_CUSTOM_TYPE_B
  config PARAM_VENDOR
    default "Other"
  config PARAM_VERSION
    default "1.0"
  config PARAM_NUM_GATES
    default 4

  config PARAM_GEAR_GEAR_RATIO
    default "1:1"
  config PARAM_GEAR_RUN_CURRENT
    default "0.7"
  config PARAM_GEAR_HOLD_CURRENT
    default "0.1"
endif 
```

## installer/mmu_types/starters/Kconfig.type_test
```kconfig
config MMU_CUSTOM_TYPE_EVERYTHING
  bool "Test config with everything"
  help 
    Select this custom starter config for testing or to create
    a fully populated set of klipper config files.
  select MMU_HAS_SELECTOR_STEPPER
  select MMU_HAS_SELECTOR_SERVO
  select MMU_HAS_ENCODER
  select MMU_HAS_ESPOOLER
  select MMU_HAS_LEDS
  select MMU_HAS_SENSOR_PRE_GATE
  select MMU_HAS_SENSOR_POST_GEAR
  select MMU_HAS_SENSOR_GATE
  select MMU_HAS_SENSOR_SYNC_FEEDBACK_COMPRESSION
  select MMU_HAS_SENSOR_SYNC_FEEDBACK_TENSION
  select MMU_HAS_SENSOR_EXTRUDER
  select MMU_HAS_SENSOR_TOOLHEAD
  select MMU_HAS_SENSOR_GEAR_TOUCH
  select MMU_HAS_FILAMENT_BUFFER # Really this is mutually exclusive with eSpooler
  select PARAM_HAS_BYPASS
  imply VIRTUAL_SELECTOR
  imply PARAM_REQUIRE_BOWDEN_MOVE
  imply PARAM_VARIABLE_ROTATION_DISTANCES
  imply PARAM_VARIABLE_BOWDEN_LENGTHS
  imply PARAM_FILAMENT_ALWAYS_GRIPPED

if MMU_CUSTOM_TYPE_EVERYTHING
  config PARAM_VENDOR
    default "Other"
  config PARAM_VERSION
    default "1.0"
  config PARAM_NUM_GATES
    default 4
endif 
```

## installer/sensors/Kconfig.entry
```kconfig
config MMU_HAS_SENSOR_ENTRY
  bool "Has gate/lane entry sensors?"
  help
    Select if you have pre-gate filament sensors at the entry to the
    MMU. This aid early filament runout detection and allow for
    autoload features.

    Configure pin in "Pins" section.
```

## installer/sensors/Kconfig.exit
```kconfig
config MMU_HAS_SENSOR_EXIT
  bool "Has gate/lane exit sensors?"
  help
    Select if you have seperate per-gate filament sensors after the MMU
    drive gear but before any combiner/splitter. Typically this is only
    fitted to type-B designs.

    Configure pin in \"Pins\" section.
```
