## installer/mmu_types/Kconfig.quattro_box
```kconfig
config MMU_FAMILY_QUATTRO_BOX
  bool "QuattroBox"
  help
    QuattroBox is type-B MMU with 4 gates. It uses a Filamentalist based
    design for spool respooling leveraging gear steppers for motion.
    Has integrated encoder for measurement of filament movement.
    Has eject button option -- be sure to install eject button addon.
  select VIRTUAL_SELECTOR
  select MMU_HAS_ENCODER
  select PARAM_VARIABLE_ROTATION_DISTANCES
  select PARAM_VARIABLE_BOWDEN_LENGTHS
  select PARAM_FILAMENT_ALWAYS_GRIPPED
  imply BOOL_ENABLE_LEDS
  imply MMU_HAS_EJECT_BUTTONS


if MMU_FAMILY_QUATTRO_BOX
  choice
    prompt "Version"

    config MMU_TYPE_QUATTRO_BOX_1_0
      bool "QuattroBox v1.0"
      select MMU_HAS_LEDS
      select PARAM_SYNC_TO_EXTRUDER
      select PARAM_SYNC_FORM_TIP
      select PARAM_SYNC_PURGE

      config MMU_TYPE_QUATTRO_BOX_1_1
      bool "QuattroBox v1.1"
      select MMU_HAS_LEDS
      select PARAM_SYNC_TO_EXTRUDER
      select PARAM_SYNC_FORM_TIP
      select PARAM_SYNC_PURGE
      help
        Version 1.1 has updated LEDs.

      config MMU_TYPE_QUATTRO_BOX_2_0
      bool "QuattroBox v2"
      select MMU_HAS_LEDS
      select PARAM_SYNC_TO_EXTRUDER
      select PARAM_SYNC_FORM_TIP
      select PARAM_SYNC_PURGE
      # The Chameleon X5 supplies the defaults for these
      imply MMU_HAS_ENVIRONMENT_SENSOR         if BOARD_TYPE_CHAMELEON_X5_1_0
      imply MMU_HAS_HEATER                     if BOARD_TYPE_CHAMELEON_X5_1_0
      imply MMU_HAS_FANS                       if BOARD_TYPE_CHAMELEON_X5_1_0
      imply MMU_HAS_SENSOR_ENTRY               if BOARD_TYPE_CHAMELEON_X5_1_0
      imply MMU_HAS_SENSOR_EXIT                if BOARD_TYPE_CHAMELEON_X5_1_0
      imply MMU_HAS_SENSOR_SHARED_EXIT         if BOARD_TYPE_CHAMELEON_X5_1_0
      imply MMU_HAS_SYNC_FEEDBACK_BUFFER       if BOARD_TYPE_CHAMELEON_X5_1_0
      imply MMU_HAS_SENSOR_BUFFER_PROPORTIONAL if BOARD_TYPE_CHAMELEON_X5_1_0 && !MMU_SHARED_SYNC_FEEDBACK_BUFFER
      # Home gates to the shared exit sensor whenever one is fitted
      imply PREFERS_CHOICE_GATE_HOMING_ENDSTOP_SHARED_EXIT
      help
        All new version 2 design with heated environment.

    endchoice

  source "Kconfig.capabilities"

  # -------------------------------------
  # Defaults
  # -------------------------------------

  config PARAM_VENDOR
    default "QuattroBox"
  config PARAM_NUM_GATES
    default 4

  config PARAM_GATE_HOMING_MAX
    default 200
  config PARAM_GATE_PRELOAD_HOMING_MAX
    default 200
  config PARAM_GATE_PARKING_DISTANCE
    default -30
  config PARAM_GATE_FINAL_EJECT_DISTANCE
    default 200


  if MMU_TYPE_QUATTRO_BOX_1_0
    config PARAM_VERSION
      default "1.0"

    config PARAM_GEAR_GEAR_RATIO
      default "50:17"
    config PARAM_GEAR_RUN_CURRENT
      default 1.27
    config PARAM_GEAR_HOLD_CURRENT
      default 0.2
    config PARAM_GEAR_HOMING_SPEED
      default 80

    config PARAM_GATE_ENDSTOP_TO_ENCODER
      default 18

    config PARAM_CHAIN_COUNT
      default 32
    config PARAM_COLOR_ORDER
      default "GRBW,GRBW,GRBW,GRBW,GRB,GRB,GRB,GRB,GRB,GRB,GRB,GRB,GRB,GRB,GRB,GRB,GRB,GRB,GRB,GRB,GRB,GRB,GRB,GRB,GRB,GRB,GRB,GRB,GRB,GRB,GRB,GRB"
    config PARAM_EXIT_LEDS
      default "neopixel:_$(UNIT_NAME)_leds (1-4)"
    config PARAM_STATUS_LEDS
      default "neopixel:_$(UNIT_NAME)_leds (5-14)"
    config PARAM_LOGO_LEDS
      default "neopixel:_$(UNIT_NAME)_leds (15-32)"

    comment "_"
  endif


  if MMU_TYPE_QUATTRO_BOX_1_1
    config PARAM_VERSION
      default "1.1"

    config PARAM_GEAR_GEAR_RATIO
      default "50:17"
    config PARAM_GEAR_RUN_CURRENT
      default 1.27
    config PARAM_GEAR_HOLD_CURRENT
      default 0.2
    config PARAM_GEAR_HOMING_SPEED
      default 80

    config PARAM_GATE_ENDSTOP_TO_ENCODER
      default 18

    config PARAM_CHAIN_COUNT
      default 36
    config PARAM_COLOR_ORDER
      default "GRBW,GRBW,GRBW,GRBW,GRBW,GRBW,GRBW,GRBW,GRB,GRB,GRB,GRB,GRB,GRB,GRB,GRB,GRB,GRB,GRB,GRB,GRB,GRB,GRB,GRB,GRB,GRB,GRB,GRB,GRB,GRB,GRB,GRB,GRB,GRB,GRB,GRB"
    config PARAM_EXIT_LEDS
      default "neopixel:_$(UNIT_NAME)_leds (2,4,6,8)"
    config PARAM_STATUS_LEDS
      default "neopixel:_$(UNIT_NAME)_leds (1,3,5,7)"
    config PARAM_LOGO_LEDS
      default "neopixel:_$(UNIT_NAME)_leds (9-36)"

    comment "_"
  endif


  # -------------------------------------
  # Latest v2 QuattroBox
  # -------------------------------------

  if MMU_TYPE_QUATTRO_BOX_2_0
    config PARAM_VERSION
      default "2.0"

    # v2 has custom mcu board
    choice BOARD_TYPE
      default BOARD_TYPE_CHAMELEON_X5_1_0
    endchoice

    # Heater: the Chameleon X5 board file supplies it as misc hardware
    config CUSTOM_HEATER_SETUP
      def_bool y if BOARD_TYPE_CHAMELEON_X5_1_0 && !MMU_HAS_PER_GATE_CONFIG
    config PARAM_FILAMENT_HEATER
      default "$(UNIT_NAME)_heater" if CUSTOM_HEATER_SETUP
    config PARAM_HEATER_FAN_HEATER_TEMP
      default 40.0
    config PARAM_HEATER_FAN_SHUTDOWN_SPEED
      default 0.0

    # Chamber sensor
    config PARAM_ENVIRONMENT_SENSOR
      default "$(UNIT_NAME)_Chamber"
    choice CHOICE_ENVIRONMENT_SENSOR_TYPE
      default CHOICE_ENVIRONMENT_SENSOR_TYPE_BME280
    endchoice

    config PARAM_GEAR_GEAR_RATIO
      default "1:1"
    config PARAM_GEAR_RUN_CURRENT
      default 0.9
    config PARAM_GEAR_HOLD_CURRENT
      default 0.2
    config PARAM_SYNC_GEAR_CURRENT
      default 40

    config PARAM_GEAR_LOAD_SPEED
      default 500
    config PARAM_GEAR_LOAD_ACCEL
      default 500
    config PARAM_GEAR_UNLOAD_SPEED
      default 500
    config PARAM_GEAR_UNLOAD_ACCEL
      default 500
    config PARAM_GEAR_SHORT_MOVE_ACCEL
      default 600
    config PARAM_GEAR_HOMING_SPEED
      default 50

    config PARAM_GATE_ENDSTOP_TO_ENCODER
      default 0
    config PARAM_BOWDEN_UNLOAD_HOMING_BUFFER
      default 50
    config PARAM_GATE_PRELOAD_PARKING_DISTANCE
      default 10 if CHOICE_GATE_PRELOAD_ENDSTOP_EXIT
    config PARAM_GATE_PRELOAD_ATTEMPTS
      default 5 if !CHOICE_GATE_PRELOAD_ENDSTOP_NONE

    config PARAM_CHAIN_COUNT
      default 38
    config PARAM_COLOR_ORDER
      default "GRBW,GRBW,GRBW,GRBW,GRBW,GRBW,GRBW,GRBW,GRB,GRB,GRB,GRB,GRB,GRB,GRB,GRB,GRB,GRB,GRB,GRB,GRB,GRB,GRB,GRB,GRB,GRB,GRB,GRB,GRB,GRB,GRB,GRB,GRB,GRB,GRB,GRB,GRB,GRB"
    config PARAM_EXIT_LEDS
      default "neopixel:_$(UNIT_NAME)_leds (1-4)"
    config PARAM_ENTRY_LEDS
      default "neopixel:_$(UNIT_NAME)_leds (8-5)"
    config PARAM_STATUS_LEDS
      default "neopixel:_$(UNIT_NAME)_leds (9-38)"
    config PARAM_LOGO_LEDS
      default ""
    choice CHOICE_ENTRY_EFFECT
      default CHOICE_ENTRY_EFFECT_GATE_STATUS
    endchoice

    comment "_"
  endif

endif # MMU_FAMILY_QUATTRO_BOX
```

## installer/mmu_types/Kconfig.vvd
```kconfig
config MMU_TYPE_VVD_1_0
  bool "BTT ViViD"
  select INDEXED_SELECTOR

  select MMU_HAS_LEDS
  select MMU_HAS_SENSOR_ENTRY
  select MMU_HAS_ENVIRONMENT_SENSOR
  select MMU_HAS_HEATER
  select MMU_HAS_NFC_READER
  select MMU_HAS_PER_GATE_NFC_READERS
  select UNSELECT_MMU_HAS_ESPOOLER        # Disable
  select UNSELECT_MMU_HAS_FILAMENT_BUFFER # Disable

  select BOOL_REQUIRE_BOWDEN_MOVE
  select UNSELECT_VARIABLE_BOWDEN_LENGTHS # Disable
  select UNSELECT_FILAMENT_ALWAYS_GRIPPED # Disable

  select DISABLE_NUM_GATES_OPTION         # Disable
  imply OPTION_VVD_BUFFER                 # Suggest


if MMU_TYPE_VVD_1_0
  config OPTION_VVD_BUFFER
    bool "BTT ViViD buffer"
    help
      Select if using the BTT ViViD brand buffer connected to the bowden tube using its
      integrated mcu. Don't select if using a different buffer system (instead add
      under MMU additions)
    select MMU_HAS_BUFFER_MCU
    select MMU_HAS_SENSOR_EXIT
    select MMU_HAS_SYNC_FEEDBACK_BUFFER
    select MMU_HAS_SENSOR_BUFFER_COMPRESSION
    select MMU_HAS_SENSOR_BUFFER_TENSION
    select UNSELECT_MMU_HAS_SENSOR_BUFFER_PROPORTIONAL

  if OPTION_VVD_BUFFER
    choice CHOICE_BUFFER_SPRING_STATE
      default CHOICE_BUFFER_SPRING_STATE_TENSION
    endchoice

    config PARAM_BUFFER_RANGE
      default 8
    config PARAM_BUFFER_MAXRANGE
      default 16
  endif
endif

if MMU_TYPE_VVD_1_0

  # MISC_HARDWARE configured these
  config CUSTOM_LED_SETUP
    def_bool y
  config CUSTOM_ENVIRONMENT_SENSOR_SETUP
    def_bool y
  config CUSTOM_HEATER_SETUP
    def_bool y
  config CUSTOM_NFC_READER_SETUP
    def_bool y

  if SHOW_MMU_ADDITIONS_WITH_TYPE
    source "Kconfig.mmu_additions"
  endif

  source "Kconfig.capabilities"

  ####################
  ##### Defaults #####
  ####################

  config PARAM_VENDOR
    default "VVD"
  config PARAM_VERSION
    default "1.0" 
  config PARAM_NUM_GATES
    default 4
  choice BOARD_TYPE
    default BOARD_TYPE_VVD_1_0
  endchoice

  config PARAM_SELECTOR_GATE_ORDER
    default "0, 3, 1, 2"

  config PARAM_GEAR_GEAR_RATIO
    default "1:1"
  config PARAM_GEAR_ROTATION_DISTANCE
    default 8.45
  config PARAM_GEAR_RUN_CURRENT
    default 0.7
  config PARAM_GEAR_HOLD_CURRENT
    default 0.1

  config PARAM_GEAR_HOMING_SPEED
    default 80

  config PARAM_SELECTOR_GEAR_RATIO
    default "25:10"
  config PARAM_SELECTOR_ROTATION_DISTANCE
    default 360
  config PARAM_SELECTOR_RUN_CURRENT
    default 0.8
  config PARAM_SELECTOR_HOLD_CURRENT
    default 0.3

  config PARAM_SELECTOR_MOVE_SPEED
    default 200

  config PARAM_GATE_HOMING_MAX
    default 800
  config PARAM_GATE_PARKING_DISTANCE
    default 10
  config PARAM_GATE_FINAL_EJECT_DISTANCE
    default 800
  
  config PARAM_CHAIN_COUNT
    default 28   
  config PARAM_COLOR_ORDER
    default "GRB"
  config PARAM_EXIT_LEDS 
    default "neopixel:$(UNIT_NAME)_leds_1 (1-14); neopixel:$(UNIT_NAME)_leds_2 (1-14)"

  config PARAM_ENVIRONMENT_SENSOR
    default "$(UNIT_NAME)_env_left"

  config PARAM_FILAMENT_HEATER
    default "$(UNIT_NAME)_heater"
  config PARAM_HEATER_MAX_TEMP
    default "75"

  config PARAM_NFC_READER_0
    default "$(UNIT_NAME)_nfc01"
  config PARAM_NFC_READER_1
    default "$(UNIT_NAME)_nfc01"
  config PARAM_NFC_READER_2
    default "$(UNIT_NAME)_nfc23"
  config PARAM_NFC_READER_3
    default "$(UNIT_NAME)_nfc23"

  config PARAM_NFC_GATE_JOG_SCAN_WINDOW
    default "-300, 200"
  config PARAM_NFC_PRELOAD_JOG_SCAN_WINDOW
    default "-300, 200"
  config PARAM_NFC_GATE_CLEAR_DISTANCE
    default -70
  config PARAM_NFC_PRELOAD_CLEAR_DISTANCE
    default -70
  config BOOL_NFC_NEIGHBOR_CHECK
    default y

  comment "_"

endif 
```

## installer/mmu_types/starters/Kconfig.everything
```kconfig
config MMU_CUSTOM_TYPE_EVERYTHING
  bool "Test config with everything"
  help 
    Select this custom starter config for testing or to create
    a fully populated set of klipper config files.
  select TESTING_SELECTOR
  select MULTIGEAR
  select MMU_HAS_BUFFER_MCU
  imply  MMU_HAS_ENCODER
  imply  MMU_HAS_ENVIRONMENT_SENSOR
  imply  MMU_HAS_ESPOOLER
  imply  MMU_HAS_HEATER
  imply  MMU_HAS_LEDS
  imply  MMU_HAS_FANS
  imply  MMU_HAS_SENSOR_EXTRUDER
  imply  MMU_HAS_SENSOR_SHARED_EXIT
  imply  MMU_HAS_SENSOR_GEAR_TOUCH
  imply  MMU_HAS_SENSOR_EXIT
  imply  MMU_HAS_SENSOR_ENTRY
  imply  MMU_HAS_SYNC_FEEDBACK_BUFFER
  imply  MMU_HAS_SENSOR_BUFFER_COMPRESSION
  imply  MMU_HAS_SENSOR_BUFFER_PROPORTIONAL
  imply  MMU_HAS_SENSOR_BUFFER_TENSION
  imply  MMU_HAS_SENSOR_TOOLHEAD
  imply  MMU_HAS_EJECT_BUTTONS
  imply  MMU_HAS_TOOLHEAD_CUTTER
  imply  MMU_HAS_GANTRY_BUMPER_SERVO
  imply  MMU_HAS_BLOBIFIER
  imply  MMU_HAS_SERVO_CUTTER

  imply  PARAM_HAS_BYPASS
  imply  PARAM_REQUIRE_BOWDEN_MOVE
  imply  PARAM_VARIABLE_ROTATION_DISTANCES
  imply  PARAM_VARIABLE_BOWDEN_LENGTHS
  imply  PARAM_FILAMENT_ALWAYS_GRIPPED

  imply  INSTALL_CLIENT_MACROS
  imply  INSTALL_12864_MENU

if MMU_CUSTOM_TYPE_EVERYTHING

  if SHOW_MMU_ADDITIONS_WITH_TYPE
    source "Kconfig.mmu_additions"
  endif

  source "Kconfig.capabilities"

  ####################
  ##### Defaults #####
  ####################

  config PARAM_VENDOR
    default "Other"
  config PARAM_VERSION
    default "1.0"
  config PARAM_NUM_GATES
    default 4

  comment "_"

endif 
```

## installer/sensors/Kconfig
```kconfig
# Force a logical order from mmu to extruder

menu "Filament sensors"
  help
    Specify any additional filament sensors you have incorporated here.
    This also allows for the installation of TMC stallguard based filament
    detection and homing option.

  rsource "Kconfig.entry"
  rsource "Kconfig.exit"
  rsource "Kconfig.shared_exit"
  rsource "Kconfig.gear_touch"

  config PARAM_REGISTER_MMU_SENSORS
    boolint "Register mmu sensors"
    default 1
    help
      Whether to register the sensors for visibility in klipper UI's
      and with QUERY_SENSOR command. There is no harm in doing this but
      it can be disabled to reduce clutter.
endmenu
```

## installer/servos/Kconfig.a0090
```kconfig
# GuoHua A0090 servo
# Used by ERCF v2/v3

if PARAM_VENDOR = "ERCF"

  config SERVO_TYPE_GUOHUA_A0090
    bool "GuoHua A0090"


  if SERVO_TYPE_GUOHUA_A0090

    config PARAM_SERVO_MIN_PULSE_WIDTH
      default 0.00050

    config PARAM_SERVO_MAX_PULSE_WIDTH
      default 0.00250

    config PARAM_SERVO_MAX_ANGLE
      default 180

    config PARAM_SERVO_UP_ANGLE
      default 30

    config PARAM_SERVO_MOVE_ANGLE
      default 50 if MMU_TYPE_ERCF_2_0 || MMU_TYPE_ERCF_3_0
      default PARAM_SERVO_UP_ANGLE

    config PARAM_SERVO_DOWN_ANGLE
      default 100

    config PARAM_SERVO_DURATION
      default 0.4

    config PARAM_SERVO_ALWAYS_ACTIVE
      default 0

  endif

endif
```

## installer/servos/Kconfig.dm996
```kconfig
# DM996 servo
# Used by LowRider

if PARAM_VENDOR = "LowRider"

  config SERVO_TYPE_DM996
    bool "DM996"

endif
```

## installer/toolheads/Kconfig.qidi_q2
```kconfig
config TOOLHEAD_TYPE_QIDI_Q2
  bool "QIDI Q2 Extruder"
  imply MMU_HAS_SENSOR_EXTRUDER
  imply MMU_HAS_TOOLHEAD_CUTTER

if TOOLHEAD_TYPE_QIDI_Q2
  config PARAM_TOOLHEAD_TYPE
    default "QIDI Q2 Extruder"
  config PARAM_TOOLHEAD_EXTRUDER_TO_NOZZLE
    default 72
  config PARAM_TOOLHEAD_SENSOR_TO_NOZZLE
    default 62
  config PARAM_TOOLHEAD_ENTRY_TO_EXTRUDER
    default 8
  config PARAM_TOOLHEAD_RESIDUAL_FILAMENT
    default 2
endif
```

## installer/toolheads/Kconfig.stealthburner_clockwork2_bambu_x1
```kconfig
config TOOLHEAD_TYPE_STEALTHBURNER_CLOCKWORK2_BAMBU_X1
  bool "Stealthburner Clockwork2 Bambu X1"

if TOOLHEAD_TYPE_STEALTHBURNER_CLOCKWORK2_BAMBU_X1
  config PARAM_TOOLHEAD_TYPE
    default "Stealthburner Clockwork2 Bambu X1"
  config PARAM_TOOLHEAD_EXTRUDER_TO_NOZZLE
    default 85
  config PARAM_TOOLHEAD_SENSOR_TO_NOZZLE
    default 75
  config PARAM_TOOLHEAD_ENTRY_TO_EXTRUDER
    default 13
  config PARAM_TOOLHEAD_RESIDUAL_FILAMENT
    default 22.5
endif
```

## installer/toolheads/Kconfig.stealthburner_g2e_bambu_x1
```kconfig
config TOOLHEAD_TYPE_STEALTHBURNER_G2E_BAMBU_X1
  bool "Stealthburner G2E Bambu X1"

if TOOLHEAD_TYPE_STEALTHBURNER_G2E_BAMBU_X1
  config PARAM_TOOLHEAD_TYPE
    default "Stealthburner G2E Bambu X1"
  config PARAM_TOOLHEAD_EXTRUDER_TO_NOZZLE
    default 99.5
  config PARAM_TOOLHEAD_SENSOR_TO_NOZZLE
    default 79.5
  config PARAM_TOOLHEAD_ENTRY_TO_EXTRUDER
    default 13.3
  config PARAM_TOOLHEAD_RESIDUAL_FILAMENT
    default 22.5
endif
```
