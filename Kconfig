## installer/Kconfig.addon_macros
```kconfig
# Defines parameter token types and defaults for macro addons
#
# Responsible for setting:
#   INSTALL_EREC_CUTTER
#     PIN_EREC_CUTTER_SERVO
#   INSTALL_12864_MENU
#   INSTALL_CLIENT_MACROS

menu "Addon macros"
  help
    Macro support for addons
    MMU functionality can be extended with popular addon macro options.
    Select which to include here

  config INSTALL_EREC_CUTTER
    help
      Enable for all servo based filament cutters on the MMU itself.
      EREC was the first example of this but this macro can work
      with other similar designs.
    bool "Install EREC filament cutter support?"

  if INSTALL_EREC_CUTTER
    config PIN_EREC_CUTTER_SERVO
      string "EREC filament cutter servo pin"
      default ""
  endif

  config INSTALL_12864_MENU
    bool "Install Mini 12864 display menu?"
    help
      Installs MMU menu for Mini 12864 display.
      Select only if printer has a Mini 12864 character display

  config INSTALL_CLIENT_MACROS
    bool "Install default client macros supplied with Happy Hare? (STRONGLY recommended)"
    default y
    help
      Includes the Happy Hare "client macros" with augmented pause/resume/cancel behavior.
      This is highly recommended and incorporates all functionality from popular alternatives
      like mainsail client macros but also works in conjunction with Happy Hare toolhead movement.

endmenu
```

## installer/Kconfig.eject_buttons
```kconfig
# Responsible for setting:
#   MMU_HAS_EJECT_BUTTONS
#
# Eject button parameter tokens which must be inside if MMU_HAS_EJECT_BUTTONS clause in cfg templates:
#   PIN_EJECT_BUTTON_<gate>
#
# Can be disabled and forced off with:
#   select UNSELECT_MMU_HAS_ENCODER


config UNSELECT_MMU_HAS_EJECT_BUTTONS
  def_bool n

if !UNSELECT_MMU_HAS_EJECT_BUTTONS
  comment "_"
  comment "_Eject Buttons"

  config MMU_HAS_EJECT_BUTTONS
    prompt "Has eject buttons?"
    forceshow
    default n
    help
      Some MMU designs have dedicated eject buttons. Select this
      option to allow pin editing and inclusion in config template
endif


# -------------------------------------
# Eject buttons config
# -------------------------------------

if MMU_HAS_EJECT_BUTTONS

  menu "Mmu eject buttons"
    @repeat var=i min=0 max=11@
      config PIN_EJECT_BUTTON_$(i)
        prompt "Eject button $(i) pin " if PARAM_NUM_GATES > $(i)
        help
          Leave blank if the gate doesn't have an eject button installed.
    @endrepeat@

  endmenu
endif
```

## installer/Kconfig.extruder
```kconfig
# Sets parameter tokens:
#   PARAM_EXTRUDER_NAME

config PARAM_EXTRUDER_NAME
  string "Extruder name"
  default "extruder"
  help
    Name of extruder attached to this MMU unit. Typically
    this is 'extruder' but you can connect different
    mmu units to different extuders
```

## installer/Kconfig.filament_speeds
```kconfig
# Filament movement speed used by gear stepper and extruder
#
# Responsible for setting:
#   PARAM_GEAR_HOMING_SPEED

menu "Filament speed"
# PAUL add more..
  config PARAM_GEAR_HOMING_SPEED
    string "Gear homing speed (mm/s)"
    default "50"
endmenu
```

## installer/Kconfig.motors
```kconfig
menu "Motors"

  comment 'v----- GEAR STEPPER -----v'
  
  config PARAM_GEAR_GEAR_RATIO
    string "Gear ratio"
    default "1:1"

  config PARAM_GEAR_ROTATION_DISTANCE
    string "Gear rotation distance"
    default "22.7316868"

  config PARAM_GEAR_RUN_CURRENT
    string "Gear run current"
    default "0.7"

  config PARAM_GEAR_HOLD_CURRENT
    string "Gear hold current"
    default "0.1"

  if MMU_HAS_SELECTOR
    comment 'v--- SELECTOR STEPPER ---v'

    config PARAM_SELECTOR_GEAR_RATIO
      string "Selector gear ratio"
      default "1:1"

    config PARAM_SELECTOR_ROTATION_DISTANCE
      string "Selector rotation distance"
      default "40"

    config PARAM_SELECTOR_RUN_CURRENT
      string "Selector run current"
      default "0.5"

    config PARAM_SELECTOR_HOLD_CURRENT
      string "Selector hold current"
      default "0.2"

    config PARAM_SELECTOR_ENDSTOP_NAME
      string
      default "mmu_sel_home"
  endif 

  if MMU_HAS_SERVO
    comment 'v---- SELECTOR SERVO ----v'

    config PARAM_SERVO_MAX_ANGLE
      int "Servo maximum angle"
      range 0 360
      default 180

    config PARAM_SERVO_MIN_PULSE_WIDTH
      string "Servo minimum pulse width"
      default "0.001"

    config PARAM_SERVO_MAX_PULSE_WIDTH
      string "Servo maximum pulse width"
      default "0.002"

    config PARAM_SERVO_UP_ANGLE
      int "Servo up angle"
      default 0

    config PARAM_SERVO_MOVE_ANGLE
      int "Servo move angle"
      default 0

    config PARAM_SERVO_DOWN_ANGLE
      int "Servo down angle"
      default 0

    config PARAM_SERVO_BUZZ_GEAR_ON_DOWN
      int "How often to buzz servo on down angle"
      default 1 

    config PARAM_SERVO_DURATION
      string "Servo duration"
      default "0.4" if LINEAR_SELECTOR
      default "0.5" if SERVO_SELECTOR

    config PARAM_SERVO_DWELL
      string "Servo dwell"
      default "0.5" if LINEAR_SELECTOR
      default "0.8" if SERVO_SELECTOR

    config BOOL_SERVO_ALWAYS_ACTIVE
      bool "Servo always active?"
      help
        This option will force the servo to always stay active. It can be dangerous on some
        on some designs or miscalibrated MMU because it strains the servo and control electronics.

        Recommend to disable unless you are sure you know you need it.
    config PARAM_SERVO_ALWAYS_ACTIVE
      int
      default 1 if BOOL_SERVO_ALWAYS_ACTIVE
      default 0

    config BOOL_SERVO_ACTIVE_DOWN
      bool "Servo active down"
      help
        This option will force the servo to stay active when in the down or gripped position. It can
        be dangerous on some designs or miscalibrated MMU because it strains the servo and control electronics.

        Recommend to disable unless you are sure you know you need it or your experience poor filament grip.
    config PARAM_SERVO_ACTIVE_DOWN
      int
      default 1 if BOOL_SERVO_ACTIVE_DOWN
      default 0
  endif 

endmenu
```

## installer/Kconfig.multi
```kconfig
# Addon Macro Features
rsource "addons/Kconfig"

# Popular software options
rsource "Kconfig.options"

menu "Printer (extruder/toolhead) sensors"
  help
    Printer Capabilities
    Here you can configure printer toolhead options such as sensors

  source "sensors/Kconfig.toolhead"
  source "sensors/Kconfig.extruder"

# PAUL
#  config MMU_HAS_SENSOR_TOOLHEAD
#    help
#      Select if you have a filament sensor inside of your toolhead after
#      the extruder drive. This is normally connected to a pin on your main
#      printer MCU so specify it here.
#    bool "Toolhead sensor?"
#
#  if MMU_HAS_SENSOR_TOOLHEAD
#    config PIN_TOOLHEAD_SENSOR
#      string "Toolhead sensor pin"
#      default "pinX"
#  endif
#
#  config MMU_HAS_SENSOR_EXTRUDER
#    help
#      Select if you have a filament sensor at or just prior to
#      the extruder entry. This is normally connected to a pin on your main
#      printer MCU so specify it here.
#    bool "Extruder (entry) sensor?"
#  
#  if MMU_HAS_SENSOR_EXTRUDER
#    config PIN_EXTRUDER_SENSOR
#      string "Extruder sensor pin"
#      default "pinX"
#  endif

endmenu

# Advanced install options
rsource "Kconfig.paths_services"
```

## installer/Kconfig.params
```kconfig
# Define MMU base capabilities excluding filament sensors. Each token has
# prefix "MMU_". These are not designed to be directly exposed in UI.
# Also allow editing of behavior parameters which are generally determined
# by MMU type but can be tuned, especially for custom designs.

config MMU_HAS_SELECTOR
  bool

config MMU_HAS_SERVO
  bool

config MMU_HAS_ENCODER
  bool

config MMU_HAS_SYNC_FEEDBACK_BUFFER
  bool

config MMU_HAS_ESPOOLER
  bool
config MMU_DISABLE_ESPOOLER_OPTION
  bool
  default n

config MMU_HAS_FILAMENT_BUFFER
  bool
config MMU_DISABLE_FILAMENT_BUFFER_OPTION
  bool
  default n

config MMU_HAS_LEDS
  bool

config PARAM_MISC_HARDWARE
  string
  default ""

# Future TODO: multi-mmu units can share the same buffer and encoder. For now assume one per unit
config PARAM_SYNC_FEEDBACK_BUFFER_NAME
  string
  default UNIT_NAME

config PARAM_ENCODER_NAME
  string
  default UNIT_NAME

menu "Design Attributes"
  source "Kconfig.selector_type" 

  config PARAM_HAS_BYPASS
    bool "Has filament bypass?"
    help
      Whether the MMU design has a built in bypass that can be selected (e.g. ERCF)

  config PARAM_VARIABLE_BOWDEN_LENGTHS
    bool "Variable bowden lengths?" 
    help
      Whether filament path from parked position in the gate to the extruder is different
      for each gate. Typically this is true of type-B designs but not true of type-A with
      Linear Selector and single bowden exit from the MMU.

  config PARAM_VARIABLE_ROTATION_DISTANCES
    bool "Variable rotation distances?"
    help
      Whether the design has different drive gears (typically BMG gears). Even if from
      the same vendor the rotation distance can vary, hence this option.

  config PARAM_REQUIRE_BOWDEN_MOVE
    bool "Require bowden move?"
    help
      Whether the design requires a calibrated fast bowden move to reach the extruder.
      This is not necessary if there is a filament splitter/combiner near the toolhead.

  config PARAM_FILAMENT_ALWAYS_GRIPPED
    bool "Filament always gripped?"

endmenu
```

## installer/Kconfig.raw
```kconfig
# Raw direct access to suggested parameters
# Generally grouped by sections of the .cfg files
# (Once user edits values here they are sticky and
# will override defaults)

menu "Raw Settings"
  help
    Raw Settings
    Allows override of designer defaults. Change these settings if you know
    what you are doing (or have MMU customizations). You can always change later
    by re-running "./install.sh -i" to run this editor (recommended) or by
    editing the generated klipper config files directly

  if !MULTI_UNIT_ENTRY_POINT
    source "Kconfig.extruder"
    source "Kconfig.num_gates"
  endif

  source "Kconfig.speeds"

  if !MULTI_UNIT_ENTRY_POINT
    source "Kconfig.gear_stepper"
    source "Kconfig.selector_stepper"
    source "Kconfig.selector_servo"
    source "sensors/Kconfig"
    source "Kconfig.endstops"
    source "Kconfig.gates"
    source "Kconfig.motor_sync"
    source "Kconfig.flowguard"
    source "Kconfig.calibration"
  endif
endmenu
```
