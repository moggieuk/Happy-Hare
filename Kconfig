## installer/Kconfig.sync_control
```kconfig
# This module is responsible for sync-feedback buffer and
# motor synchronization parameters:
#
#   PARAM_SYNC_TO_EXTRUDER
#   PARAM_SYNC_FORM_TIP
#   PARAM_SYNC_PURGE
#
#   PARAM_SYNC_FEEDBACK_BUFFER_NAME
#   PARAM_SYNC_FEEDBACK_ENABLE
#   PARAM_SYNC_FEEDBACK_BUFFER_RANGE
#   PARAM_SYNC_FEEDBACK_BUFFER_MAXRANGE

menu "MMU/Extruder sync"
  help
    Some MMU designs allow fine control over when the MMU stepper is
    synced with the extruder stepper. Synchronization helps to
    overcome friction in the filament path.

  if !FILAMENT_ALWAYS_GRIPPED
    config BOOL_ENABLE_SYNC_TO_EXTRUDER
      bool "Enable sync to extruder?"
      default y if FILAMENT_ALWAYS_GRIPPED
      help
        This controls whether the extruder and gear steppers are synchronized
        during printing operations.
    config PARAM_SYNC_TO_EXTRUDER
      int
      default 1 if BOOL_ENABLE_SYNC_TO_EXTRUDER
      default 0

    config BOOL_ENABLE_SYNC_FORM_TIP
      bool "Enable syncing while tip forming?"
      default y if ENABLE_SYNC_TO_EXTRUDER
      help
        This controls whether the extruder and gear steppers are synchronized
        during tip forming operation.
    config PARAM_SYNC_FORM_TIP
      int
      default 1 if BOOL_ENABLE_FORM_TIP
      default 0

    config BOOL_ENABLE_SYNC_PURGE
      bool "Enable syncing while purging?"
      default y if ENABLE_SYNC_TO_EXTRUDER
      help
        This controls whether the extruder and gear steppers are synchronized
        during purging operation.
    config PARAM_SYNC_PURGE
      int
      default 1 if BOOL_ENABLE_SYNC_PURGE
      default 0
  endif

  if MMU_HAS_SYNC_FEEDBACK_BUFFER
    config PARAM_SYNC_FEEDBACK_BUFFER_NAME
      string "Sync feedback buffer name"
      default UNIT_NAME

    config BOOL_ENABLE_SYNC_FEEDBACK
      bool "Enable sync feedback?"
      default y
      help
        Sync feedback will be used to dynamically adjust the gear stepper speed to
        match the extruder.
      depends on !FILAMENT_ALWAYS_GRIPPED
    config PARAM_SYNC_FEEDBACK_ENABLE
      int
      default 1 if BOOL_ENABLE_SYNC_FEEDBACK
      default 0

    config PARAM_SYNC_FEEDBACK_BUFFER_RANGE
      int "Sync feedback buffer (sensor) range"
      default "10"
      help
        Travel in "buffer" between compression/tension or one sensor and end:

        <------maxrange------>       <------maxrange------>       <------maxrange------>       <------maxrange------>
             <--range--->                  <----range----->       <----range----->                       <> range=0
        |====================|       |====================|       |====================|       |====================|
             ^          ^                  ^                                     ^                       ^^
        compression   tension        compression-only                      tension-only

    config PARAM_SYNC_FEEDBACK_BUFFER_MAXRANGE
      int "Sync feedback buffer max range"
      default "12"
      help
        The maximum distance the sync-feedback buffer can move from hard limit to hard limit:

        <------maxrange------>       <------maxrange------>       <------maxrange------>       <------maxrange------>
             <--range--->                  <----range----->       <----range----->                       <> range=0
        |====================|       |====================|       |====================|       |====================|
             ^          ^                  ^                                     ^                       ^^
        compression   tension        compression-only                      tension-only
  endif
endmenu
```

## installer/Kconfig.warnings
```kconfig
#
# Highlight common config warnings as comments
# This is not exhaustive by any means.
# It is just designed as an aid...
#


config SHOW_SHARED_WARNINGS
  bool
  depends on MULTI_UNIT_ENTRY_POINT || !MULTI_UNIT
  @repeat var=i min=1 max=3@
    default y if SW$(i)
  @endrepeat@

config SW1
    def_bool y if !INSTALL_CLIENT_MACROS

config SW2
    def_bool y if MMU_HAS_SENSOR_TOOLHEAD && PIN_TOOLHEAD_SENSOR = ""

config SW3
    def_bool y if MMU_HAS_SENSOR_EXTRUDER && PIN_EXTRUDER_SENSOR = ""


config SHOW_PER_UNIT_WARNINGS
  bool
  depends on !MULTI_UNIT_ENTRY_POINT
  @repeat var=i min=1 max=16@
    default y if W$(i)
  @endrepeat@

config W1
    def_bool y if MMU_CUSTOM

config W2
    def_bool y if BOARD_TYPE_OTHER

config W3
    def_bool y if CHOICE_TOOLHEAD_TYPE_OTHER

config W4
    def_bool y if PARAM_GATE_HOMING_ENDSTOP = ""

config W5
    def_bool n # Spare

config W6
    def_bool y if MMU_HAS_LEDS && PIN_NEOPIXEL = "" && !MMU_HAS_PER_GATE_MCU && !CUSTOM_LED_SETUP

config W7
    def_bool y if MMU_HAS_FANS && PIN_FAN = "" && !MMU_HAS_PER_GATE_MCU

config W8
    def_bool y if MMU_HAS_ENCODER && PIN_ENCODER = "" && !MMU_SHARED_ENCODER

config W9
    def_bool y if MMU_HAS_SENSOR_SHARED_EXIT && PIN_SHARED_EXIT_SENSOR = ""

config W10
    def_bool y if MMU_HAS_SENSOR_BUFFER_TENSION && PIN_BUFFER_TENSION = "" && !MMU_SHARED_SYNC_FEEDBACK_BUFFER

config W11
    def_bool y if MMU_HAS_SENSOR_BUFFER_COMPRESSION && PIN_BUFFER_COMPRESSION = "" && !MMU_SHARED_SYNC_FEEDBACK_BUFFER

config W12
    def_bool y if MMU_HAS_SENSOR_BUFFER_PROPORTIONAL && PIN_BUFFER_ANALOG = "" && !MMU_SHARED_SYNC_FEEDBACK_BUFFER

config W13
    def_bool y if MMU_HAS_HEATERS && PARAM_FILAMENT_HEATER = "" && PARAM_FILAMENT_HEATERS = ""

config W14
    def_bool y if MMU_HAS_ENVIRONMENT_SENSOR && PARAM_ENVIRONMENT_SENSOR = "" && PARAM_ENVIRONMENT_SENSORS = ""

config W15
    def_bool y if MMU_HAS_SYNC_FEEDBACK_BUFFER && !MMU_SHARED_SYNC_FEEDBACK_BUFFER && !(MMU_HAS_SENSOR_BUFFER_TENSION || MMU_HAS_SENSOR_BUFFER_COMPRESSION || MMU_HAS_SENSOR_BUFFER_PROPORTIONAL)

config W16
    def_bool y if MMU_HAS_SYNC_FEEDBACK_BUFFER && !MMU_SHARED_SYNC_FEEDBACK_BUFFER && (MMU_HAS_SENSOR_BUFFER_TENSION || MMU_HAS_SENSOR_BUFFER_COMPRESSION) && MMU_HAS_SENSOR_BUFFER_PROPORTIONAL



if SHOW_PER_UNIT_WARNINGS || SHOW_SHARED_WARNINGS
  comment "_"
  comment "_Config Warnings / Errors"

  if SHOW_SHARED_WARNINGS
    comment "Caution: You opted to not install client macros [Software Options]"  if SW1
    comment "Toolhead sensor is enabled but no MCU pin defined"                   if SW2
    comment "Extruder sensor is enabled but no MCU pin defined"                   if SW3
  endif

  if SHOW_PER_UNIT_WARNINGS
    comment "Custom MMU selected. You will need to carefully check configuration" if W1
    comment "Unknown MCU board selected. You will need to configure all pins"     if W2
    comment "Toolhead type is 'other'. Are you sure yours is not listed?"         if W3
    comment "No gate homing endstop configured"                                   if W4
    comment "-unused-"                                                            if W5
    comment "Leds are enabled but no MCU pin defined"                             if W6
    comment "Fans are enabled but no MCU pin defined"                             if W7
    comment "Encoder is enabled but no MCU pin defined"                           if W8
    comment "Shared exit sensor is enabled but no MCU pin defined"                if W9
    comment "Buffer tension switch is enabled but no MCU pin defined"             if W10
    comment "Buffer compression switch is enabled but no MCU pin defined"         if W11
    comment "Buffer proportional feedback enabled but no analog MCU pin defined"  if W12
    comment "MMU heater is enabled but heater name(s) not defined"                if W13
    comment "MMU environment sensor is enabled but sensor name(s) not defined"    if W14
    comment "Sync-feedback buffer configured but it had no sensors defined"       if W15
    comment "Warning: Sync-feedback buffer configured with both analog and digital inputs" if W16
  endif
endif
```

## installer/addons/Kconfig
```kconfig
menu "Addon Macros"
  help
    Macro support for addons
    MMU functionality can be extended with popular addon macro options.
    Select which to include here and configure pins and features.

  rsource "Kconfig.*"
endmenu
```

## installer/addons/Kconfig.blobifier
```kconfig
config ADDON_BLOBIFIER
  help
    Enable this if you have a Blobifer (or derivative) purging system.
  bool "Enable Blobifier support?"

if ADDON_BLOBIFIER
  menu "Blobifier pins"
    config PIN_BLOBIFIER_SERVO
      string "Blobifier servo pin"
      default ""

    config PIN_BLOBIFIER_BUCKET_SWITCH
      string "Blobifier bucket switch pin"
      default ""
  endmenu
endif
```

## installer/addons/Kconfig.eject_buttons
```kconfig
config ADDON_EJECT_BUTTONS
  help
    Enable if you have dedicated eject buttons on each gate. Note that
    The pin connections will still need to be setup in the macro.
  bool "Enable eject buttons support?"

if ADDON_EJECT_BUTTONS
  menu "Eject button pins"

    config PIN_EJECT_BUTTON_0
      string "Eject button gate 0"
      depends on PARAM_NUM_GATES >= 1

    config PIN_EJECT_BUTTON_1
      string "Eject button gate 1"
      depends on PARAM_NUM_GATES >= 2

    config PIN_EJECT_BUTTON_2
      string "Eject button gate 2"
      depends on PARAM_NUM_GATES >= 3

    config PIN_EJECT_BUTTON_3
      string "Eject button gate 3"
      depends on PARAM_NUM_GATES >= 4

    config PIN_EJECT_BUTTON_4
      string "Eject button gate 4"
      depends on PARAM_NUM_GATES >= 5

    config PIN_EJECT_BUTTON_5
      string "Eject button gate 5"
      depends on PARAM_NUM_GATES >= 6

    config PIN_EJECT_BUTTON_6
      string "Eject button gate 6"
      depends on PARAM_NUM_GATES >= 7

    config PIN_EJECT_BUTTON_7
      string "Eject button gate 7"
      depends on PARAM_NUM_GATES >= 8

    config PIN_EJECT_BUTTON_8
      string "Eject button gate 8"
      depends on PARAM_NUM_GATES >= 9

    config PIN_EJECT_BUTTON_9
      string "Eject button gate 9"
      depends on PARAM_NUM_GATES >= 10

    config PIN_EJECT_BUTTON_10
      string "Eject button gate 10"
      depends on PARAM_NUM_GATES >= 11

    config PIN_EJECT_BUTTON_11
      string "Eject button gate 11"
      depends on PARAM_NUM_GATES >= 12

  endmenu
endif
```

## installer/addons/Kconfig.erec_cutter
```kconfig
config ADDON_EREC_CUTTER
  help
    Enable for all servo based filament cutters on the MMU itself.
    EREC was the first example of this but this macro can work
    with other similar designs.
  bool "Enable EREC filament cutter support?"

if ADDON_EREC_CUTTER
  menu "EREC filament cutter pins"
    config PIN_EREC_CUTTER_SERVO
      string "EREC filament cutter servo pin"
      default ""
  endmenu
endif
```

## installer/boards/Kconfig
```kconfig
config PARAM_BOARD_TYPE
  string

choice CHOICE_BOARD_TYPE
  prompt "Board type"
  default BOARD_TYPE_OTHER
  help 
    MCU type
    Select the type of mcu board you are using. This will configure
    the default pin layout for your setup. After selecting board
    pins can be customized in Advanced Settings.

  if !MMU_TYPE_KMS_1_0 && ! MMU_TYPE_VVD_1_0
    rsource "Kconfig.*"

    config BOARD_TYPE_OTHER
      bool "Not listed / Other"
      select OVERRIDE_PINS # Force user to define pins
  endif

  # KMS has custom mcu
  if MMU_TYPE_KMS_1_0
    rsource "custom/Kconfig.kms"
  endif

  # ViViD has custom mcu
  if MMU_TYPE_VVD_1_0
    rsource "custom/Kconfig.vvd"
  endif
endchoice
```

## installer/boards/Kconfig.afc_lite_1
```kconfig
config BOARD_TYPE_AFC_LITE_1_0
  bool "AFC Lite v1.0"

if BOARD_TYPE_AFC_LITE_1_0
  config PARAM_BOARD_TYPE
    default "AFC_LITE_1"

  choice CHOICE_SERIAL_DEVICE
    default $(serial_config,1,stm32)
  endchoice

  config PIN_GEAR_UART 
    default "$(MMU_MCU):PD5" 
  config PIN_GEAR_STEP
    default "$(MMU_MCU):PD4" 
  config PIN_GEAR_DIR
    default "$(MMU_MCU):PD3" 
  config PIN_GEAR_ENABLE
    default "!$(MMU_MCU):PD6" 
  config PIN_GEAR_DIAG
    default "$(MMU_MCU):PD2" 

  config PIN_GEAR_UART_1 
    default "$(MMU_MCU):PD0" 
  config PIN_GEAR_STEP_1
    default "$(MMU_MCU):PC12" 
  config PIN_GEAR_DIR_1
    default "$(MMU_MCU):PC11" 
  config PIN_GEAR_ENABLE_1
    default "!$(MMU_MCU):PD1" 
  config PIN_GEAR_DIAG_1
    default "$(MMU_MCU):PC10" 

  config PIN_GEAR_UART_2 
    default "$(MMU_MCU):PE1" 
  config PIN_GEAR_STEP_2
    default "$(MMU_MCU):PE2" 
  config PIN_GEAR_DIR_2
    default "$(MMU_MCU):PE3" 
  config PIN_GEAR_ENABLE_2
    default "!$(MMU_MCU):PE0" 
  config PIN_GEAR_DIAG_2
    default "$(MMU_MCU):PE4" 

  config PIN_GEAR_UART_3 
    default "$(MMU_MCU):PC6" 
  config PIN_GEAR_STEP_3
    default "$(MMU_MCU):PD15" 
  config PIN_GEAR_DIR_3
    default "$(MMU_MCU):PD14" 
  config PIN_GEAR_ENABLE_3
    default "!$(MMU_MCU):PC7" 
  config PIN_GEAR_DIAG_3
    default "$(MMU_MCU):PC8" 

  config PIN_PRE_GATE_0
    default "^$(MMU_MCU):PC5" 
  config PIN_PRE_GATE_1
    default "^$(MMU_MCU):PB0" 
  config PIN_PRE_GATE_2
    default "^$(MMU_MCU):PB1" 
  config PIN_PRE_GATE_3
    default "^$(MMU_MCU):PB2" 

  config PIN_GEAR_SENSOR_0
    default "^$(MMU_MCU):PE8" 
  config PIN_GEAR_SENSOR_1
    default "^$(MMU_MCU):PE9" 
  config PIN_GEAR_SENSOR_2
    default "^$(MMU_MCU):PE10" 
  config PIN_GEAR_SENSOR_3
    default "^$(MMU_MCU):PE11" 

  config PIN_ESPOOLER_EN_0
    default "$(MMU_MCU):PA2" 
  config PIN_ESPOOLER_RWD_0
    default "$(MMU_MCU):PA0" 
  config PIN_ESPOOLER_FWD_0
    default "$(MMU_MCU):PA1" 

  config PIN_ESPOOLER_EN_1
    default "$(MMU_MCU):PA5" 
  config PIN_ESPOOLER_RWD_1
    default "$(MMU_MCU):PA6" 
  config PIN_ESPOOLER_FWD_1
    default "$(MMU_MCU):PA7" 

  config PIN_ESPOOLER_EN_2
    default "$(MMU_MCU):PB13" 
  config PIN_ESPOOLER_RWD_2
    default "$(MMU_MCU):PB14" 
  config PIN_ESPOOLER_FWD_2
    default "$(MMU_MCU):PB15" 

  config PIN_ESPOOLER_EN_3
    default "$(MMU_MCU):PD11" 
  config PIN_ESPOOLER_RWD_3
    default "$(MMU_MCU):PD12" 
  config PIN_ESPOOLER_FWD_3
    default "$(MMU_MCU):PD13" 

  config PIN_NEOPIXEL
    default "$(MMU_MCU):PE14"
  config PIN_GATE_SENSOR
    default "^$(MMU_MCU):PC4"
endif
```
