## installer/Kconfig.selector_servo
```kconfig
# Selector servo parameter tokens which must be inside
# if MMU_HAS_SELECTOR_SERVO clause in cfg templates
#
# Responsible for setting:
#   PARAM_SERVO_MIN_PULSE_WIDTH
#   PARAM_SERVO_MAX_PULSE_WIDTH
#   PARAM_SERVO_MAXIMUM_ANGLE
#   PARAM_SERVO_ALWAYS_ACTIVE
#   PARAM_SERVO_DURATION
#   PARAM_SERVO_DWELL
#
# Optionally depending on selector type:
#   PARAM_SERVO_UP_ANGLE
#   PARAM_SERVO_MOVE_ANGLE
#   PARAM_SERVO_DOWN_ANGLE
#   PARAM_SERVO_ACTIVE_DOWN
#
#   PARAM_SERVO_GATE_ANGLES
#   PARAM_SERVO_RELEASE_ANGLE
#   PARAM_SERVO_BYPASS_ANGLE
#   PARAM_SERVO_MIN_ANGLE
#   PARAM_SERVO_MAX_ANGLE

if MMU_HAS_SELECTOR_SERVO

  menu "Selector servo"

    config PARAM_SERVO_MIN_PULSE_WIDTH
      float "Servo min pulse width"
      default 0.001

    config PARAM_SERVO_MAX_PULSE_WIDTH
      float "Servo max pulse width"
      default 0.002

    config PARAM_SERVO_MAXIMUM_ANGLE
      int "Servo h/w max angle  "
      range 0 360
      default 180
      help
        Klipper scales the PWM pulse width to never exceed this angle

    config PARAM_SERVO_DWELL
      float "Servo dwell          "
      default 0.5 if LINEAR_SELECTOR
      default 0.8 if SERVO_SELECTOR
      default 0.5
      help
        How long to wait in seconds for the servo to move into position.
        This avoids subsequent operations from happening before
        movement is complete

    config BOOL_SERVO_ALWAYS_ACTIVE
      bool "Servo always active?"
      help
        This option will force the servo to always stay active. It can be dangerous on some
        on some designs or miscalibrated MMU because it strains the servo and control electronics.

        Recommend to disable unless you are sure you know you need it.
    config PARAM_SERVO_ALWAYS_ACTIVE
      int
      default 1 if BOOL_SERVO_ALWAYS_ACTIVE
      default 0

    config PARAM_SERVO_DURATION
      float "Servo PWM duration   "
      default 0.4 if LINEAR_SELECTOR
      default 0.5 if SERVO_SELECTOR
      default 0.4
      help
        Duration of servo PWM signal if not always active


# -------------------------------------
# LinearServoSelector
# -------------------------------------

    if LINEAR_SERVO_SELECTOR || TESTING_SELECTOR

      comment "_"
      comment "_Filament grip control"

      config BOOL_SERVO_ACTIVE_DOWN
        bool "Servo active down"
        help
          This option will force the servo to stay active just when in the down or gripped position.
          It can be dangerous on some designs or miscalibrated MMU because it strains the servo
          and control electronics.

          Recommend to disable unless you are sure you know you need it or your experience poor filament grip.
      config PARAM_SERVO_ACTIVE_DOWN
        int
        default 1 if BOOL_SERVO_ACTIVE_DOWN
        default 0
    endif

    if LINEAR_SERVO_SELECTOR || TESTING_SELECTOR
        config PARAM_SERVO_UP_ANGLE
          int "Servo up angle       "
          default 0
          help
            Position of the servo up (filament released) position.

        config PARAM_SERVO_MOVE_ANGLE
          int "Servo move angle     "
          default PARAM_SERVO_UP_ANGLE
          help
            Position of the servo for selector movement.
            Often this is the same as the up setting but on some
            designs like ERCF this position also passively
            holds the filament.

        config PARAM_SERVO_DOWN_ANGLE
          int "Servo down angle     "
          default 0
          help
            Position of the servo down (filament gripped) position.

        config PARAM_SERVO_BUZZ_GEAR_ON_DOWN
          int "Buzz servo on down   "
          default 1
          help
            How often to buzz servo on down angle
    endif


# -------------------------------------
# ServoSelector
# -------------------------------------

    if SERVO_SELECTOR || TESTING_SELECTOR

      comment "_"
      comment "_Gate positions"

      config PARAM_SERVO_GATE_ANGLES
        string "Servo gate angles    "
        default "0, 180"                    if PARAM_NUM_GATES = 2
        default "0, 120, 240"               if PARAM_NUM_GATES = 3
        default "0, 90, 180, 270"           if PARAM_NUM_GATES = 4
        default "0, 72, 144, 216, 288"      if PARAM_NUM_GATES = 5
        default "0, 60, 120, 180, 240, 300" if PARAM_NUM_GATES = 6
        default ""
        help
          CAUTION: default settings assume a 360 degree movement!
          Specify a list of angles representing the initial gate positions. This can avoid
          calibration but typically calibrated values (saved in 'mmu_vars.cfg') would override
          this setting.
          You may leave it blank to force user calibration.

      config PARAM_SERVO_RELEASE_ANGLE
        int "Servo release angle  "
        default -1
        help
          Optional specific servo position to allow release of filament
          Leave at '-1' for default bahavior of selecting angle half way between gates
          Can be overriden by calibrated value saved in 'mmu_vars.cfg'

      config PARAM_SERVO_BYPASS_ANGLE
        int "Servo bypass angle   "
        default -1
        help
          Optional servo position for bypass gate.
          Leave at '-1' if not supported.
          Can be overriden by calibrated value saved in 'mmu_vars.cfg'

      config PARAM_SERVO_MIN_ANGLE
        int "Servo selector min   "
        range 0 360
        default 0
        help
          Happy Hare will never move the server past this minimum configured angle

      config PARAM_SERVO_MAX_ANGLE
        int "Servo selector max   "
        range 0 360
        default 360
        help
          Happy Hare will never move the server past this mximum configured angle


    endif

  endmenu
endif
```

## installer/Kconfig.selector_type
```kconfig
# The choice menu is only used for custom MMU types.
# All other types should directly set a selector by enabling exactly one
# helper flag, similar to:
#   "select LINEAR_SERVO_SELECTOR"
#
# Defines parameter tokens:
#   PARAM_SELECTOR_TYPE

choice CHOICE_SELECTOR_TYPE 
  prompt "Selector type?"
  depends on MMU_CUSTOM
  default CHOICE_SELECTOR_TYPE_VIRTUAL_SELECTOR
  help
    This must be a valid selector class that matches the control required by
    your MMU design. Use VirtualSelector for all type-b designs.

  config CHOICE_SELECTOR_TYPE_LINEAR_SELECTOR
    bool "LinearSelector" 
    help
      This uses stepper for linear movement without servo

  config CHOICE_SELECTOR_TYPE_LINEAR_SERVO_SELECTOR
    bool "LinearServoSelector" 
    help
      This uses stepper for linear movement and servo for filament gripping

  config CHOICE_SELECTOR_TYPE_LINEAR_MUTLI_GEAR_SELECTOR
    bool "LinearMultiGearSelector" 
    help
      Use this for type-C MMU designs with separate gear motors and a stepper
      for gate selection

  config CHOICE_SELECTOR_TYPE_ROTARY_SELECTOR
    bool "RotarySelector"
    help
      This is a special selector for 3D-Chameleon which can select opposing gates and also
      causes the gear movement to be reversed

  config CHOICE_SELECTOR_TYPE_MACRO_SELECTOR
    bool "MacroSelector" 
    help
      Universal selector that uses user defined macros for the selection process.

  config CHOICE_SELECTOR_TYPE_SERVO_SELECTOR
    bool "ServoSelector" 
    help
      This uses a servo (and usually a cam mechanism) to select. Filament can optionally
      be unselected by selecting an opposing gate or moving to designated position.

  config CHOICE_SELECTOR_TYPE_INDEXED_SELECTOR
    bool "IndexedSelector"
    help
      This uses a stepper motor for selection and relies on specific homing sensors for
      each gate (e.g. BTT ViViD).

  config CHOICE_SELECTOR_TYPE_VIRTUAL_SELECTOR
    bool "VirtualSelector"
    help
      Use this for type-B MMU designs without a selector but instead separate gear motors
endchoice


# Because these don't have a prompt they will always follow the default value
# So they will not stay incorrectly selected when switching between MMU types
config VIRTUAL_SELECTOR
  def_bool CHOICE_SELECTOR_TYPE_VIRTUAL_SELECTOR

config LINEAR_SELECTOR
  def_bool CHOICE_SELECTOR_TYPE_LINEAR_SELECTOR
  select MMU_HAS_SELECTOR_STEPPER

config LINEAR_SERVO_SELECTOR
  def_bool CHOICE_SELECTOR_TYPE_LINEAR_SERVO_SELECTOR
  select MMU_HAS_SELECTOR_STEPPER
  select MMU_HAS_SELECTOR_SERVO

config LINEAR_MUTLI_GEAR_SELECTOR
  def_bool CHOICE_SELECTOR_TYPE_LINEAR_MULTI_GEAR_SELECTOR
  select MMU_HAS_SELECTOR_STEPPER

config ROTARY_SELECTOR
  def_bool CHOICE_SELECTOR_TYPE_ROTARY_SELECTOR
  select MMU_HAS_SELECTOR_STEPPER

config MACRO_SELECTOR
  def_bool CHOICE_SELECTOR_TYPE_MACRO_SELECTOR

config SERVO_SELECTOR
  def_bool CHOICE_SELECTOR_TYPE_SERVO_SELECTOR
  select MMU_HAS_SELECTOR_SERVO

config INDEXED_SELECTOR
  def_bool CHOICE_SELECTOR_TYPE_INDEXED_SELECTOR
  select MMU_HAS_SELECTOR_STEPPER

# Special for testing full config
config TESTING_SELECTOR
  def_bool n
  select MMU_HAS_SELECTOR_STEPPER
  select MMU_HAS_SELECTOR_SERVO


config PARAM_SELECTOR_TYPE
  string
  default "VirtualSelector"         if VIRTUAL_SELECTOR
  default "LinearSelector"          if LINEAR_SELECTOR
  default "LinearServoSelector"     if LINEAR_SERVO_SELECTOR
  default "LinearMultiGearSelector" if LINEAR_MULTI_GEAR_SELECTOR
  default "RotarySelector"          if ROTARY_SELECTOR
  default "MacroSelector"           if MACRO_SELECTOR
  default "ServoSelector"           if SERVO_SELECTOR
  default "IndexedSelector"         if INDEXED_SELECTOR
  default "Testing"                 if TESTING_SELECTOR # For testing
  default "VirtualSelector"         # Safety
```

## installer/Kconfig.sensors
```kconfig
# Force a logical order from mmu to extruder
source "sensors/Kconfig.entry"
source "sensors/Kconfig.exit"
source "sensors/Kconfig.shared_exit"
source "sensors/Kconfig.sync_feedback"
source "sensors/Kconfig.gear_touch"
if !MULTI_UNIT || MULTI_UNIT_ENTRY_POINT
  source "sensors/Kconfig.extruder"
  source "sensors/Kconfig.toolhead"
endif
```

## installer/Kconfig.serial
```kconfig
# Make the first 10 available serial tty devices selectable, it's unlikely people have more.
# And if they do, they probably know what they are doing and have no issue manually selecting it.
# Not the prettiest configuration, but it works
choice CHOICE_SERIAL_DEVICE 
  help
    Step 5 - MCU connection
    Specify the path of the serial device connected to the MMU MCU.
    It's best to use the /dev/serial/by-id/ path, as it's unique and
    doesn't change when you plug in multiple serial devices.
    Example: /dev/serial/by-id/usb-Klipper_MCU_12345678-if00
    (CANbus must be configured manually by editing config files)
  prompt "Select MCU serial device"
  depends on $(serial_exists,1) # Only show if there are any serial tty devices to select. Likely an issue with the setup

  config $(serial_config,1)
    bool "$(serial,1)"
    depends on $(serial_exists,1)
  config $(serial_config,2)
    bool "$(serial,2)"
    depends on $(serial_exists,2)
  config $(serial_config,3)
    bool "$(serial,3)"
    depends on $(serial_exists,3)
  config $(serial_config,4)
    bool "$(serial,4)"
    depends on $(serial_exists,4)
  config $(serial_config,5)
    bool "$(serial,5)"
    depends on $(serial_exists,5)
  config $(serial_config,6)
    bool "$(serial,6)"
    depends on $(serial_exists,6)
  config $(serial_config,7)
    bool "$(serial,7)"
    depends on $(serial_exists,7)
  config $(serial_config,8)
    bool "$(serial,8)"
    depends on $(serial_exists,8)
  config $(serial_config,9)
    bool "$(serial,9)"
    depends on $(serial_exists,9)
  config $(serial_config,10)
    bool "$(serial,10)"
    depends on $(serial_exists,10)
  config PARAM_SERIAL_OTHER
    bool "Other Manually Entered"
endchoice

config PARAM_SERIAL
  string
  prompt "MCU serial device path" if PARAM_SERIAL_OTHER || !$(serial_exists,1)
  help
    Step 5 - MCU connection
    Specify the path of the serial device connected to the MMU MCU.
    It's best to use the /dev/serial/by-id/ path, as it's unique and
    doesn't change when you plug in multiple serial devices.
    Example: /dev/serial/by-id/usb-Klipper_MCU_12345678-if00
    (CANbus must be configured manually by editing config files)
  default "$(serial,1)" if $(serial_config,1)
  default "$(serial,2)" if $(serial_config,2)
  default "$(serial,3)" if $(serial_config,3)
  default "$(serial,4)" if $(serial_config,4)
  default "$(serial,5)" if $(serial_config,5)
  default "$(serial,6)" if $(serial_config,6)
  default "$(serial,7)" if $(serial_config,7)
  default "$(serial,8)" if $(serial_config,8)
  default "$(serial,9)" if $(serial_config,9)
  default "$(serial,10)" if $(serial_config,10)
```

## installer/Kconfig.shared
```kconfig
config PIN_EXTRUDER_SENSOR
 string "Extruder sensor pin"

config PIN_TOOLHEAD_SENSOR
 string "Toolhead sensor pin"

config PIN_SYNC_FEEDBACK_TENSION
 string "Sync feedback tension pin"

config PIN_SYNC_FEEDBACK_COMPRESSION
 string "Sync feedback compression pin"
```

## installer/Kconfig.shared_pins
```kconfig
# Responsible for defining "PIN_*" parameters that are "per-printer"
# rather than per-mmu in a multi unit setup.
#
# Responsible for setting:
#   PIN_TOOLHEAD_SENSOR
#   PIN_EXTRUDER_SENSOR
#   PIN_GANTRY_BUMPER_SERVO
#   PIN_BLOBIFIER_SERVO
#   PIN_BLOBIFIER_BUCKET_SWITCH
#   PIN_SERVO_CUTTER_SERVO


if MULTI_UNIT_ENTRY_POINT || !MULTI_UNIT

# -------------------------------------
# Toolhead sensors
# -------------------------------------

  config PIN_TOOLHEAD_SENSOR
    prompt "Toolhead sensor pin   " if MMU_HAS_SENSOR_TOOLHEAD

  config PIN_EXTRUDER_SENSOR
    prompt "Extruder sensor pin   " if MMU_HAS_SENSOR_EXTRUDER


# -------------------------------------
# Misc servos, etc
# -------------------------------------

  if MMU_HAS_GANTRY_BUMPER_SERVO || MMU_HAS_BLOBIFIER || MMU_HAS_SERVO_CUTTER

    comment "_"
    comment "_Additional hardware"

    config PIN_GANTRY_BUMPER_SERVO
      prompt "Gantry servo pin      " if MMU_HAS_GANTRY_BUMPER_SERVO
      help
        Optional. Used to deploy fold-down "bumper" for tip cutting
        when using a toolhead mounted filament cutting blade

    config PIN_BLOBIFIER_SERVO
      prompt "Blobifer servo pin    " if MMU_HAS_BLOBIFIER && CHOICE_BLOBIFIER_TYPE_SERVO

    config PIN_BLOBIFIER_BUCKET_SWITCH
      prompt "Blobifer bucket switch" if MMU_HAS_BLOBIFIER

    config PIN_SERVO_CUTTER_SERVO
      prompt "Cutting servo pin     " if MMU_HAS_SERVO_CUTTER

  endif

endif
```

## installer/Kconfig.sync
```kconfig
if !FILAMENT_ALWAYS_GRIPPED

  config ENABLE_SYNC_TO_EXTRUDER
    bool "Enable sync to extruder?"
    help
      This controls whether the extruder and gear steppers are synchronized during printing operations
  config PARAM_SYNC_TO_EXTRUDER
    int
    default 1 if ENABLE_SYNC_TO_EXTRUDER
    default 0

  config ENABLE_SYNC_FORM_TIP
    bool "Enable syncing while tip forming?"
    default y if ENABLE_SYNC_TO_EXTRUDER
    help
      This controls whether the extruder and gear steppers are synchronized during tip forming operation
  config PARAM_SYNC_FORM_TIP
    int
    default 1 if ENABLE_FORM_TIP
    default 0

  config ENABLE_SYNC_PURGE
    bool "Enable syncing while purging?"
    default y if ENABLE_SYNC_TO_EXTRUDER
    help
      This controls whether the extruder and gear steppers are synchronized during purging operation
  config PARAM_SYNC_PURGE
    int
    default 1 if ENABLE_SYNC_PURGE
    default 0

endif

config ENABLE_SYNC_FEEDBACK
  bool "Enable sync feedback?"
  help
    Sync feedback will be used to dynamically adjust the gear stepper speed to match the extruder
  depends on MMU_HAS_SYNC_FEEDBACK && (ENABLE_SYNC_TO_EXTRUDER || FILAMENT_ALWAYS_GRIPPED)
config PARAM_SYNC_FEEDBACK
  int
  default 1 if ENABLE_SYNC_FEEDBACK
  default 0
```
