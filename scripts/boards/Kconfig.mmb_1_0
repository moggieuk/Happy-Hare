## scripts/boards/Kconfig.mmb_1_0
```kconfig
choice CHOICE_BOARD_TYPE
  config BOARD_TYPE_MMB_1_0
    bool "BTT MMB v1.0 (with CANbus)"
endchoice

choice CHOICE_SERIAL_DEVICE
  default $(serial_config,1,stm32)
endchoice

if BOARD_TYPE_MMB_1_0
  config PARAM_BOARD_TYPE
    default "MMB10"

  config PIN_GEAR_UART 
    default "PA10" 
  config PIN_GEAR_STEP
    default "PB15" 
  config PIN_GEAR_DIR
    default "PB14" 
  config PIN_GEAR_ENABLE
    default "PA8" 
  config PIN_GEAR_DIAG
    default "PA3" 

  if PARAM_SELECTOR_TYPE = "VirtualSelector"
    config PIN_GEAR_1_UART 
      default "PC7" 
    config PIN_GEAR_1_STEP
      default "PD2" 
    config PIN_GEAR_1_DIR
      default "PB13" 
    config PIN_GEAR_1_ENABLE
      default "PD1" 
    config PIN_GEAR_1_DIAG
      default "PA4" 

    config PIN_GEAR_2_UART 
      default "PC6" 
    config PIN_GEAR_2_STEP
      default "PD0" 
    config PIN_GEAR_2_DIR
      default "PB3" 
    config PIN_GEAR_2_ENABLE
      default "PA15" 
    config PIN_GEAR_2_DIAG

    config PIN_GEAR_3_UART 
      default "PA9" 
    config PIN_GEAR_3_STEP
      default "PB6" 
    config PIN_GEAR_3_DIR
      default "PB7" 
    config PIN_GEAR_3_ENABLE
      default "PB5" 
    config PIN_GEAR_3_DIAG
      default "PB8" 

    config PIN_PRE_GATE_0
      default "PB11" 
    config PIN_PRE_GATE_1
      default "PA3" 
    config PIN_PRE_GATE_2
      default "PB9" 
    config PIN_PRE_GATE_3
      default "PB8" 

    config PIN_GEAR_SENSOR_0
      default "PC15"
    config PIN_GEAR_SENSOR_1
      default "PC13"
    config PIN_GEAR_SENSOR_2
      default "PC14"
    config PIN_GEAR_SENSOR_3
      default "PC12"
    
    config PIN_DC_ESPOOLER_0_A
      default "PA0"
    config PIN_DC_ESPOOLER_1_A
      default "PA1"
    config PIN_DC_ESPOOLER_2_A
      default "PB10"
    config PIN_DC_ESPOOLER_3_A
      default "PB2"
  endif

  if PARAM_SELECTOR_TYPE = "LinearSelector"
    config PIN_SELECTOR_UART
      default "PC7" 
    config PIN_SELECTOR_STEP
      default "PD2" 
    config PIN_SELECTOR_DIR
      default "PB13" 
    config PIN_SELECTOR_ENABLE
      default "PD1" 
    config PIN_SELECTOR_DIAG
      default "PA4" 
    config PIN_SELECTOR_ENDSTOP
      default "PB2" 
    config PIN_SELECTOR_SERVO
      default "PA0" 

    config PIN_PRE_GATE_0
      default "PB9" 
    config PIN_PRE_GATE_1
      default "PB8" 
    config PIN_PRE_GATE_2
      default "PC15" 
    config PIN_PRE_GATE_3
      default "PC13" 

    config PIN_PRE_GATE_4
      default "PC14"
    config PIN_PRE_GATE_5
      default "PB12"
    config PIN_PRE_GATE_6
      default "PB11"
    config PIN_PRE_GATE_7
      default "PB10"
  endif

  config PIN_ENCODER
    default "PA1" if MMU_HAS_ENCODER
  config PIN_NEOPIXEL
    default "PA2" 
  config PIN_GATE_SENSOR
    default "PA3" if !MMU_HAS_ENCODER
endif
```

## scripts/boards/Kconfig.mmb_1_1
```kconfig
choice CHOICE_BOARD_TYPE
  config HW_BOARD_TYPE_MMB_1_1
    bool "BTT MMB v1.1 (with CANbus)"
endchoice

if HW_BOARD_TYPE_MMB_1_1
  config PIN_GEAR_UART 
    default "PA10" 
  config PIN_GEAR_STEP
    default "PB15" 
  config PIN_GEAR_DIR
    default "PB14" 
  config PIN_GEAR_ENABLE
    default "PB8" 
  config PIN_GEAR_DIAG
    default "PA3" 

  if !MMU_HAS_SELECTOR
    config PIN_GEAR_1_UART 
      default "PC7" 
    config PIN_GEAR_1_STEP
      default "PD2" 
    config PIN_GEAR_1_DIR
      default "PB13" 
    config PIN_GEAR_1_ENABLE
      default "PD1" 
    config PIN_GEAR_1_DIAG
      default "PA4" 

    config PIN_GEAR_2_UART 
      default "PC6" 
    config PIN_GEAR_2_STEP
      default "PD0" 
    config PIN_GEAR_2_DIR
      default "PB3" 
    config PIN_GEAR_2_ENABLE
      default "PA15" 
    config PIN_GEAR_2_DIAG

    config PIN_GEAR_3_UART 
      default "PA9" 
    config PIN_GEAR_3_STEP
      default "PB6" 
    config PIN_GEAR_3_DIR
      default "PB7" 
    config PIN_GEAR_3_ENABLE
      default "PB5" 
    config PIN_GEAR_3_DIAG
      default "PB8" 

    config PIN_PRE_GATE_0
      default "PB11" 
    config PIN_PRE_GATE_1
      default "PA3" 
    config PIN_PRE_GATE_2
      default "PB9" 
    config PIN_PRE_GATE_3
      default "PA8" 

    config PIN_GEAR_SENSOR_0
      default "PC15"
    config PIN_GEAR_SENSOR_1
      default "PC13"
    config PIN_GEAR_SENSOR_2
      default "PC14"
    config PIN_GEAR_SENSOR_3
      default "PC12"
    
    config PIN_SPOOLER_RWD_0
      default "PA0"
    config PIN_SPOOLER_RWD_1
      default "PA1"
    config PIN_SPOOLER_RWD_2
      default "PB10"
    config PIN_SPOOLER_RWD_3
      default "PB2"
  endif

  if MMU_HAS_SELECTOR
    config PIN_SELECTOR_UART
      default "PC7" 
    config PIN_SELECTOR_STEP
      default "PD2" 
    config PIN_SELECTOR_DIR
      default "PB13" 
    config PIN_SELECTOR_ENABLE
      default "PD1" 
    config PIN_SELECTOR_DIAG
      default "PA4" 
    config PIN_SELECTOR_ENDSTOP
      default "PB2" 
    config PIN_SELECTOR_SERVO
      default "PA0" 

    config PIN_PRE_GATE_0
      default "PB9" 
    config PIN_PRE_GATE_1
      default "PA8" 
    config PIN_PRE_GATE_2
      default "PC15" 
    config PIN_PRE_GATE_3
      default "PC13" 

    config PIN_PRE_GATE_4
      default "PC14"
    config PIN_PRE_GATE_5
      default "PB12"
    config PIN_PRE_GATE_6
      default "PB11"
    config PIN_PRE_GATE_7
      default "PB10"
  endif

  config PIN_ENCODER
    default "PA1" 
  config PIN_NEOPIXEL
    default "PA2" 
  config PIN_GATE_SENSOR
    default "PA3" 
endif
```

## scripts/boards/mellow_easy_brd_can_2/Kconfig
```kconfig
if HW_BOARD_TYPE_MELLOW_EASY_BRD_CAN_2
  config PIN_GEAR_UART
    default "gpio9" 
  config PIN_GEAR_STEP
    default "gpio7" 
  config PIN_GEAR_DIR
    default "gpio8" 
  config PIN_GEAR_ENABLE
    default "gpio6"

  config PIN_SELECTOR_UART
    default "gpio2" 
  config PIN_SELECTOR_STEP
    default "gpio4" 
  config PIN_SELECTOR_DIR
    default "gpio3" 
  config PIN_SELECTOR_ENABLE
    default "gpio5" 
  config PIN_SELECTOR_DIAG
    default "gpio20" if MMU_SELECTOR_TOUCH 
  config PIN_SELECTOR_ENDSTOP
    default "gpio20" if !MMU_SELECTOR_TOUCH
  config PIN_SELECTOR_SERVO
    default "gpio21" 

  config PIN_PRE_GATE_0
    default "gpio24"
  config PIN_PRE_GATE_1
    default "gpio22"
  config PIN_PRE_GATE_2
    default "gpio25"
  config PIN_PRE_GATE_3
    default "gpio23"
  config PIN_PRE_GATE_4
    default "gpio13"
  config PIN_PRE_GATE_5
    default "gpio26"
  config PIN_PRE_GATE_6
    default "gpio12"
  config PIN_PRE_GATE_7
    default "gpio27"
  config PIN_PRE_GATE_8
    default "gpio11"
  config PIN_PRE_GATE_9
    default "gpio28"
  config PIN_PRE_GATE_10
    default "gpio10"
  config PIN_PRE_GATE_11
    default "gpio29"

  config PIN_ENCODER
    default "gpio15" if MMU_HAS_ENCODER
  config PIN_GATE_SENSOR
    default "gpio15"
  config PIN_NEOPIXEL
    default "gpio14"
endif
```

## scripts/servos/Kconfig
```kconfig
if PARAM_SELECTOR_TYPE = "LinearSelector"
  rsource	"Kconfig.*"

  choice CHOICE_SERVO_TYPE 
    prompt "Selector servo type"
    help
      Select the type of servo you are using for the selector. 
  
    config SERVO_TYPE_OTHER
      bool "Not listed / Other"
  endchoice
endif
```

## scripts/servos/Kconfig.ds041mg
```kconfig
if HW_MMU_VENDOR = "ERCF"
  choice CHOICE_SERVO_TYPE 
    config HW_SERVO_TYPE_GDW_DS041MG
      bool "GDW DS041MG"
  endchoice
endif

if HW_SERVO_TYPE_GDW_DS041MG
  config HW_SERVO_MIN_PULSE_WIDTH
    default "0.00050"
  config HW_SERVO_MAX_PULSE_WIDTH
    default "0.00250" 
  config HW_SERVO_MAX_ANGLE
    default 180
  config HW_SERVO_UP_ANGLE
    default 30 
  config HW_SERVO_MOVE_ANGLE
    default 50 if HW_MMU_TYPE_ERCF_2
    default HW_SERVO_UP_ANGLE 
  config HW_SERVO_DOWN_ANGLE
    default 100 
endif
```

## scripts/servos/Kconfig.mg90s
```kconfig
if PARAM_MMU_VENDOR = "ERCF"
  choice CHOICE_SERVO_TYPE 
    config SERVO_TYPE_MG_90S
      bool "MG-90S"
  endchoice
endif

if SERVO_TYPE_MG_90S 
  config PARAM_SERVO_MIN_PULSE_WIDTH
    default "0.00085"
  config PARAM_SERVO_MAX_PULSE_WIDTH
    default "0.00240"
  config PARAM_SERVO_MAX_ANGLE
    default 180
  config PARAM_SERVO_UP_ANGLE
    default 30 
  config PARAM_SERVO_MOVE_ANGLE
    default 61 if MMU_TYPE_ERCF_2
    default PARAM_SERVO_UP_ANGLE 
  config PARAM_SERVO_DOWN_ANGLE
    default 140 
endif
```

## scripts/servos/Kconfig.sh0225mg
```kconfig
if HW_MMU_VENDOR = "ERCF"
  choice CHOICE_SERVO_TYPE 
    config HW_SERVO_TYPE_GDW_DS041MG
      bool "GDW DS041MG"
  endchoice
endif

if HW_SERVO_TYPE_SAVOX_SH0255MG 
  config HW_SERVO_MIN_PULSE_WIDTH
    default "0.00085"
  config HW_SERVO_MAX_PULSE_WIDTH
    default "0.00240" 
  config HW_SERVO_MAX_ANGLE
    default 180
  config HW_SERVO_UP_ANGLE
    default 140 
  config HW_SERVO_MOVE_ANGLE
    default 109 if HW_MMU_TYPE_ERCF_2
    default HW_SERVO_UP_ANGLE
  config HW_SERVO_DOWN_ANGLE
    default 30 
endif
```

## scripts/servos/Kconfig.tradrack
```kconfig
if HW_MMU_VENDOR = "Tradrack"
  choice CHOICE_SERVO_TYPE 
    config HW_SERVO_TYPE_TRADRACK
      bool "PS-1171MG or FT1117M (Tradrack)"
  endchoice
endif

if HW_SERVO_TYPE_TRADRACK
  config HW_SERVO_MIN_PULSE_WIDTH
    default "0.00070"
  config HW_SERVO_MAX_PULSE_WIDTH
    default "0.00220" 
  config HW_SERVO_MAX_ANGLE
    default 131
  config HW_SERVO_UP_ANGLE
    default 145 
  config HW_SERVO_MOVE_ANGLE
    default HW_SERVO_UP_ANGLE
  config HW_SERVO_DOWN_ANGLE
    default 1 
endif
```

## scripts/types/Kconfig
```kconfig
rsource "Kconfig.*"

config HW_MMU_VENDOR
  string
  default "Other"

config HW_MMU_BASE_VERSION
  string
  default "0.1" 

choice CHOICE_MMU_TYPE 
  prompt "MMU Type"
  help 
    Select the type of MMU you are using. 
    This will configure the default settings for your setup.

  config HW_MMU_TYPE_CUSTOM
    bool "Custom"
    imply HW_REQUIRE_BOWDEN_MOVE

  if HW_MMU_TYPE_CUSTOM
    rsource "starters/Kconfig.*"

    choice CHOICE_MMU_CUSTOM_TYPE
      prompt "Pick a starter config"
      help 
        Select a custom starter config to start from. 
        This will configure a good starting point for your custom MMU setup.
    endchoice
  endif
endchoice
```

## scripts/types/Kconfig.3ms
```kconfig
choice CHOICE_MMU_TYPE
  config MMU_TYPE_3MS_1
    bool "3MS v1.0"
    select VARIABLE_ROTATION_DISTANCES
    select FILAMENT_ALWAYS_GRIPPED
endchoice

if MMU_TYPE_3MS_1
  config PARAM_MMU_VENDOR
    default "3MS"
  config PARAM_MMU_VERSION
    default "1.0"

  config PARAM_GEAR_GEAR_RATIO
    default "1:1"
  config PARAM_GEAR_RUN_CURRENT
    default "0.7"
  config PARAM_GEAR_HOLD_CURRENT
    default "0.1"
  config PARAM_GEAR_HOMING_SPEED
    default "80"
  config PARAM_GATE_HOMING_MAX
    default "500"
  config PARAM_GATE_PARKING_DISTANCE
    default "250"

  # config PARAM_SELECTOR_TYPE
  #   default "VirtualSelector"
  choice CHOICE_SELECTOR_TYPE
    default SELECTOR_TYPE_VIRTUAL
  endchoice

  choice CHOICE_GATE_HOMING_ENDSTOP
    default GATE_HOMING_ENDSTOP_EXTRUDER
  endchoice
  
  choice CHOICE_EXTRUDER_HOMING_ENDSTOP
    default EXTRUDER_HOMING_ENDSTOP_EXTRUDER
  endchoice
endif 
```

## scripts/types/Kconfig.angry_beaver_1
```kconfig
choice CHOICE_MMU_TYPE
  config MMU_TYPE_ANGRY_BEAVER_1
    bool "Angry Beaver v1.0"
    select VARIABLE_ROTATION_DISTANCES
    select FILAMENT_ALWAYS_GRIPPED
endchoice

if MMU_TYPE_ANGRY_BEAVER_1
  config PARAM_MMU_VENDOR
    default "AngryBeaver"
  config MMU_BASE_VERSION
    default "1.0"

  config PARAM_GEAR_GEAR_RATIO
    default "1:1"
  config PARAM_GEAR_RUN_CURRENT
    default "0.7"
  config PARAM_GEAR_HOLD_CURRENT
    default "0.1"
  config PARAM_GEAR_HOMING_SPEED
    default "80"
  config PARAM_GATE_HOMING_MAX
    default "500"
  config PARAM_GATE_PARKING_DISTANCE
    default "50"

  config PARAM_SELECTOR_TYPE
    default "VirtualSelector"

  choice CHOICE_GATE_HOMING_ENDSTOP
    default GATE_HOMING_ENDSTOP_GATE
  endchoice
  
  choice CHOICE_EXTRUDER_HOMING_ENDSTOP
    default EXTRUDER_HOMING_ENDSTOP_EXTRUDER
  endchoice
endif 
```

## scripts/types/Kconfig.box_turtle_1
```kconfig
choice CHOICE_MMU_TYPE
  config HW_MMU_TYPE_BOX_TURTLE_1
    bool "Box Turtle v1.0"
    select HW_VARIABLE_BOWDEN_LENGTHS
    select HW_VARIABLE_ROTATION_DISTANCES
    select HW_REQUIRE_BOWDEN_MOVE
    select HW_FILAMENT_ALWAYS_GRIPPED
endchoice

if HW_MMU_TYPE_BOX_TURTLE_1
  config HW_MMU_VENDOR
    default "BoxTurtle"
  config HW_MMU_BASE_VERSION
    default "1.0"

  config HW_GEAR_GEAR_RATIO
    default "1:1"
  config HW_GEAR_RUN_CURRENT
    default "0.7"
  config HW_GEAR_HOLD_CURRENT
    default "0.1"

  config HW_SELECTOR_TYPE
    default "VirtualSelector"

  choice CHOICE_GATE_HOMING_ENDSTOP
    default PARAM_GATE_HOMING_ENDSTOP_GATE
  endchoice
  
  choice CHOICE_EXTRUDER_HOMING_ENDSTOP
    default PARAM_EXTRUDER_HOMING_ENDSTOP_NONE
  endchoice
endif 
```

## scripts/types/Kconfig.ercf_1_1
```kconfig
choice CHOICE_MMU_TYPE 
  config MMU_TYPE_ERCF_1_1
    bool "ERCF v1.1"
    select MMU_HAS_ENCODER
    select VARIABLE_ROTATION_DISTANCES
    select REQUIRE_BOWDEN_MOVE
    # select SELECTOR_TYPE_LINEAR

  if MMU_TYPE_ERCF_1_1 
    config EXT_SPRINGY
      bool "Springy"
    config EXT_BINKY
      bool "Binky"
    config EXT_TRIPLE_DECK
      bool "Triple Deck"
  endif
endchoice

if MMU_TYPE_ERCF_1_1
  config PARAM_MMU_VENDOR
    default "ERCF"
  config PARAM_MMU_VERSION
    default "1.1sbt" if EXT_SPRINGY && EXT_BINKY && EXT_TRIPLE_DECK
    default "1.1sb" if EXT_SPRINGY && EXT_BINKY
    default "1.1st" if EXT_SPRINGY && EXT_TRIPLE_DECK
    default "1.1bt" if EXT_BINKY && EXT_TRIPLE_DECK
    default "1.1s" if EXT_SPRINGY
    default "1.1b" if EXT_BINKY
    default "1.1t" if EXT_TRIPLE_DECK
    default "1.1"

   
  config PARAM_SERVO_BUZZ_GEAR_ON_DOWN
    default 3

  config PARAM_GEAR_GEAR_RATIO
    default "80:20"
  config PARAM_GEAR_RUN_CURRENT
    default "0.5"
  config PARAM_GEAR_HOLD_CURRENT
    default "0.1"
  config PARAM_SELECTOR_RUN_CURRENT
    default "0.4"
  config PARAM_SELECTOR_HOLD_CURRENT
    default "0.2"
  config PARAM_SERVO_DURATION
    default "0.4"
  config PARAM_ENCODER_RESOLUTION
    default "0.7059"
  config PARAM_GATE_PARKING_DISTANCE
    default "23"

  # config PARAM_SELECTOR_TYPE
  #   default "LinearSelector"

  # config SELECTOR_TYPE_LINEAR
  #   bool
  #   default y 
  choice CHOICE_SELECTOR_TYPE
    default SELECTOR_TYPE_LINEAR
  endchoice

  choice CHOICE_GATE_HOMING_ENDSTOP
    default GATE_HOMING_ENDSTOP_ENCODER
  endchoice
  
  choice CHOICE_EXTRUDER_HOMING_ENDSTOP
    default EXTRUDER_HOMING_ENDSTOP_COLLISION
  endchoice
endif 
```

## scripts/types/Kconfig.ercf_2
```kconfig
choice CHOICE_MMU_TYPE 
  config MMU_TYPE_ERCF_2
    bool "ERCF v2.0"
    select MMU_HAS_ENCODER
    select VARIABLE_ROTATION_DISTANCES
    select REQUIRE_BOWDEN_MOVE
  
  if MMU_TYPE_ERCF_2
    config EXT_THUMPER_BLOCKS
      bool "Thumper Blocks"
  endif
endchoice 

if MMU_TYPE_ERCF_2
  config PARAM_MMU_VENDOR
    default "ERCF"
  config MMU_BASE_VERSION
    default "2.0"
  
  config PARAM_SERVO_BUZZ_GEAR_ON_DOWN
    default 3
 
  config PARAM_GEAR_GEAR_RATIO
    default "80:20"
  config PARAM_GEAR_RUN_CURRENT
    default "0.5"
  config PARAM_GEAR_HOLD_CURRENT
    default "0.1"
  config PARAM_SELECTOR_RUN_CURRENT
    default "0.4"
  config PARAM_SELECTOR_HOLD_CURRENT
    default "0.2"
  config PARAM_SERVO_DURATION
    default "0.4"
  config PARAM_ENCODER_RESOLUTION
    default "1.0"
  config PARAM_GATE_PARKING_DISTANCE
    default "11" if EXT_THUMPER_BLOCKS
    default "13"

  config PARAM_SELECTOR_TYPE
    default "LinearSelector"

  choice CHOICE_GATE_HOMING_ENDSTOP
    default GATE_HOMING_ENDSTOP_ENCODER
  endchoice
  
  choice CHOICE_EXTRUDER_HOMING_ENDSTOP
    default EXTRUDER_HOMING_ENDSTOP_COLLISION
  endchoice
endif 
```
