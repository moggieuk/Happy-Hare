## scripts/types/Kconfig.tradrack_1
```kconfig
choice CHOICE_MMU_TYPE
  config HW_MMU_TYPE_TRADRACK_1
    bool "Tradrack v1.0"
    select MMU_HAS_SELECTOR
    select HW_REQUIRE_BOWDEN_MOVE
    imply HW_SERVO_ALWAYS_ACTIVE
    
  config HW_EXT_BINKY
    bool "Binky" 
    select MMU_HAS_ENCODER
    depends on HW_MMU_TYPE_TRADRACK_1
endchoice

if HW_MMU_TYPE_TRADRACK_1
  config HW_MMU_VENDOR
    default "Tradrack"
  config HW_MMU_BASE_VERSION
    default "1.0"

  config HW_SERVO_BUZZ_GEAR_ON_DOWN
    default 1

  config HW_GEAR_GEAR_RATIO
    default "50:17"
  config HW_GEAR_RUN_CURRENT
    default "1.27"
  config HW_GEAR_HOLD_CURRENT
    default "0.2"
  config HW_SELECTOR_RUN_CURRENT
    default "0.63"
  config HW_SELECTOR_HOLD_CURRENT
    default "0.2"

  config HW_SELECTOR_TYPE
    default "LinearSelector"

  choice CHOICE_GATE_HOMING_ENDSTOP
    default PARAM_GATE_HOMING_ENDSTOP_GATE
  endchoice
  
  choice CHOICE_EXTRUDER_HOMING_ENDSTOP
    default PARAM_EXTRUDER_HOMING_ENDSTOP_NONE
  endchoice
endif 
```

## scripts/types/starters/Kconfig.type_a
```kconfig
choice CHOICE_MMU_CUSTOM_TYPE
  config MMU_CUSTOM_TYPE_A
    bool "Type A (Selector)"
		imply MMU_HAS_SELECTOR
    imply HW_REQUIRE_BOWDEN_MOVE
  
  if MMU_CUSTOM_TYPE_A 
    config MMU_HAS_ENCODER
      bool "With encoder?"
  endif 
endchoice

if MMU_CUSTOM_TYPE_A
  config HW_MMU_VENDOR
    default "Other"
  config HW_MMU_BASE_VERSION
    default "1.0"

  config HW_GEAR_GEAR_RATIO
    default "1:1"
  config HW_GEAR_RUN_CURRENT
    default "0.7"
  config HW_GEAR_HOLD_CURRENT
    default "0.1"

  config HW_SELECTOR_RUN_CURRENT
    default "0.5"
  config HW_SELECTOR_HOLD_CURRENT
    default "0.1"
  config HW_SELECTOR_TYPE
    default "LinearSelector"

  choice CHOICE_GATE_HOMING_ENDSTOP
    default PARAM_GATE_HOMING_ENDSTOP_ENCODER if MMU_HAS_ENCODER
    default PARAM_GATE_HOMING_ENDSTOP_GATE if !MMU_HAS_ENCODER
  endchoice

  choice CHOICE_EXTRUDER_HOMING_ENDSTOP
    default PARAM_EXTRUDER_HOMING_ENDSTOP_COLLISION if MMU_HAS_ENCODER
    default PARAM_EXTRUDER_HOMING_ENDSTOP_NONE if !MMU_HAS_ENCODER
  endchoice
endif 
```

## scripts/types/starters/Kconfig.type_b
```kconfig
choice CHOICE_MMU_CUSTOM_TYPE
  config MMU_CUSTOM_TYPE_B
    bool "Type B (Multiple filament drivers)"
    imply HW_REQUIRE_BOWDEN_MOVE
    imply HW_VARIABLE_BOWDEN_LENGTHS
    imply HW_VARIABLE_ROTATION_DISTANCES
    imply HW_FILAMENT_ALWAYS_GRIPPED

  if MMU_CUSTOM_TYPE_B
    config MMU_HAS_ENCODER
      bool "With encoder?"
    config MMU_WITH_SHARED_GATE # There seems to be no difference in setup between shared gate and not?
      bool "With shared Gate?"
    config MMU_WITH_GEAR_SENSORS
      bool "With individual post-gear sensors?"
  endif
endchoice

if MMU_CUSTOM_TYPE_B
  config HW_MMU_VENDOR
    default "Other"
  config HW_MMU_BASE_VERSION
    default "1.0"

  config HW_GEAR_GEAR_RATIO
    default "1:1"
  config HW_GEAR_RUN_CURRENT
    default "0.7"
  config HW_GEAR_HOLD_CURRENT
    default "0.1"

  config HW_SELECTOR_TYPE
    default "VirtualSelector"

  choice CHOICE_GATE_HOMING_ENDSTOP
    default PARAM_GATE_HOMING_ENDSTOP_GATE if !MMU_WITH_GEAR_SENSORS
    default PARAM_GATE_HOMING_ENDSTOP_GEAR if MMU_WITH_GEAR_SENSORS
  endchoice

  choice CHOICE_EXTRUDER_HOMING_ENDSTOP
    default PARAM_EXTRUDER_HOMING_ENDSTOP_NONE
  endchoice
endif 
```
